## CMakeLists.txt
```
# SPDX-License-Identifier: Apache-2.0

cmake_minimum_required(VERSION 3.20.0)
find_package(Zephyr REQUIRED HINTS $ENV{ZEPHYR_BASE})
project(posix_c_lib_ext)

FILE(GLOB app_sources src/*.c)

target_sources(app PRIVATE ${app_sources})

target_include_directories(app PRIVATE ${ZEPHYR_POSIX_NEXT_MODULE_DIR}/lib/posix/options/getopt)
target_compile_options(app PRIVATE -U_POSIX_C_SOURCE -D_POSIX_C_SOURCE=202405L)
```

## Kconfig
```
# SPDX-FileCopyrightText: Copyright The Zephyr Project Contributors
# SPDX-License-Identifier: Apache-2.0

source "Kconfig.zephyr"
rsource "../Kconfig.test_common"

choice TEST_LOCALE_CHOICE
	prompt "Locale for strfmon tests"
	default TEST_LOCALE_CHOICE_C
	help
	  Choose the locale to be used for strfmon tests.

config TEST_LOCALE_CHOICE_C
	bool "Test locale C"
	help
	  Enable test using the C locale.

config TEST_LOCALE_CHOICE_EN_US_UTF8
	bool "Test locale en_US.UTF-8"
	help
	  Test using the en_US.UTF-8 locale.

endchoice

config TEST_LOCALE_STR
	string
	default "C" if TEST_LOCALE_CHOICE_C
	default "en_US.UTF-8" if TEST_LOCALE_CHOICE_EN_US_UTF8
	default "C"
```

## prj.conf
```kconfig
CONFIG_ZTEST=y

CONFIG_POSIX_C_LIB_EXT=y
CONFIG_ENTROPY_GENERATOR=y

# Picolibc requires this to be set for formatting floats
CONFIG_REQUIRES_FLOAT_PRINTF=y
```

## src/main.c
```c
/*
 * Copyright The Zephyr Contributors
 *
 * SPDX-License-Identifier: Apache-2.0
 */

#include <zephyr/ztest.h>

ZTEST_SUITE(posix_c_lib_ext, NULL, NULL, NULL, NULL, NULL);
```

## src/fnmatch.c
```c
/*
 * Copyright (c) The Zephyr Project Contributors
 *
 * SPDX-License-Identifier: Apache-2.0
 */

#include <ctype.h>
#include <fnmatch.h>

#include <zephyr/ztest.h>

/*
 * Note: the \x00 control character is specifically excluded below, since testing for it is
 * equivalent to reading past the end of a '\0'-terminated string (i.e. can fault).
 */
#define TEST_BLANK_CHARS " \t"
#define TEST_CNTRL_CHARS                                                                           \
	"\x01\x02\x03\x04\x05\x06\x07\x08\x09\x0a\x0b\x0c\x0d\x0e\x0f\x10\x11\x12\x13\x14\x15\x16" \
	"\x17\x18\x19\x1a\x1b\x1c\x1d\x1e\x1f\x7f"
#define TEST_DIGIT_CHARS  "0123456789"
#define TEST_LOWER_CHARS  "abcdefghijklmnopqrstuvwxyz"
#define TEST_PUNCT_CHARS  "!\"#$%&'()*+,-./:;<=>?@[\\]^_`{|}~"
#define TEST_SPACE_CHARS  " \f\n\r\t\v"
#define TEST_UPPER_CHARS  "ABCDEFGHIJKLMNOPQRSTUVWXYZ"
#define TEST_XDIGIT_CHARS "0123456789ABCDEFabcdef"

/*
 * Adapted from
 * https://git.musl-libc.org/cgit/libc-testsuite/tree/fnmatch.c
 */
ZTEST_USER(posix_c_lib_ext, test_fnmatch)
{
	zexpect_ok(fnmatch("*.c", "foo.c", 0));
	zexpect_ok(fnmatch("*.c", ".c", 0));
	zexpect_equal(fnmatch("*.a", "foo.c", 0), FNM_NOMATCH);
	zexpect_ok(fnmatch("*.c", ".foo.c", 0));
	zexpect_equal(fnmatch("*.c", ".foo.c", FNM_PERIOD), FNM_NOMATCH);
	zexpect_ok(fnmatch("*.c", "foo.c", FNM_PERIOD));
	zexpect_equal(fnmatch("a\\*.c", "a*.c", FNM_NOESCAPE), FNM_NOMATCH);
	zexpect_equal(fnmatch("a\\*.c", "ax.c", 0), FNM_NOMATCH);
	zexpect_ok(fnmatch("a[xy].c", "ax.c", 0));
	zexpect_ok(fnmatch("a[!y].c", "ax.c", 0));
	zexpect_equal(fnmatch("a[a/z]*.c", "a/x.c", FNM_PATHNAME), FNM_NOMATCH);
	zexpect_ok(fnmatch("a/*.c", "a/x.c", FNM_PATHNAME));
	zexpect_equal(fnmatch("a*.c", "a/x.c", FNM_PATHNAME), FNM_NOMATCH);
	zexpect_ok(fnmatch("*/foo", "/foo", FNM_PATHNAME));
	zexpect_ok(fnmatch("-O[01]", "-O1", 0));
	/*
	 * '\' in pattern escapes ']'. bracket expression is incomplete. pattern is interpreted as
	 * literal sequence '[[?*\]'. which does not match input '\'
	 */
	zexpect_equal(fnmatch("[[?*\\]", "\\", 0), FNM_NOMATCH);
	/* '\' in pattern does not escape ']'. bracket expression complete. '\' matches input '\' */
	zexpect_ok(fnmatch("[[?*\\]", "\\", FNM_NOESCAPE));
	/* '\' in pattern escapes '\', match '\' */
	zexpect_ok(fnmatch("[[?*\\\\]", "\\", 0));
	/*
	 * "[]" (empty bracket expression) is an invalid pattern.
	 * > The ( ']' ) shall lose its special meaning and represent itself in a bracket expression
	 * > if it occurs first in the list (after an initial ( '^' ), if any)
	 * https://pubs.opengroup.org/onlinepubs/9699919799/basedefs/V1_chap09.html#tag_09_03_05
	 *
	 * So the next test is (again) and incomplete bracket expression and should return error.
	 * The two tests that follow it also require the ']' to be treated as a literal character to
	 * match within the bracket expression.
	 */
	zexpect_equal(fnmatch("[]?*\\]", "]", 0), FNM_NOMATCH);
	/* '\' in pattern does not escape. bracket expression complete. ']' matches input ']' */
	zexpect_ok(fnmatch("[]?*\\]", "]", FNM_NOESCAPE));
	/* '\' in pattern escapes '\'. bracket expression complete. ']' matches input ']' */
	zexpect_ok(fnmatch("[]?*\\\\]", "]", 0));

	zexpect_ok(fnmatch("[!]a-]", "b", 0));
	zexpect_ok(fnmatch("[]-_]", "^", 0));
	zexpect_ok(fnmatch("[!]-_]", "X", 0));
	zexpect_equal(fnmatch("??", "-", 0), FNM_NOMATCH);
	zexpect_equal(fnmatch("*LIB*", "lib", FNM_PERIOD), FNM_NOMATCH);
	zexpect_ok(fnmatch("a[/]b", "a/b", 0));
	zexpect_equal(fnmatch("a[/]b", "a/b", FNM_PATHNAME), FNM_NOMATCH);
	zexpect_ok(fnmatch("[a-z]/[a-z]", "a/b", 0));
	zexpect_equal(fnmatch("*", "a/b", FNM_PATHNAME), FNM_NOMATCH);
	zexpect_equal(fnmatch("*[/]b", "a/b", FNM_PATHNAME), FNM_NOMATCH);
	zexpect_equal(fnmatch("*[b]", "a/b", FNM_PATHNAME), FNM_NOMATCH);
	zexpect_equal(fnmatch("[*]/b", "a/b", 0), FNM_NOMATCH);
	zexpect_ok(fnmatch("[*]/b", "*/b", 0));
	zexpect_equal(fnmatch("[?]/b", "a/b", 0), FNM_NOMATCH);
	zexpect_ok(fnmatch("[?]/b", "?/b", 0));
	zexpect_ok(fnmatch("[[a]/b", "a/b", 0));
	zexpect_ok(fnmatch("[[a]/b", "[/b", 0));
	zexpect_equal(fnmatch("\\*/b", "a/b", 0), FNM_NOMATCH);
	zexpect_ok(fnmatch("\\*/b", "*/b", 0));
	zexpect_equal(fnmatch("\\?/b", "a/b", 0), FNM_NOMATCH);
	zexpect_ok(fnmatch("\\?/b", "?/b", 0));
	zexpect_ok(fnmatch("[/b", "[/b", 0));
	zexpect_ok(fnmatch("\\[/b", "[/b", 0));
	zexpect_ok(fnmatch("??"
			   "/b",
			   "aa/b", 0));
	zexpect_ok(fnmatch("???b", "aa/b", 0));
	zexpect_equal(fnmatch("???b", "aa/b", FNM_PATHNAME), FNM_NOMATCH);
	zexpect_equal(fnmatch("?a/b", ".a/b", FNM_PATHNAME | FNM_PERIOD), FNM_NOMATCH);
	zexpect_equal(fnmatch("a/?b", "a/.b", FNM_PATHNAME | FNM_PERIOD), FNM_NOMATCH);
	zexpect_equal(fnmatch("*a/b", ".a/b", FNM_PATHNAME | FNM_PERIOD), FNM_NOMATCH);
	zexpect_equal(fnmatch("a/*b", "a/.b", FNM_PATHNAME | FNM_PERIOD), FNM_NOMATCH);
	zexpect_equal(fnmatch("[.]a/b", ".a/b", FNM_PATHNAME | FNM_PERIOD), FNM_NOMATCH);
	zexpect_equal(fnmatch("a/[.]b", "a/.b", FNM_PATHNAME | FNM_PERIOD), FNM_NOMATCH);
	zexpect_ok(fnmatch("*/?", "a/b", FNM_PATHNAME | FNM_PERIOD));
	zexpect_ok(fnmatch("?/*", "a/b", FNM_PATHNAME | FNM_PERIOD));
	zexpect_ok(fnmatch(".*/?", ".a/b", FNM_PATHNAME | FNM_PERIOD));
	zexpect_ok(fnmatch("*/.?", "a/.b", FNM_PATHNAME | FNM_PERIOD));
	zexpect_equal(fnmatch("*/*", "a/.b", FNM_PATHNAME | FNM_PERIOD), FNM_NOMATCH);
	zexpect_ok(fnmatch("*?*/*", "a/.b", FNM_PERIOD));
	zexpect_ok(fnmatch("*[.]/b", "a./b", FNM_PATHNAME | FNM_PERIOD));
	zexpect_ok(fnmatch("*[[:alpha:]]/*[[:alnum:]]", "a/b", FNM_PATHNAME));
	zexpect_ok(fnmatch("*[![:digit:]]*/[![:d-d]", "a/b", FNM_PATHNAME), 0);
	zexpect_ok(fnmatch("*[![:digit:]]*/[[:d-d]", "a/[", FNM_PATHNAME), 0);
	zexpect_equal(fnmatch("*[![:digit:]]*/[![:d-d]", "a/[", FNM_PATHNAME), FNM_NOMATCH);
	zexpect_ok(fnmatch("a?b", "a.b", FNM_PATHNAME | FNM_PERIOD));
	zexpect_ok(fnmatch("a*b", "a.b", FNM_PATHNAME | FNM_PERIOD));
	zexpect_ok(fnmatch("a[.]b", "a.b", FNM_PATHNAME | FNM_PERIOD));

	/* Additional test cases for POSIX character classes (C-locale only) */
	static const struct test_data_s {
		const char *pattern;
		const char *match;
		const char *nomatch;
	} test_data[] = {
		{"[[:alnum:]]", TEST_DIGIT_CHARS TEST_UPPER_CHARS TEST_LOWER_CHARS, " "},
		{"[[:alpha:]]", TEST_UPPER_CHARS TEST_LOWER_CHARS, "0"},
		{"[[:blank:]]", TEST_BLANK_CHARS, "x"},
		{"[[:cntrl:]]", TEST_CNTRL_CHARS, "x"},
		{"[[:digit:]]", TEST_DIGIT_CHARS, "a"},
		{"[[:graph:]]", TEST_DIGIT_CHARS TEST_UPPER_CHARS TEST_LOWER_CHARS TEST_PUNCT_CHARS,
		 " "},
		{"[[:lower:]]", TEST_LOWER_CHARS, "X"},
		{"[[:print:]]",
		 TEST_DIGIT_CHARS TEST_UPPER_CHARS TEST_LOWER_CHARS TEST_PUNCT_CHARS " ", "\t"},
		{"[[:punct:]]", TEST_PUNCT_CHARS, "x"},
		{"[[:space:]]", TEST_SPACE_CHARS, "x"},
		{"[[:upper:]]", TEST_UPPER_CHARS, "x"},
		{"[[:xdigit:]]", TEST_XDIGIT_CHARS, "h"},
	};

	ARRAY_FOR_EACH_PTR(test_data, data) {
		/* ensure that characters in "nomatch" do not match "pattern" */
		for (size_t j = 0; j < strlen(data->nomatch); j++) {
			char c = data->nomatch[j];
			char input[] = {c, '\0'};

			zexpect_equal(fnmatch(data->pattern, input, 0), FNM_NOMATCH,
				      "pattern \"%s\" unexpectedly matched char 0x%02x (%c)",
				      data->pattern, c, isprint(c) ? c : '.');
		}

		/* ensure that characters in "match" do match "pattern" */
		for (size_t j = 0; j < strlen(data->match); j++) {
			char c = data->match[j];
			char input[] = {c, '\0'};

			zexpect_ok(fnmatch(data->pattern, input, 0),
				   "pattern \"%s\" did not match char 0x%02x (%c)", data->pattern,
				   c, isprint(c) ? c : '.');
		}
	}

	/* ensure that an invalid character class generates an error */
	zexpect_equal(fnmatch("[[:foobarbaz:]]", "Z", 0), FNM_NOMATCH);
}
```

## src/getentropy.c
```c
/*
 * Copyright (c) 2024 Google LLC
 *
 * SPDX-License-Identifier: Apache-2.0
 */

#include <zephyr/posix/unistd.h>

#include <zephyr/device.h>
#include <zephyr/ztest.h>

#if DT_HAS_CHOSEN(zephyr_entropy)
static const struct device *const dev = DEVICE_DT_GET(DT_CHOSEN(zephyr_entropy));
#else
static const struct device *const dev;
#endif

ZTEST_USER(posix_c_lib_ext, test_getentropy)
{
	/* verify that a buffer larger than 256 bytes returns an error */
	{
		uint8_t buf[256 + 1] = {0};
		int ret;

		ret = getentropy(buf, sizeof(buf));
		zexpect_equal(ret, -1);
		zexpect_equal(errno, EIO);
	}

	if (((dev == NULL) || !device_is_ready(dev)) &&
	    !(IS_ENABLED(CONFIG_CSPRNG_ENABLED) || IS_ENABLED(CONFIG_TEST_CSPRNG_GENERATOR))) {
		/* no entropy device and no generator to stand in for it: EIO */
		{
			uint8_t buf[16] = {0};
			int ret;

			ret = getentropy(buf, sizeof(buf));
			zexpect_equal(ret, -1);
			zexpect_equal(errno, EIO);
		}

		/* some platforms do not have an entropy device, so skip the tests below */
		ztest_test_skip();
	}

	/* verify that a buffer of 256 bytes returns success */
	{
		uint8_t buf[256] = {0};
		int ret;

		ret = getentropy(buf, sizeof(buf));
		zexpect_equal(ret, 0);
	}

	/* verify that two calls return different data */
	{
		uint8_t zero[16] = {0};
		uint8_t buf1[16];
		uint8_t buf2[16];
		int ret;

		ret = getentropy(buf1, sizeof(buf1));
		zassert_equal(ret, 0);

		ret = getentropy(buf2, sizeof(buf2));
		zassert_equal(ret, 0);

		zassert_true(memcmp(buf1, zero, sizeof(zero)) != 0);
		zassert_true(memcmp(buf2, zero, sizeof(zero)) != 0);
		zassert_true(memcmp(buf1, buf2, sizeof(buf1)) != 0);
	}
}
```

## src/getopt_long.c
```c
/*
 * Copyright (c) The Zephyr Project Contributors
 *
 * SPDX-License-Identifier: Apache-2.0
 */

#include <ctype.h>
#include <getopt.h>
#include <stdio.h>

#include <zephyr/sys/util.h>
#include <zephyr/ztest.h>

#if defined(CONFIG_NATIVE_LIBC)
/* glibc() use char *argv[], which breaks conformance */
#define GETOPT_ARGV_CAST char **
#else
/* POSIX requires the argv array to be of type char *const [] */
#define GETOPT_ARGV_CAST char *const *
#endif

#define TEST_MAX_LOOP_ITER 10
static int loop_iter;

ZTEST(getopt_long, test_getopt_long)
{
	if (IS_ENABLED(CONFIG_NATIVE_LIBC)) {
		/* This seems to be required by glibc in order to reliably reset getopt state */
		static const char *const argv[] = {"cmd", NULL};
		int argc = ARRAY_SIZE(argv) - 1;

		optind = 0;
		(void)getopt(argc, (GETOPT_ARGV_CAST)argv, "");
	}

	/* Test basic long option without argument */
	{
		static const struct option long_options[] = {
			{"verbose", no_argument, NULL, 'v'},
			{"help", no_argument, NULL, 'h'},
			{0, 0, 0, 0},
		};
		static const char *const argv[] = {"cmd", "--verbose", NULL};
		int argc = ARRAY_SIZE(argv) - 1;
		int opt;

		optind = 1;
		opt = getopt_long(argc, (GETOPT_ARGV_CAST)argv, "vh", long_options, NULL);
		zexpect_equal('v', opt, "getopt_long should return 'v' for --verbose");
	}

	/* Test long option with required argument (separate) */
	{
		static const struct option long_options[] = {
			{"file", required_argument, NULL, 'f'},
			{0, 0, 0, 0},
		};
		static const char *const argv[] = {"cmd", "--file", "myfile.txt", NULL};
		int argc = ARRAY_SIZE(argv) - 1;
		int opt;

		optind = 1;
		opt = getopt_long(argc, (GETOPT_ARGV_CAST)argv, "f:", long_options, NULL);
		zexpect_equal('f', opt);
		zexpect_str_equal("myfile.txt", optarg, "optarg should be 'myfile.txt'");
	}

	/* Test long option with required argument using = syntax */
	{
		static const struct option long_options[] = {
			{"file", required_argument, NULL, 'f'},
			{0, 0, 0, 0},
		};
		static const char *const argv[] = {"cmd", "--file=myfile.txt", NULL};
		int argc = ARRAY_SIZE(argv) - 1;
		int opt;

		optind = 1;
		opt = getopt_long(argc, (GETOPT_ARGV_CAST)argv, "f:", long_options, NULL);
		zexpect_equal('f', opt);
		zexpect_str_equal("myfile.txt", optarg, "optarg should be 'myfile.txt'");
	}

	/* Test multiple long options in sequence */
	{
		static const struct option long_options[] = {
			{"verbose", no_argument, NULL, 'v'},
			{"file", required_argument, NULL, 'f'},
			{0, 0, 0, 0},
		};
		static const char *const argv[] = {"cmd", "--verbose", "--file", "test.txt", NULL};
		int argc = ARRAY_SIZE(argv) - 1;
		int opt;
		int v_count = 0;
		char *f_arg = NULL;

		optind = 1;
		loop_iter = 0;
		while ((opt = getopt_long(argc, (GETOPT_ARGV_CAST)argv, "vf:", long_options,
					  NULL)) != -1) {
			zassert_true(loop_iter < TEST_MAX_LOOP_ITER);
			loop_iter++;

			switch (opt) {
			case 'v':
				v_count++;
				break;
			case 'f':
				f_arg = optarg;
				break;
			}
		}

		zexpect_equal(1, v_count);
		zexpect_not_null(f_arg);
		if (f_arg != NULL) {
			zexpect_str_equal("test.txt", f_arg);
		}
	}

	/* Test longindex parameter returns correct index */
	{
		static const struct option long_options[] = {
			{"verbose", no_argument, NULL, 'v'},
			{"file", required_argument, NULL, 'f'},
			{"output", required_argument, NULL, 'o'},
			{0, 0, 0, 0},
		};
		static const char *const argv[] = {"cmd", "--output", "out.txt", NULL};
		int argc = ARRAY_SIZE(argv) - 1;
		int opt;
		int option_index = -1;

		optind = 1;
		opt = getopt_long(argc, (GETOPT_ARGV_CAST)argv, "vf:o:", long_options,
				  &option_index);
		zexpect_equal('o', opt);
		zexpect_equal(2, option_index, "option_index should be 2 for 'output' option");
		zexpect_str_equal("out.txt", optarg);
	}

	/* Test flag behavior: flag != NULL, getopt_long returns 0 and sets *flag to val */
	{
		static int verbose_flag;
		static int debug_flag;
		static const struct option long_options[] = {
			{"verbose", no_argument, &verbose_flag, 1},
			{"debug", no_argument, &debug_flag, 1},
			{0, 0, 0, 0},
		};
		static const char *const argv[] = {"cmd", "--verbose", "--debug", NULL};
		int argc = ARRAY_SIZE(argv) - 1;
		int opt;

		verbose_flag = 0;
		debug_flag = 0;
		optind = 1;
		loop_iter = 0;
		while ((opt = getopt_long(argc, (GETOPT_ARGV_CAST)argv, "", long_options, NULL)) !=
		       -1) {
			zassert_true(loop_iter < TEST_MAX_LOOP_ITER);
			loop_iter++;

			/* When flag is not NULL, getopt_long returns 0 */
			zexpect_equal(0, opt, "getopt_long should return 0 when flag is not NULL");
		}

		zexpect_equal(1, verbose_flag, "verbose_flag should be set to 1");
		zexpect_equal(1, debug_flag, "debug_flag should be set to 1");
	}

	/* Test flag with different values */
	{
		static int mode_flag;
		static const struct option long_options[] = {
			{"fast", no_argument, &mode_flag, 1},
			{"slow", no_argument, &mode_flag, 2},
			{0, 0, 0, 0},
		};
		static const char *const argv[] = {"cmd", "--fast", NULL};
		int argc = ARRAY_SIZE(argv) - 1;
		int opt;

		mode_flag = 0;
		optind = 1;
		opt = getopt_long(argc, (GETOPT_ARGV_CAST)argv, "", long_options, NULL);
		zexpect_equal(0, opt);
		zexpect_equal(1, mode_flag, "mode_flag should be 1 for --fast");
	}

	/* Test mixing short and long options */
	{
		static const struct option long_options[] = {
			{"verbose", no_argument, NULL, 'v'},
			{"file", required_argument, NULL, 'f'},
			{0, 0, 0, 0},
		};
		static const char *const argv[] = {"cmd", "-v", "--file", "test.txt", NULL};
		int argc = ARRAY_SIZE(argv) - 1;
		int opt;
		int v_count = 0;
		char *f_arg = NULL;

		optind = 1;
		loop_iter = 0;
		while ((opt = getopt_long(argc, (GETOPT_ARGV_CAST)argv, "vf:", long_options,
					  NULL)) != -1) {
			zassert_true(loop_iter < TEST_MAX_LOOP_ITER);
			loop_iter++;

			switch (opt) {
			case 'v':
				v_count++;
				break;
			case 'f':
				f_arg = optarg;
				break;
			}
		}

		zexpect_equal(1, v_count, "short option -v recognized");
		zexpect_not_null(f_arg);
		if (f_arg != NULL) {
			zexpect_str_equal("test.txt", f_arg);
		}
	}

	/* Test long option with optional argument (value provided) */
	{
		static const struct option long_options[] = {
			{"config", optional_argument, NULL, 'c'},
			{0, 0, 0, 0},
		};
		static const char *const argv[] = {"cmd", "--config=myconfig.txt", NULL};
		int argc = ARRAY_SIZE(argv) - 1;
		int opt;

		optind = 1;
		opt = getopt_long(argc, (GETOPT_ARGV_CAST)argv, "c::", long_options, NULL);
		zexpect_equal('c', opt);
		zexpect_str_equal("myconfig.txt", optarg);
	}

	/* Test unknown long option returns '?' */
	{
		static const struct option long_options[] = {
			{"verbose", no_argument, NULL, 'v'},
			{0, 0, 0, 0},
		};
		static const char *const argv[] = {"cmd", "--unknown", NULL};
		int argc = ARRAY_SIZE(argv) - 1;
		int opt;

		optind = 1;
		opt = getopt_long(argc, (GETOPT_ARGV_CAST)argv, "v", long_options, NULL);
		zexpect_equal('?', opt, "unknown option should return '?'");
	}

	/* Test missing required argument returns '?' */
	{
		static const struct option long_options[] = {
			{"file", required_argument, NULL, 'f'},
			{0, 0, 0, 0},
		};
		static const char *const argv[] = {"cmd", "--file", NULL};
		int argc = ARRAY_SIZE(argv) - 1;
		int opt;

		optind = 1;
		opt = getopt_long(argc, (GETOPT_ARGV_CAST)argv, "f:", long_options, NULL);
		zexpect_equal('?', opt, "missing argument should return '?'");
	}

	/* Test colon prefix for different error reporting */
	{
		static const struct option long_options[] = {
			{"file", required_argument, NULL, 'f'},
			{0, 0, 0, 0},
		};
		static const char *const argv[] = {"cmd", "--file", NULL};
		int argc = ARRAY_SIZE(argv) - 1;
		int opt;

		optind = 1;
		opt = getopt_long(argc, (GETOPT_ARGV_CAST)argv, ":f:", long_options, NULL);
		zexpect_equal(':', opt, "with ':' prefix should return ':' for missing argument");
	}

	/* Test '--' terminates option processing */
	{
		static const struct option long_options[] = {
			{"verbose", no_argument, NULL, 'v'},
			{0, 0, 0, 0},
		};
		static const char *const argv[] = {"cmd", "-v", "--", "--verbose", "file", NULL};
		int argc = ARRAY_SIZE(argv) - 1;
		int opt;
		int v_count = 0;

		optind = 1;
		loop_iter = 0;
		while ((opt = getopt_long(argc, (GETOPT_ARGV_CAST)argv, "v", long_options, NULL)) !=
		       -1) {
			zassert_true(loop_iter < TEST_MAX_LOOP_ITER);
			loop_iter++;

			if (opt == 'v') {
				v_count++;
			}
		}

		zexpect_equal(1, v_count, "only one -v before '--' processed");
		zexpect_equal(3, optind, "optind should point past '--'");
		zexpect_str_equal("--verbose", argv[optind], "after '--' should be operand");
	}
}

ZTEST(getopt_long, test_getopt_long_example)
{
	if (IS_ENABLED(CONFIG_NATIVE_LIBC)) {
		/* This seems to be required by glibc in order to reliably reset getopt state */
		static const char *const argv[] = {"cmd", NULL};
		int argc = ARRAY_SIZE(argv) - 1;

		optind = 0;
		(void)getopt(argc, (GETOPT_ARGV_CAST)argv, "");
	}

	/* Test example from man page */
	{
		static const struct option long_options[] = {
			{"add", required_argument, NULL, 'a'},
			{"append", no_argument, NULL, 'A'},
			{"delete", required_argument, NULL, 'd'},
			{"verbose", no_argument, NULL, 'v'},
			{"create", required_argument, NULL, 'c'},
			{"file", required_argument, NULL, 'f'},
			{0, 0, 0, 0}};
		static const char *const argv[] = {"cmd",    "--verbose", "--add", "item1",
						   "--file", "data.txt",  NULL};
		int argc = ARRAY_SIZE(argv) - 1;
		int opt;
		int verbose_count = 0;
		char *add_arg = NULL;
		char *file_arg = NULL;
		int option_index = 0;

		optind = 1;
		loop_iter = 0;
		while ((opt = getopt_long(argc, (GETOPT_ARGV_CAST)argv, "a:Ad:vc:f:", long_options,
					  &option_index)) != -1) {
			zassert_true(loop_iter < TEST_MAX_LOOP_ITER);
			loop_iter++;

			switch (opt) {
			case 'a':
				add_arg = optarg;
				break;
			case 'v':
				verbose_count++;
				break;
			case 'f':
				file_arg = optarg;
				break;
			}
		}

		zexpect_equal(1, verbose_count);
		zexpect_not_null(add_arg);
		if (add_arg != NULL) {
			zexpect_str_equal("item1", add_arg);
		}
		zexpect_not_null(file_arg);
		if (file_arg != NULL) {
			zexpect_str_equal("data.txt", file_arg);
		}
	}
}

ZTEST(getopt_long, test_getopt_long_only)
{
	if (IS_ENABLED(CONFIG_NATIVE_LIBC)) {
		/* This seems to be required by glibc in order to reliably reset getopt state */
		static const char *const argv[] = {"cmd", NULL};
		int argc = ARRAY_SIZE(argv) - 1;

		optind = 0;
		(void)getopt(argc, (GETOPT_ARGV_CAST)argv, "");
	}

	/* Test single dash long option */
	{
		static const struct option long_options[] = {{"verbose", no_argument, NULL, 'v'},
							     {0, 0, 0, 0}};
		static const char *const argv[] = {"cmd", "-verbose", NULL};
		int argc = ARRAY_SIZE(argv) - 1;
		int opt;

		optind = 1;
		opt = getopt_long_only(argc, (GETOPT_ARGV_CAST)argv, "v", long_options, NULL);
		zexpect_equal('v', opt, "getopt_long_only should match -verbose as long option");
	}

	/* Test double dash still works */
	{
		static const struct option long_options[] = {{"verbose", no_argument, NULL, 'v'},
							     {0, 0, 0, 0}};
		static const char *const argv[] = {"cmd", "--verbose", NULL};
		int argc = ARRAY_SIZE(argv) - 1;
		int opt;

		optind = 1;
		opt = getopt_long_only(argc, (GETOPT_ARGV_CAST)argv, "v", long_options, NULL);
		zexpect_equal('v', opt, "getopt_long_only should support --verbose");
	}

	/* Test single dash with required argument (separate) */
	{
		static const struct option long_options[] = {{"file", required_argument, NULL, 'f'},
							     {0, 0, 0, 0}};
		static const char *const argv[] = {"cmd", "-file", "test.txt", NULL};
		int argc = ARRAY_SIZE(argv) - 1;
		int opt;

		optind = 1;
		opt = getopt_long_only(argc, (GETOPT_ARGV_CAST)argv, "f:", long_options, NULL);
		zexpect_equal('f', opt);
		zexpect_str_equal("test.txt", optarg);
	}

	/* Test single dash with required argument (= syntax) */
	{
		static const struct option long_options[] = {{"file", required_argument, NULL, 'f'},
							     {0, 0, 0, 0}};
		static const char *const argv[] = {"cmd", "-file=test.txt", NULL};
		int argc = ARRAY_SIZE(argv) - 1;
		int opt;

		optind = 1;
		opt = getopt_long_only(argc, (GETOPT_ARGV_CAST)argv, "f:", long_options, NULL);
		zexpect_equal('f', opt);
		zexpect_str_equal("test.txt", optarg);
	}

	/* Test single dash non-matching falls back to short option */
	{
		static const struct option long_options[] = {{"verbose", no_argument, NULL, 'v'},
							     {0, 0, 0, 0}};
		static const char *const argv[] = {"cmd", "-a", NULL};
		int argc = ARRAY_SIZE(argv) - 1;
		int opt;

		optind = 1;
		opt = getopt_long_only(argc, (GETOPT_ARGV_CAST)argv, "av", long_options, NULL);
		zexpect_equal('a', opt,
			      "non-matching single dash should fall back to short option");
	}

	/* Test mixing single and double dash long options */
	{
		static const struct option long_options[] = {{"verbose", no_argument, NULL, 'v'},
							     {"file", required_argument, NULL, 'f'},
							     {0, 0, 0, 0}};
		static const char *const argv[] = {"cmd", "-verbose", "--file", "test.txt", NULL};
		int argc = ARRAY_SIZE(argv) - 1;
		int opt;
		int v_count = 0;
		char *f_arg = NULL;

		optind = 1;
		loop_iter = 0;
		while ((opt = getopt_long_only(argc, (GETOPT_ARGV_CAST)argv, "vf:", long_options,
					       NULL)) != -1) {
			zassert_true(loop_iter < TEST_MAX_LOOP_ITER);
			loop_iter++;

			switch (opt) {
			case 'v':
				v_count++;
				break;
			case 'f':
				f_arg = optarg;
				break;
			}
		}

		zexpect_equal(1, v_count);
		zexpect_not_null(f_arg);
		if (f_arg != NULL) {
			zexpect_str_equal("test.txt", f_arg);
		}
	}

	/* Test short option still works */
	{
		static const struct option long_options[] = {{"verbose", no_argument, NULL, 'v'},
							     {0, 0, 0, 0}};
		static const char *const argv[] = {"cmd", "-v", NULL};
		int argc = ARRAY_SIZE(argv) - 1;
		int opt;

		optind = 1;
		opt = getopt_long_only(argc, (GETOPT_ARGV_CAST)argv, "v", long_options, NULL);
		zexpect_equal('v', opt, "short option -v should still work");
	}

	/* Test longindex parameter with single dash */
	{
		static const struct option long_options[] = {
			{"verbose", no_argument, NULL, 'v'},
			{"file", required_argument, NULL, 'f'},
			{"output", required_argument, NULL, 'o'},
			{0, 0, 0, 0}};
		static const char *const argv[] = {"cmd", "-output", "out.txt", NULL};
		int argc = ARRAY_SIZE(argv) - 1;
		int opt;
		int option_index = -1;

		optind = 1;
		opt = getopt_long_only(argc, (GETOPT_ARGV_CAST)argv, "vf:o:", long_options,
				       &option_index);
		zexpect_equal('o', opt);
		zexpect_equal(2, option_index, "option_index should be 2 for 'output'");
		zexpect_str_equal("out.txt", optarg);
	}

	/* Test flag behavior with single dash */
	{
		static int verbose_flag;
		static const struct option long_options[] = {
			{"verbose", no_argument, &verbose_flag, 1}, {0, 0, 0, 0}};
		static const char *const argv[] = {"cmd", "-verbose", NULL};
		int argc = ARRAY_SIZE(argv) - 1;
		int opt;

		verbose_flag = 0;
		optind = 1;
		opt = getopt_long_only(argc, (GETOPT_ARGV_CAST)argv, "", long_options, NULL);
		zexpect_equal(0, opt, "getopt_long_only should return 0 when flag is set");
		zexpect_equal(1, verbose_flag, "verbose_flag should be set to 1");
	}

	/* Test optional argument with single dash */
	{
		static const struct option long_options[] = {
			{"config", optional_argument, NULL, 'c'}, {0, 0, 0, 0}};
		static const char *const argv[] = {"cmd", "-config=myconfig.txt", NULL};
		int argc = ARRAY_SIZE(argv) - 1;
		int opt;

		optind = 1;
		opt = getopt_long_only(argc, (GETOPT_ARGV_CAST)argv, "c::", long_options, NULL);
		zexpect_equal('c', opt);
		zexpect_str_equal("myconfig.txt", optarg);
	}

	/* Test unknown option returns '?' */
	{
		static const struct option long_options[] = {{"verbose", no_argument, NULL, 'v'},
							     {0, 0, 0, 0}};
		static const char *const argv[] = {"cmd", "-unknown", NULL};
		int argc = ARRAY_SIZE(argv) - 1;
		int opt;

		optind = 1;
		opt = getopt_long_only(argc, (GETOPT_ARGV_CAST)argv, "v", long_options, NULL);
		zexpect_equal('?', opt, "unknown option should return '?'");
	}

	/* Test missing required argument */
	{
		static const struct option long_options[] = {{"file", required_argument, NULL, 'f'},
							     {0, 0, 0, 0}};
		static const char *const argv[] = {"cmd", "-file", NULL};
		int argc = ARRAY_SIZE(argv) - 1;
		int opt;

		optind = 1;
		opt = getopt_long_only(argc, (GETOPT_ARGV_CAST)argv, "f:", long_options, NULL);
		zexpect_equal('?', opt, "missing argument should return '?'");
	}

	/* Test colon prefix for different error reporting */
	{
		static const struct option long_options[] = {{"file", required_argument, NULL, 'f'},
							     {0, 0, 0, 0}};
		static const char *const argv[] = {"cmd", "-file", NULL};
		int argc = ARRAY_SIZE(argv) - 1;
		int opt;

		optind = 1;
		opt = getopt_long_only(argc, (GETOPT_ARGV_CAST)argv, ":f:", long_options, NULL);
		zexpect_equal(':', opt, "with ':' prefix should return ':' for missing argument");
	}

	/* Test '--' terminates option processing */
	{
		static const struct option long_options[] = {{"verbose", no_argument, NULL, 'v'},
							     {0, 0, 0, 0}};
		static const char *const argv[] = {"cmd",      "-verbose", "--",
						   "-verbose", "file",     NULL};
		int argc = ARRAY_SIZE(argv) - 1;
		int opt;
		int v_count = 0;

		optind = 1;
		loop_iter = 0;
		while ((opt = getopt_long_only(argc, (GETOPT_ARGV_CAST)argv, "v", long_options,
					       NULL)) != -1) {
			zassert_true(loop_iter < TEST_MAX_LOOP_ITER);
			loop_iter++;

			if (opt == 'v') {
				v_count++;
			}
		}

		zexpect_equal(1, v_count, "only one -verbose before '--' processed");
		zexpect_equal(3, optind, "optind should point past '--'");
		zexpect_str_equal("-verbose", argv[optind], "after '--' should be operand");
	}

	/* Test multiple options in sequence */
	{
		static const struct option long_options[] = {{"verbose", no_argument, NULL, 'v'},
							     {"file", required_argument, NULL, 'f'},
							     {0, 0, 0, 0}};
		static const char *const argv[] = {"cmd", "-verbose", "-file", "data.txt", NULL};
		int argc = ARRAY_SIZE(argv) - 1;
		int opt;
		int v_count = 0;
		char *f_arg = NULL;

		optind = 1;
		loop_iter = 0;
		while ((opt = getopt_long_only(argc, (GETOPT_ARGV_CAST)argv, "vf:", long_options,
					       NULL)) != -1) {
			zassert_true(loop_iter < TEST_MAX_LOOP_ITER);
			loop_iter++;

			switch (opt) {
			case 'v':
				v_count++;
				break;
			case 'f':
				f_arg = optarg;
				break;
			}
		}

		zexpect_equal(1, v_count);
		zexpect_not_null(f_arg);
		if (f_arg != NULL) {
			zexpect_str_equal("data.txt", f_arg);
		}
	}

	/* Test grouped short options with long options */
	{
		static const struct option long_options[] = {{"verbose", no_argument, NULL, 'v'},
							     {0, 0, 0, 0}};
		static const char *const argv[] = {"cmd", "-ab", "-verbose", NULL};
		int argc = ARRAY_SIZE(argv) - 1;
		int opt;
		int a_count = 0, b_count = 0, v_count = 0;

		optind = 1;
		loop_iter = 0;
		while ((opt = getopt_long_only(argc, (GETOPT_ARGV_CAST)argv, "abv", long_options,
					       NULL)) != -1) {
			zassert_true(loop_iter < TEST_MAX_LOOP_ITER);
			loop_iter++;

			switch (opt) {
			case 'a':
				a_count++;
				break;
			case 'b':
				b_count++;
				break;
			case 'v':
				v_count++;
				break;
			}
		}

		zexpect_equal(1, a_count);
		zexpect_equal(1, b_count);
		zexpect_equal(1, v_count);
	}
}

ZTEST_SUITE(getopt_long, NULL, NULL, NULL, NULL, NULL);
```

## src/getsubopt.c
```c
/*
 * Copyright (c) 2025 Tenstorrent AI ULC
 *
 * SPDX-License-Identifier: Apache-2.0
 */

#include <zephyr/ztest.h>

#include <stdlib.h>

ZTEST(posix_c_lib_ext, test_getsubopt)
{
	char *value;
	char *option;
	char buf[32];

	enum opte {
		RO_OPTION,
		RW_OPTION,
		READ_SIZE_OPTION,
		WRITE_SIZE_OPTION,
		EMBEDDED_EQ_OPTION,
	};

	static const char *const key_list[] = {
		[RO_OPTION] = "ro",
		[RW_OPTION] = "rw",
		[READ_SIZE_OPTION] = "rsize",
		[WRITE_SIZE_OPTION] = "wsize",
		[EMBEDDED_EQ_OPTION] = "equal",
		NULL,
	};

	static const char *const empty_key_list[] = {
		NULL,
	};

	/* empty options string */
	memset(buf, 0, sizeof(buf));
	option = buf;
	value = (char *)0x4242;
	zexpect_equal(-1, getsubopt(&option, (char **)key_list, &value));
	/* empty key list */
	strcpy(buf, "ro,rsize=512,equal=1=2,rw");
	option = buf;
	value = (char *)0x4242;
	zexpect_equal(-1, getsubopt(&option, (char **)empty_key_list, &value));

	strcpy(buf, "ro,rsize=512,equal=1=2,rw");
	option = buf;
	value = (char *)0x4242;
	zexpect_equal(RO_OPTION, getsubopt(&option, (char **)key_list, &value));
	zexpect_equal(option, &buf[strlen("ro,")]);

	zexpect_equal(READ_SIZE_OPTION, getsubopt(&option, (char **)key_list, &value));
	zexpect_equal(option, &buf[strlen("ro,rsize=512,")]);
	zexpect_not_null(value);
	if (value != NULL) {
		zexpect_str_equal(value, "512");
	}

	value = (char *)0x4242;
	zexpect_equal(EMBEDDED_EQ_OPTION, getsubopt(&option, (char **)key_list, &value));
	zexpect_equal(option, &buf[strlen("ro,rsize=512,equal=1=2,")]);
	zexpect_not_null(value);
	if (value != NULL) {
		zexpect_str_equal(value, "1=2");
	}

	value = (char *)0x4242;
	zexpect_equal(RW_OPTION, getsubopt(&option, (char **)key_list, &value));
	zexpect_equal(option, &buf[strlen("ro,rsize=512,equal=1=2,rw")]);

	value = (char *)0x4242;
	zexpect_equal(getsubopt(&option, (char **)key_list, &value), -1);

	strcpy(buf, "oops");
	option = buf;
	value = (char *)0x4242;
	zexpect_equal(getsubopt(&option, (char **)key_list, &value), -1);

	/* some corner cases */
	strcpy(buf, ",rsize=,");
	option = buf;
	value = (char *)0x4242;
	zexpect_equal(-1, getsubopt(&option, (char **)key_list, &value));
	zexpect_equal(option, &buf[strlen(",")]);

	value = (char *)0x4242;
	zexpect_equal(READ_SIZE_OPTION, getsubopt(&option, (char **)key_list, &value));
	zexpect_equal(option, &buf[strlen(",rsize=,")]);
	zexpect_not_null(value);
	if (value != NULL) {
		zexpect_str_equal(value, "");
	}

	/* option without '=' leaves value NULL */
	strcpy(buf, "ro");
	option = buf;
	value = (char *)0x4242;
	zexpect_equal(RO_OPTION, getsubopt(&option, (char **)key_list, &value));
	zexpect_is_null(value);
	zexpect_equal(option, &buf[strlen("ro")]);

	/* prefix of a valid key must not match */
	strcpy(buf, "rost");
	option = buf;
	value = (char *)0x4242;
	zexpect_equal(-1, getsubopt(&option, (char **)key_list, &value));
}
```

## src/stpcpy.c
```c
/*
 * Copyright The Zephyr Project Contributors
 *
 * SPDX-License-Identifier: Apache-2.0
 */

#include <string.h>

#include <zephyr/ztest.h>

ZTEST_USER(posix_c_lib_ext, test_stpcpy)
{
	char buf[16];

	zexpect_equal_ptr(stpcpy(buf, "hello"), &buf[5]);
	zexpect_str_equal(buf, "hello");
}
```

## src/stpncpy.c
```c
/*
 * Copyright The Zephyr Project Contributors
 *
 * SPDX-License-Identifier: Apache-2.0
 */

#include <string.h>

#include <zephyr/ztest.h>

ZTEST_USER(posix_c_lib_ext, test_stpncpy)
{
	/* truncated copy: no terminating NUL within n bytes */
	char short_buf[4];

	memset(short_buf, 'x', sizeof(short_buf));
	zexpect_equal_ptr(stpncpy(short_buf, "abcdef", sizeof(short_buf)),
			  &short_buf[sizeof(short_buf)]);
	zexpect_mem_equal(short_buf, "abc", 3);
}
```

## src/strcasecmp.c
```c
/*
 * Copyright The Zephyr Project Contributors
 *
 * SPDX-License-Identifier: Apache-2.0
 */

#include <strings.h>

#include <zephyr/ztest.h>

ZTEST_USER(posix_c_lib_ext, test_strcasecmp)
{
	zexpect_equal(strcasecmp("Hello", "hello"), 0);
	zexpect_equal(strcasecmp("abc", "abd"), -1);
	zexpect_equal(strcasecmp("abd", "abc"), 1);
	zexpect_true(strcasecmp("abc", "abcdef") < 0);
	zexpect_true(strcasecmp("abcdef", "abc") > 0);
}
```

## src/strdup.c
```c
/*
 * Copyright The Zephyr Project Contributors
 *
 * SPDX-License-Identifier: Apache-2.0
 */

#include <stdlib.h>
#include <string.h>

#include <zephyr/ztest.h>

ZTEST_USER(posix_c_lib_ext, test_strdup)
{
	char *copy = strdup("posix");

	zexpect_not_null(copy);
	if (copy != NULL) {
		zexpect_str_equal(copy, "posix");
		free(copy);
	}
}
```

## src/strfmon.c
```c
/*
 * SPDX-FileCopyrightText: Copyright The Zephyr Project Contributors
 * SPDX-License-Identifier: Apache-2.0
 */

#include <locale.h>
#include <monetary.h>
#include <string.h>

#include <zephyr/sys/util.h>
#include <zephyr/ztest.h>

#define HRULE "------------------------------------------------"

struct test_data {
	int tag;
	char *s;
	size_t maxsize;
	const char *format;
	bool expected_success;
	int expected_errno;
	const char *expected_buffer[3];
};

enum strfmon_tc_enum {
	STRFMON_TC_ESCAPE_PERCENT,
	STRFMON_TC_DEFAULT,
	STRFMON_TC_RIGHT_ALIGN,
	STRFMON_TC_ALIGNED_COLUMNS,
	STRFMON_TC_FILL_CHAR,
	STRFMON_TC_NO_FILL_GROUPING,
	STRFMON_TC_DISABLE_GROUPING,
	STRFMON_TC_ROUND_WHOLE,
	STRFMON_TC_INCREASE_PRECISION,
	STRFMON_TC_ALTERNATE_POS_NEG,
	STRFMON_TC_NO_CURRENCY_SYMBOL,
	STRFMON_TC_LEFT_JUSTIFY,
	STRFMON_TC_RIGHT_JUSTIFY,
};

static const char *const strfmon_tc_desc[] = {
	[STRFMON_TC_ESCAPE_PERCENT] = "Escape percent sign",
	[STRFMON_TC_DEFAULT] = "Default formatting",
	[STRFMON_TC_RIGHT_ALIGN] = "Right align within an 11-character field",
	[STRFMON_TC_ALIGNED_COLUMNS] = "Aligned columns for values up to 99999",
	[STRFMON_TC_FILL_CHAR] = "Specify a fill character",
	[STRFMON_TC_NO_FILL_GROUPING] = "Fill characters do not use grouping",
	[STRFMON_TC_DISABLE_GROUPING] = "Disable the grouping separator",
	[STRFMON_TC_ROUND_WHOLE] = "Round off to whole units",
	[STRFMON_TC_INCREASE_PRECISION] = "Increase the precision",
	[STRFMON_TC_ALTERNATE_POS_NEG] = "Use an alternative pos/neg style",
	[STRFMON_TC_NO_CURRENCY_SYMBOL] = "Disable the currency symbol",
	[STRFMON_TC_LEFT_JUSTIFY] = "Left-justify the output",
	[STRFMON_TC_RIGHT_JUSTIFY] = "Corresponding right-justified output",
};

static const char *const strfmon_tc_fmt[] = {
	/* clang-format off */
	[STRFMON_TC_ESCAPE_PERCENT] = "%%",
	[STRFMON_TC_DEFAULT] = "%n",
	[STRFMON_TC_RIGHT_ALIGN] = "%11n",
	[STRFMON_TC_ALIGNED_COLUMNS] = "%#5n",
	[STRFMON_TC_FILL_CHAR] = "%=*#5n",
	[STRFMON_TC_NO_FILL_GROUPING] = "%=0#5n",
	[STRFMON_TC_DISABLE_GROUPING] = "%^#5n",
	[STRFMON_TC_ROUND_WHOLE] = "%^#5.0n",
	[STRFMON_TC_INCREASE_PRECISION] = "%^#5.4n",
	[STRFMON_TC_ALTERNATE_POS_NEG] = "%(#5n",
	[STRFMON_TC_NO_CURRENCY_SYMBOL] = "%!(#5n",
	[STRFMON_TC_LEFT_JUSTIFY] = "%-14#5.4n",
	[STRFMON_TC_RIGHT_JUSTIFY] = "%14#5.4n",
	/* clang-format on */
};

#define STRFMON_TC_ERR_DECL(_buf, _bufsize, _fmt, _err)                                            \
	{                                                                                          \
		.tag = -1, .s = _buf, .maxsize = _bufsize, .format = _fmt,                         \
		.expected_success = false, .expected_errno = _err,                                 \
		.expected_buffer = {                                                               \
			NULL,                                                                      \
			NULL,                                                                      \
			NULL,                                                                      \
		},                                                                                 \
	}

#define STRFMON_TC_OK_DECL(_tag, a, b, c)                                                          \
	{                                                                                          \
		.tag = STRFMON_TC_##_tag, .s = buffer, .maxsize = sizeof(buffer),                  \
		.format = strfmon_tc_fmt[STRFMON_TC_##_tag], .expected_success = true,             \
		.expected_errno = 0,                                                               \
		.expected_buffer = {                                                               \
			a,                                                                         \
			b,                                                                         \
			c,                                                                         \
		},                                                                                 \
	}

/* oversized to accomodate coverage tests using native libc's strfmon() */
static ZTEST_BMEM char buffer[64];
static const double input[] = {
	123.45,
	-123.45,
	3456.781,
};

static const struct test_data data[] = {
	/* expected failures - commented lines will cause e.g. glibc to segfault */

	/* STRFMON_TC_ERR_DECL(NULL, 0, NULL, EINVAL), */
	STRFMON_TC_ERR_DECL(NULL, 0, "", E2BIG),
	/* STRFMON_TC_ERR_DECL(NULL, sizeof(buffer), NULL, EINVAL), */
	/* STRFMON_TC_ERR_DECL(NULL, sizeof(buffer), "", EINVAL), */
	/* STRFMON_TC_ERR_DECL(buffer, 0, NULL, EINVAL), */
	STRFMON_TC_ERR_DECL(buffer, 0, "", E2BIG),
	/* STRFMON_TC_ERR_DECL(buffer, sizeof(buffer), NULL, EINVAL), */

	STRFMON_TC_ERR_DECL(buffer, 0, "%n", E2BIG),
	STRFMON_TC_ERR_DECL(buffer, sizeof(buffer), "%", EINVAL),

	/* happy path */
	STRFMON_TC_OK_DECL(ESCAPE_PERCENT, "%", "%", "%"),

#if defined(CONFIG_TEST_LOCALE_CHOICE_C)
	STRFMON_TC_OK_DECL(DEFAULT, "123.45", "-123.45", "3456.78"),
	STRFMON_TC_OK_DECL(RIGHT_ALIGN, "     123.45", "    -123.45", "    3456.78"),
	STRFMON_TC_OK_DECL(ALIGNED_COLUMNS, "   123.45", "-  123.45", "  3456.78"),
	STRFMON_TC_OK_DECL(FILL_CHAR, " **123.45", "-**123.45", " *3456.78"),
	STRFMON_TC_OK_DECL(NO_FILL_GROUPING, " 00123.45", "-00123.45", " 03456.78"),
	STRFMON_TC_OK_DECL(DISABLE_GROUPING, "   123.45", "-  123.45", "  3456.78"),
	STRFMON_TC_OK_DECL(ROUND_WHOLE, "   123", "-  123", "  3457"),
	STRFMON_TC_OK_DECL(INCREASE_PRECISION, "   123.4500", "-  123.4500", "  3456.7810"),
	STRFMON_TC_OK_DECL(ALTERNATE_POS_NEG, "   123.45", "(  123.45)", "  3456.78"),
	STRFMON_TC_OK_DECL(NO_CURRENCY_SYMBOL, "   123.45", "(  123.45)", "  3456.78"),
	STRFMON_TC_OK_DECL(LEFT_JUSTIFY, "   123.4500   ", "-  123.4500   ", "  3456.7810   "),
	STRFMON_TC_OK_DECL(RIGHT_JUSTIFY, "      123.4500", "   -  123.4500", "     3456.7810"),
#elif defined(CONFIG_TEST_LOCALE_CHOICE_EN_US_UTF8)
	STRFMON_TC_OK_DECL(DEFAULT, "$123.45", "-$123.45", "$3,456.78"),
	STRFMON_TC_OK_DECL(RIGHT_ALIGN, "    $123.45", "   -$123.45", "  $3,456.78"),
	STRFMON_TC_OK_DECL(ALIGNED_COLUMNS, " $   123.45", "-$   123.45", " $ 3,456.78"),
	STRFMON_TC_OK_DECL(FILL_CHAR, " $***123.45", "-$***123.45", " $*3,456.78"),
	STRFMON_TC_OK_DECL(NO_FILL_GROUPING, " $000123.45", "-$000123.45", " $03,456.78"),
	STRFMON_TC_OK_DECL(DISABLE_GROUPING, " $  123.45", "-$  123.45", " $ 3456.78"),
	STRFMON_TC_OK_DECL(ROUND_WHOLE, " $  123", "-$  123", " $ 3457"),
	STRFMON_TC_OK_DECL(INCREASE_PRECISION, " $  123.4500", "-$  123.4500", " $ 3456.7810"),
	STRFMON_TC_OK_DECL(ALTERNATE_POS_NEG, " $   123.45", "($   123.45)", " $ 3,456.78"),
	STRFMON_TC_OK_DECL(NO_CURRENCY_SYMBOL, "    123.45", "(   123.45)", "  3,456.78"),
	STRFMON_TC_OK_DECL(LEFT_JUSTIFY, " $   123.4500 ", "-$   123.4500 ", " $ 3,456.7810 "),
	STRFMON_TC_OK_DECL(RIGHT_JUSTIFY, "  $   123.4500", " -$   123.4500", "  $ 3,456.7810"),
#endif
};

ZTEST_USER(posix_c_lib_ext, test_strfmon)
{
	TC_PRINT("%.*s\nSetting locale to %s\n%.*s\n",
		 (int)strlen("Setting locale to ") + (int)strlen(CONFIG_TEST_LOCALE_STR), HRULE,
		 CONFIG_TEST_LOCALE_STR,
		 (int)strlen("Setting locale to ") + (int)strlen(CONFIG_TEST_LOCALE_STR), HRULE);

	setlocale(LC_ALL, CONFIG_TEST_LOCALE_STR);

	ARRAY_FOR_EACH(data, j) {
		const struct test_data *const dat = &data[j];

		if (dat->tag != -1) {
			const char *const desc = strfmon_tc_desc[dat->tag];
			int desc_len = (int)strlen(desc);

			TC_PRINT("%.*s\n%s\n%.*s\n", desc_len, HRULE, desc, desc_len, HRULE);
		}

		ARRAY_FOR_EACH(input, i) {
			errno = 0;
			memset(buffer, 0, sizeof(buffer));

			ssize_t ret = strfmon(dat->s, dat->maxsize, dat->format, input[i]);
			bool success = ret == -1 ? false : true;

			zexpect_equal(success, dat->expected_success,
				      "[%zu] strfmon(%p, %zu, \"%s\") expected: %s actual: %s", j,
				      dat->s, dat->maxsize, dat->format,
				      dat->expected_success ? "success" : "failure",
				      success ? "success" : "failure");

			zexpect_equal(errno, dat->expected_errno,
				      "[%zu] strfmon errno %d (%s), expected %d (%s)", j, errno,
				      strerror(errno), dat->expected_errno,
				      strerror(dat->expected_errno));

			if (!dat->expected_success) {
				break;
			}

			zexpect_equal(ret, strlen(dat->expected_buffer[i]),
				      "[%zu] strfmon(%p, %zu, \"%s\") return %zd, expected %zu", j,
				      dat->s, dat->maxsize, dat->format, ret,
				      strlen(dat->expected_buffer[i]));

			zexpect_str_equal(
				buffer, dat->expected_buffer[i],
				"[%zu] strfmon(%p, %zu, \"%s\") output '%s', expected '%s'", j,
				dat->s, dat->maxsize, dat->format, buffer, dat->expected_buffer[i]);
		}
	}
}
```

## src/strncasecmp.c
```c
/*
 * Copyright The Zephyr Project Contributors
 *
 * SPDX-License-Identifier: Apache-2.0
 */

#include <strings.h>

#include <zephyr/ztest.h>

ZTEST_USER(posix_c_lib_ext, test_strncasecmp)
{
	zexpect_equal(strncasecmp("Hello", "hello", 5), 0);
	zexpect_equal(strncasecmp("abc", "abd", 2), 0);
	zexpect_equal(strncasecmp("abc", "abd", 3), -1);
	zexpect_true(strncasecmp("ab", "abc", 3) < 0);
	zexpect_true(strncasecmp("abc", "ab", 3) > 0);
}
```

## src/strndup.c
```c
/*
 * Copyright The Zephyr Project Contributors
 *
 * SPDX-License-Identifier: Apache-2.0
 */

#include <stdlib.h>
#include <string.h>

#include <zephyr/ztest.h>

ZTEST_USER(posix_c_lib_ext, test_strndup)
{
	char *copy = strndup("posix-next", 7);

	zexpect_not_null(copy);
	if (copy != NULL) {
		zexpect_str_equal(copy, "posix-n");
		free(copy);
	}

	copy = strndup("hello", 4);
	zexpect_not_null(copy);
	if (copy != NULL) {
		zexpect_str_equal(copy, "hell");
		free(copy);
	}

	copy = strndup("posix", 8);
	zexpect_not_null(copy);
	if (copy != NULL) {
		zexpect_str_equal(copy, "posix");
		free(copy);
	}

	copy = strndup("abc", 0);
	zexpect_not_null(copy);
	if (copy != NULL) {
		zexpect_str_equal(copy, "");
		free(copy);
	}
}
```
