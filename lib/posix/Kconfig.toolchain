## lib/posix/Kconfig.toolchain
```kconfig
# Copyright (c) The Zephyr Project Contributors
#
# SPDX-License-Identifier: Apache-2.0

# Toolchain override symbols (CONFIG_TC_PROVIDES_*) tell Zephyr not to build its own
# implementation when the C library (or some external source) already provides the feature.
#
# Policy:
#
# TC_PROVIDES_* Kconfig options may be provided for
#
# - Subprofiling Option Groups (IEEE Std 1003.1 V4_subprofiles)
# - Option-Group-like Options (that gate one or more functions and are semi-independent)
# - POSIX-adjacent options (such as eventfd, or the non-portable APIs)
#
# https://pubs.opengroup.org/onlinepubs/9799919799/xrat/V4_subprofiles.html

# ---------------------------------------------------------------------------
# POSIX-adjacent (not a POSIX Option Group)
# ---------------------------------------------------------------------------

# zephyr-keep-sorted-start
config TC_PROVIDES_EVENTFD
	bool

config TC_PROVIDES_POSIX_NON_PORTABLE
	bool
# zephyr-keep-sorted-stop

# ---------------------------------------------------------------------------
# Quasi–Option Group POSIX Options (TC_PROVIDES allowed)
# ---------------------------------------------------------------------------

# zephyr-keep-sorted-start
config TC_PROVIDES_POSIX_FSYNC
	bool

config TC_PROVIDES_POSIX_MEMLOCK
	bool

config TC_PROVIDES_POSIX_MEMLOCK_RANGE
	bool

config TC_PROVIDES_POSIX_MESSAGE_PASSING
	bool

config TC_PROVIDES_POSIX_PRIORITY_SCHEDULING
	bool

config TC_PROVIDES_POSIX_SHARED_MEMORY_OBJECTS
	bool

config TC_PROVIDES_POSIX_SYNCHRONIZED_IO
	bool
# zephyr-keep-sorted-stop

# ---------------------------------------------------------------------------
# Subprofiling Option Groups
# ---------------------------------------------------------------------------

# zephyr-keep-sorted-start
config TC_PROVIDES_POSIX_ASYNCHRONOUS_IO
	bool

config TC_PROVIDES_POSIX_BARRIERS
	bool

config TC_PROVIDES_POSIX_C_LANG_JUMP
	bool

config TC_PROVIDES_POSIX_C_LANG_MATH
	bool

config TC_PROVIDES_POSIX_C_LANG_SUPPORT
	bool

config TC_PROVIDES_POSIX_C_LANG_SUPPORT_R
	bool

config TC_PROVIDES_POSIX_C_LANG_WIDE_CHAR
	bool

config TC_PROVIDES_POSIX_C_LANG_WIDE_CHAR_EXT
	bool

config TC_PROVIDES_POSIX_C_LIB_EXT
	bool

config TC_PROVIDES_POSIX_CLOCK_SELECTION
	bool

config TC_PROVIDES_POSIX_DEVICE_IO
	bool

config TC_PROVIDES_POSIX_DEVICE_IO_EXT
	bool

config TC_PROVIDES_POSIX_DEVICE_SPECIFIC
	bool

config TC_PROVIDES_POSIX_DEVICE_SPECIFIC_R
	bool

config TC_PROVIDES_POSIX_DYNAMIC_LINKING
	bool

config TC_PROVIDES_POSIX_FD_MGMT
	bool

config TC_PROVIDES_POSIX_FIFO
	bool

config TC_PROVIDES_POSIX_FIFO_FD
	bool

config TC_PROVIDES_POSIX_FILE_ATTRIBUTES
	bool

config TC_PROVIDES_POSIX_FILE_ATTRIBUTES_FD
	bool

config TC_PROVIDES_POSIX_FILE_LOCKING
	bool

config TC_PROVIDES_POSIX_FILE_SYSTEM
	bool

config TC_PROVIDES_POSIX_FILE_SYSTEM_EXT
	bool

config TC_PROVIDES_POSIX_FILE_SYSTEM_FD
	bool

config TC_PROVIDES_POSIX_FILE_SYSTEM_GLOB
	bool

config TC_PROVIDES_POSIX_FILE_SYSTEM_R
	bool

config TC_PROVIDES_POSIX_I18N
	bool

config TC_PROVIDES_POSIX_JOB_CONTROL
	bool

config TC_PROVIDES_POSIX_MAPPED_FILES
	bool

config TC_PROVIDES_POSIX_MEMORY_PROTECTION
	bool

config TC_PROVIDES_POSIX_MULTI_CONCURRENT_LOCALES
	bool

config TC_PROVIDES_POSIX_MULTI_PROCESS
	bool

config TC_PROVIDES_POSIX_MULTI_PROCESS_FD
	bool

config TC_PROVIDES_POSIX_NETWORKING
	bool

config TC_PROVIDES_POSIX_PIPE
	bool

config TC_PROVIDES_POSIX_REALTIME_SIGNALS
	bool

config TC_PROVIDES_POSIX_REGEXP
	bool

config TC_PROVIDES_POSIX_ROBUST_MUTEXES
	bool

config TC_PROVIDES_POSIX_RW_LOCKS
	bool

config TC_PROVIDES_POSIX_SEMAPHORES
	bool

config TC_PROVIDES_POSIX_SHELL_FUNC
	bool

config TC_PROVIDES_POSIX_SIGNAL_JUMP
	bool

config TC_PROVIDES_POSIX_SIGNALS
	bool

config TC_PROVIDES_POSIX_SIGNALS_EXT
	bool

config TC_PROVIDES_POSIX_SINGLE_PROCESS
	bool

config TC_PROVIDES_POSIX_SPIN_LOCKS
	bool

config TC_PROVIDES_POSIX_SYMBOLIC_LINKS
	bool

config TC_PROVIDES_POSIX_SYMBOLIC_LINKS_FD
	bool

config TC_PROVIDES_POSIX_SYSTEM_DATABASE
	bool

config TC_PROVIDES_POSIX_SYSTEM_DATABASE_R
	bool

# Note: the Option is _POSIX_THREADS, while the Option Group is POSIX_THREADS_BASE.
# We have opted to use POSIX_THREADS here to match the Option name.
config TC_PROVIDES_POSIX_THREADS
	bool

config TC_PROVIDES_POSIX_THREADS_EXT
	bool

config TC_PROVIDES_POSIX_TIMERS
	bool

config TC_PROVIDES_POSIX_USER_GROUPS
	bool

config TC_PROVIDES_POSIX_USER_GROUPS_R
	bool

config TC_PROVIDES_POSIX_WIDE_CHAR_DEVICE_IO
	bool

config TC_PROVIDES_XSI_C_LANG_SUPPORT
	bool

config TC_PROVIDES_XSI_DBM
	bool

config TC_PROVIDES_XSI_DEVICE_IO
	bool

config TC_PROVIDES_XSI_DEVICE_SPECIFIC
	bool

config TC_PROVIDES_XSI_FILE_SYSTEM
	bool

config TC_PROVIDES_XSI_IPC
	bool

config TC_PROVIDES_XSI_JUMP
	bool

config TC_PROVIDES_XSI_MATH
	bool

config TC_PROVIDES_XSI_MULTI_PROCESS
	bool

config TC_PROVIDES_XSI_REALTIME
	bool

config TC_PROVIDES_XSI_SIGNALS
	bool

config TC_PROVIDES_XSI_SINGLE_PROCESS
	bool

config TC_PROVIDES_XSI_STREAMS
	bool

config TC_PROVIDES_XSI_SYSTEM_DATABASE
	bool

config TC_PROVIDES_XSI_SYSTEM_LOGGING
	bool

config TC_PROVIDES_XSI_THREADS_EXT
	bool

config TC_PROVIDES_XSI_TIMERS
	bool

config TC_PROVIDES_XSI_USER_GROUPS
	bool

config TC_PROVIDES_XSI_WIDE_CHAR
	bool
# zephyr-keep-sorted-stop
```

## lib/posix/c_lang_support_r/Kconfig
```kconfig
# Copyright (c) 2024 Tenstorrent AI ULC
# Copyright (c) 2024 Meta Platforms
#
# SPDX-License-Identifier: Apache-2.0

config POSIX_C_LANG_SUPPORT_R
	bool "Thread-Safe General ISO C Library"
	select HEAP_SORT
	imply MINIMAL_LIBC_STRING_ERROR_TABLE
	help
	  Select 'y' here and Zephyr will provide an implementation of the POSIX_C_LANG_SUPPORT_R
	  Option Group, consisting of asctime_r(), ctime_r(), gmtime_r(), localtime_r(), qsort_r(),
	  rand_r(), strerror_r(), and strtok_r()
```

## lib/posix/c_lib_ext/Kconfig
```kconfig
# Copyright (c) 2024 Tenstorrent AI ULC
#
# SPDX-License-Identifier: Apache-2.0

menu "POSIX C Library Extensions"

config POSIX_C_LIB_EXT
	bool "POSIX general C library extension"
	help
	  Select 'y' here to enable support for the POSIX_C_LIB_EXT Option, consisting of fnmatch(),
	  getopt(), getsubopt(), optarg, opterr, optind, optopt, stpcpy(), stpncpy(), strcasecmp(),
	  strdup(), strfmon(), and strncasecmp(), strndup(), and strnlen().

	  For more information, please see
	  https://pubs.opengroup.org/onlinepubs/9699919799/xrat/V4_subprofiles.html

config ZEPHYR_GETOPT
	bool "Support for zephyr_getopt()"
	# defaults to 'y' when not provided by the toolchain, our getopt(), getopt_long(),
	# getopt_long_only(), depend on zephyr_getopt()
	default y if POSIX_C_LIB_EXT && !TC_PROVIDES_POSIX_C_LIB_EXT
	help
	  Say 'y' here to support zephyr_getopt(), a reentrant function that supports short and long options.

if ZEPHYR_GETOPT

config ZEPHYR_GETOPT_LONG
	bool "Support for long options in zephyr_getopt()"
	default y
	help
	  Say 'y' here to support long options, such as "--option <value>", "--option=<value>", and
	  "-option <value>" with zephyr_getopt().

	  When this option is disabled, the longopts, longindex, and longonly arguments passed to
	  zephyr_getopt() have no affect.

module = GETOPT
module-str = getopt
source "subsys/logging/Kconfig.template.log_config"

endif

endmenu
```

## lib/posix/eventfd/Kconfig
```kconfig
# Copyright (c) 2020 Tobias Svehagen
# Copyright (c) 2023 Meta
#
# SPDX-License-Identifier: Apache-2.0

config EVENTFD
	bool "Support for eventfd"
	select ZVFS if !TC_PROVIDES_EVENTFD
	select ZVFS_EVENTFD if !TC_PROVIDES_EVENTFD
	help
	  Enable support for event file descriptors, eventfd. An eventfd can
	  be used as an event wait/notify mechanism together with POSIX calls
	  like read, write and poll.
```

## lib/posix/fsync/Kconfig
```kconfig
# Copyright (c) 2024 Tenstorrent AI ULC
#
# SPDX-License-Identifier: Apache-2.0

config POSIX_FSYNC
	bool "Support for fsync()"
	help
	  Select 'y' here and Zephyr will provide an implementation of fsync().

if POSIX_FSYNC

# These options are intended to be used for compatibility with external POSIX
# implementations such as those in Newlib or Picolibc.

config POSIX_FILE_SYSTEM_ALIAS_FSYNC
	bool
	help
	  Select 'y' here and Zephyr will provide an alias for fsync() as _fsync().

endif # POSIX_FSYNC
```

## lib/posix/memlock_range/Kconfig
```kconfig
# Copyright (c) 2024 BayLibre SAS
#
# SPDX-License-Identifier: Apache-2.0

config POSIX_MEMLOCK_RANGE
	bool "POSIX range memory locking"
	depends on POSIX_MAPPED_FILES
	imply DEMAND_PAGING
	help
	  Select 'y' here and Zephyr will provide support for mlock() and munlock().

	  Note: This feature depends on hardware MMU support. If the underlying platform does not
	  support an MMU, then affected POSIX API functions will return -1 and set errno to ENOTSUP.
```

## lib/posix/options/Kconfig
```kconfig
# Copyright (c) 2018 Intel Corporation
# Copyright (c) 2023 Meta
# Copyright (c) 2024 Tenstorrent AI ULC
#
# SPDX-License-Identifier: Apache-2.0

# zephyr-keep-sorted-start
rsource "asynchronous_io/Kconfig"
rsource "barriers/Kconfig"
rsource "clock_selection/Kconfig"
rsource "device_io/Kconfig"
rsource "fd_mgmt/Kconfig"
rsource "file_locking/Kconfig"
rsource "file_system/Kconfig"
rsource "file_system_r/Kconfig"
rsource "fsync/Kconfig"
rsource "mapped_files/Kconfig"
rsource "memlock/Kconfig"
rsource "memlock_range/Kconfig"
rsource "memory_protection/Kconfig"
rsource "message_passing/Kconfig"
rsource "multi_process/Kconfig"
rsource "networking/Kconfig"
rsource "non_portable/Kconfig"
rsource "signals_ext/Kconfig"
rsource "priority_scheduling/Kconfig"
rsource "thread_priority_scheduling/Kconfig"
rsource "rw_locks/Kconfig"
rsource "semaphores/Kconfig"
rsource "shared_memory_objects/Kconfig"
rsource "signals/Kconfig"
rsource "single_process/Kconfig"
rsource "spin_locks/Kconfig"
rsource "synchronized_io/Kconfig"
rsource "threads_base/Kconfig"
rsource "threads_ext/Kconfig"
rsource "timers/Kconfig"
# zephyr-keep-sorted-stop

menu "X/Open system interfaces"
# zephyr-keep-sorted-start
rsource "xsi/Kconfig"
rsource "xsi_advanced_realtime/Kconfig"
rsource "xsi_advanced_realtime_threads/Kconfig"
rsource "xsi_realtime/Kconfig"
rsource "xsi_realtime_threads/Kconfig"
rsource "xsi_single_process/Kconfig"
rsource "xsi_streams/Kconfig"
rsource "xsi_system_logging/Kconfig"
rsource "xsi_threads_ext/Kconfig"
# zephyr-keep-sorted-stop

endmenu # "X/Open system interfaces"
```

## lib/posix/options/Kconfig.pipe
```kconfig
# Copyright (c) 2025 Atym, Inc.
#
# SPDX-License-Identifier: Apache-2.0

menuconfig POSIX_PIPE
	bool "POSIX pipe system API support"
	default y if POSIX_API
	select FDTABLE
	help
	  This enables POSIX style pipe API.

if POSIX_PIPE

config POSIX_PIPE_BUF
    int "PIPE_BUF size"
	default 64
	help
	  Number of bytes in each POSIX pipe ring buffer. PIPE_BUF is defined from this.

endif # POSIX_PIPE
```

## lib/posix/options/Kconfig.signal
```kconfig
# Copyright (c) 2023 Meta
#
# SPDX-License-Identifier: Apache-2.0

menu "POSIX signals"

config POSIX_REALTIME_SIGNALS
	bool "POSIX realtime signals"
	help
	  Enable support for POSIX realtime signals.

if POSIX_REALTIME_SIGNALS

config CONFIG_SIGNAL_QUEUE_SIZE_ADD_POSIX_REALTIME
	def_int 32
	help
	  This value represents the maximum number of signals that a process may send or have pending
	  at any given time, according to the POSIX specification (see SIGQUEUE_MAX and
	  _POSIX_SIGQUEUE_MAX limits.h).

config POSIX_RTSIG_MAX
	int "Maximum number of realtime signals"
	default 8
	help
	  Define the maximum number of realtime signals (RTSIG_MAX).
	  The range of realtime signals is [SIGRTMIN .. (SIGRTMIN+RTSIG_MAX)]

# it would be much better to use arithmetic + variables here but it does not work
config SIGNAL_SET_SIZE_MIN_POSIX_REALTIME
	def_int 40
	help
	  This number of signals required for POSIX real-time extensions.
	  
	  When enabled, this option ensures the value of SIGNAL_SET_SIZE is at least
	  CONFIG_THREAD_CANCEL_SIGNAL_NUMBER + CONFIG_POSIX_RTSIG_MAX, or in
	  other terms [SIGRTMIN .. (SIGRTMIN+RTSIG_MAX)].

endif # POSIX_REALTIME_SIGNALS

config POSIX_SIGNALS
	bool "POSIX signals"
	select POSIX_MULTI_PROCESS
	help
	  Enable support for POSIX signals.

if POSIX_SIGNALS

config SIGNAL_SET_SIZE_MIN_POSIX_REALTIME
	def_int 32
	help
	  This number of signals required for POSIX conformance.
	  
	  When enabled, this option ensures the value of SIGNAL_SET_SIZE is at least
	  32.

config POSIX_SIGNAL_STRING_DESC
	bool "Use full description for the strsignal API"
	default y
	help
	  Use full description for the strsignal API.
	  Will use 256 bytes of ROM.

# These options are intended to be used for compatibility with external POSIX
# implementations such as those in Newlib or Picolibc.

config POSIX_SIGNALS_ALIAS_KILL
	bool

endif

endmenu # "Signal support"
```

## lib/posix/options/clock_selection/Kconfig
```kconfig
# Copyright (c) 2018 Intel Corporation
# Copyright (c) 2024 Tenstorrent AI ULC
#
# SPDX-License-Identifier: Apache-2.0

config POSIX_CLOCK_SELECTION
	bool "POSIX Clock selection"
	depends on POSIX_TIMERS
	help
	  This enables POSIX clock selection.
```

## lib/posix/options/device_io/Kconfig
```kconfig
# Copyright (c) 2024 Tenstorrent AI ULC
#
# SPDX-License-Identifier: Apache-2.0

menu "POSIX device I/O"

config POSIX_DEVICE_IO
	bool "POSIX device I/O"
	select ZVFS
	select ZVFS_POLL
	select ZVFS_SELECT
	help
	  Select 'y' here and Zephyr will provide an implementation of the POSIX_DEVICE_IO Option
	  Group such as FD_CLR(), FD_ISSET(), FD_SET(), FD_ZERO(), close(), fdopen(), fileno(), open(),
	  poll(), pread(), pselect(), pwrite(), read(), select(), and write().

if POSIX_DEVICE_IO

# These options are intended to be used for compatibility with external POSIX
# implementations such as those in Newlib or Picolibc.

config POSIX_DEVICE_IO_ALIAS_CLOSE
	bool
	help
	  When selected via Kconfig, Zephyr will provide an alias for close() as _close().

config POSIX_DEVICE_IO_ALIAS_FDOPEN
	bool
	help
	  When selected via Kconfig, Zephyr will provide an alias for fdopen() as _fdopen().

config POSIX_DEVICE_IO_ALIAS_FILENO
	bool
	help
	  When selected via Kconfig, Zephyr will provide an alias for fileno() as _fileno().

config POSIX_DEVICE_IO_ALIAS_OPEN
	bool
	help
	  When selected via Kconfig, Zephyr will provide an alias for open() as _open().

config POSIX_DEVICE_IO_ALIAS_READ
	bool
	help
	  When selected via Kconfig, Zephyr will provide an alias for read() as _read().

config POSIX_DEVICE_IO_ALIAS_WRITE
	bool
	help
	  When selected via Kconfig, Zephyr will provide an alias for write() as _write().

endif # POSIX_DEVICE_IO

config POSIX_OPEN_MAX
	int
	default ZVFS_OPEN_ADD_SIZE_STDIO
	help
	  The maximum number of files that a process can have open at one time. This option is not
	  directly user-configurable but can be adjusted via CONFIG_POSIX_OPEN_MAX.

endmenu
```
