## tests/posix/signals/testcase.yaml
```yaml
common:
  filter: not CONFIG_NATIVE_LIBC
  tags:
    - posix_signals
  # 1 tier0 platform per supported architecture
  platform_key:
    - arch
    - simulation
  min_flash: 64
  min_ram: 32
  # Exclude qemu_arc/qemu_arc_hs5x for now because of qemu_arc issue
  # qemu-system-arc: /usr/src/debug/nativesdk-qemu-arc/git/target/arc/decoder-v2.c:266:
  #   arc_find_format_v2: Assertion `mcount != 0' failed.
  # Aborted (core dumped)
  platform_exclude:
    - qemu_arc/qemu_arc_hs5x
tests:
  portability.posix.signals:
    integration_platforms:
      - qemu_riscv64
  portability.posix.signals.minimal:
    integration_platforms:
      - qemu_riscv64
    extra_configs:
      - CONFIG_MINIMAL_LIBC=y
  portability.posix.signals.newlib:
    integration_platforms:
      - qemu_riscv64
    filter: TOOLCHAIN_HAS_NEWLIB == 1
    extra_configs:
      - CONFIG_NEWLIB_LIBC=y
  portability.posix.signals.picolibc:
    integration_platforms:
      - qemu_riscv64
    tags: picolibc
    filter: CONFIG_PICOLIBC_SUPPORTED
    extra_configs:
      - CONFIG_PICOLIBC=y
  portability.posix.signals.big_nsig:
    # Large SIGNAL_SET_SIZE grows k_sig_ctx and pushes callee_saved past the
    # ARM64 stp/ldp immediate offset limit in arch/arm64/core/switch.S.
    platform_allow:
      - qemu_riscv64
    integration_platforms:
      - qemu_riscv64
    extra_configs:
      - CONFIG_POSIX_RTSIG_MAX=1024
      - CONFIG_SIGNAL_SET_SIZE=1058
  portability.posix.signals.linux_compat:
    tags: native
    filter: CONFIG_NATIVE_LIBC
    extra_configs:
      - CONFIG_POSIX_TEST_LINUX_COMPAT=y
```

## tests/posix/signals_ext/testcase.yaml
```yaml
common:
  tags:
    - posix
    - posix_signals_ext
  # 1 tier0 platform per supported architecture
  platform_key:
    - arch
    - simulation
tests:
  portability.posix.signals_ext:
    filter: not CONFIG_NATIVE_LIBC
    extra_configs:
      - CONFIG_POSIX_AEP_CHOICE_BASE=y
  portability.posix.signals_ext.minimal:
    filter: not CONFIG_NATIVE_LIBC
    extra_configs:
      - CONFIG_POSIX_AEP_CHOICE_BASE=y
      - CONFIG_MINIMAL_LIBC=y
  portability.posix.signals_ext.minimal.strsignal_no_desc:
    filter: not CONFIG_NATIVE_LIBC
    extra_configs:
      - CONFIG_POSIX_AEP_CHOICE_BASE=y
      - CONFIG_MINIMAL_LIBC=y
      - CONFIG_POSIX_SIGNAL_STRING_DESC_DISABLE=y
  portability.posix.signals_ext.newlib:
    filter: (not CONFIG_NATIVE_LIBC) and (TOOLCHAIN_HAS_NEWLIB == 1)
    extra_configs:
      - CONFIG_POSIX_AEP_CHOICE_BASE=y
      - CONFIG_NEWLIB_LIBC=y
  portability.posix.signals_ext.picolibc:
    tags: picolibc
    filter: (not CONFIG_NATIVE_LIBC) and CONFIG_PICOLIBC_SUPPORTED
    extra_configs:
      - CONFIG_POSIX_AEP_CHOICE_BASE=y
      - CONFIG_PICOLIBC=y
  portability.posix.signals_ext.linux_compat:
    tags: native
    filter: CONFIG_NATIVE_LIBC
    extra_configs:
      - CONFIG_POSIX_TEST_LINUX_COMPAT=y
      - CONFIG_ZVFS_OPEN_MAX=7
```

## tests/posix/single_process/testcase.yaml
```yaml
common:
  tags:
    - posix_single_process
  # 1 tier0 platform per supported architecture
  platform_key:
    - arch
    - simulation
  min_flash: 64
  min_ram: 32
tests:
  portability.posix.single_process:
    filter: not CONFIG_NATIVE_LIBC
  portability.posix.single_process.armclang_std_libc:
    toolchain_allow: armclang
    extra_configs:
      - CONFIG_ARMCLANG_STD_LIBC=y
  portability.posix.single_process.arcmwdtlib:
    toolchain_allow: arcmwdt
    extra_configs:
      - CONFIG_ARCMWDT_LIBC=y
  portability.posix.single_process.minimal:
    filter: not CONFIG_NATIVE_LIBC
    extra_configs:
      - CONFIG_MINIMAL_LIBC=y
      - CONFIG_COMMON_LIBC_MALLOC_ARENA_SIZE=256
  portability.posix.single_process.newlib:
    filter: (not CONFIG_NATIVE_LIBC) and (TOOLCHAIN_HAS_NEWLIB == 1)
    extra_configs:
      - CONFIG_NEWLIB_LIBC=y
  portability.posix.single_process.picolibc:
    tags: picolibc
    filter: (not CONFIG_NATIVE_LIBC) and CONFIG_PICOLIBC_SUPPORTED
    extra_configs:
      - CONFIG_PICOLIBC=y
  portability.posix.single_process.hostname:
    filter: not CONFIG_NATIVE_LIBC
    # This can work for any platform with networking support. It is only exercised on
    # native_sim because it is known to have have networking support.
    platform_allow:
      - native_sim
    integration_platforms:
      - native_sim
    extra_configs:
      - CONFIG_NET_HOSTNAME_ENABLE=y
      - CONFIG_NETWORKING=y
      - CONFIG_COMMON_LIBC_MALLOC_ARENA_SIZE=256
  portability.posix.single_process.linux_compat:
    tags: native
    platform_allow:
      - native_sim
      - native_sim/native/64
    filter: CONFIG_NATIVE_LIBC
    extra_configs:
      - CONFIG_POSIX_TEST_LINUX_COMPAT=y
      - CONFIG_ZVFS_OPEN_MAX=7
      - CONFIG_COMMON_LIBC_MALLOC_ARENA_SIZE=256
```

## tests/posix/system_database/testcase.yaml
```yaml
common:
  tags:
    - posix
    - posix_system_database
  # 1 tier0 platform per supported architecture
  platform_key:
    - arch
    - simulation
  min_flash: 64
  min_ram: 32
tests:
  portability.posix.posix_system_database:
    filter: not CONFIG_NATIVE_LIBC
  portability.posix.posix_system_database.minimal:
    filter: not CONFIG_NATIVE_LIBC
    extra_configs:
      - CONFIG_MINIMAL_LIBC=y
  portability.posix.posix_system_database.newlib:
    filter: (not CONFIG_NATIVE_LIBC) and (TOOLCHAIN_HAS_NEWLIB == 1)
    extra_configs:
      - CONFIG_NEWLIB_LIBC=y
  portability.posix.posix_system_database.picolibc:
    tags: picolibc
    filter: (not CONFIG_NATIVE_LIBC) and CONFIG_PICOLIBC_SUPPORTED
    extra_configs:
      - CONFIG_PICOLIBC=y
  portability.posix.posix_system_database.linux_compat:
    tags: native
    filter: CONFIG_NATIVE_LIBC
    extra_configs:
      - CONFIG_POSIX_TEST_LINUX_COMPAT=y
      - CONFIG_ZVFS_OPEN_MAX=7
```

## tests/posix/system_database_r/testcase.yaml
```yaml
common:
  tags:
    - posix
    - posix_system_database_r
  # 1 tier0 platform per supported architecture
  platform_key:
    - arch
    - simulation
  min_flash: 64
  min_ram: 32
tests:
  portability.posix.posix_system_database_r:
    filter: not CONFIG_NATIVE_LIBC
  portability.posix.posix_system_database_r.minimal:
    filter: not CONFIG_NATIVE_LIBC
    extra_configs:
      - CONFIG_MINIMAL_LIBC=y
  portability.posix.posix_system_database_r.newlib:
    filter: (not CONFIG_NATIVE_LIBC) and (TOOLCHAIN_HAS_NEWLIB == 1)
    extra_configs:
      - CONFIG_NEWLIB_LIBC=y
  portability.posix.posix_system_database_r.picolibc:
    tags: picolibc
    filter: (not CONFIG_NATIVE_LIBC) and CONFIG_PICOLIBC_SUPPORTED
    extra_configs:
      - CONFIG_PICOLIBC=y
  portability.posix.posix_system_database_r.linux_compat:
    tags: native
    filter: CONFIG_NATIVE_LIBC
    extra_configs:
      - CONFIG_POSIX_TEST_LINUX_COMPAT=y
      - CONFIG_ZVFS_OPEN_MAX=7
```

## tests/posix/threads_base/testcase.yaml
```yaml
common:
  tags:
    - posix_threads_base
  min_ram: 64
  timeout: 240
  # 1 tier0 platform per supported architecture
  platform_key:
    - arch
    - simulation
tests:
  portability.posix.threads_base:
    filter: not CONFIG_NATIVE_LIBC
  portability.posix.threads_base.userspace:
    filter: (not CONFIG_NATIVE_LIBC) and CONFIG_ARCH_SUPPORTS_USERSPACE_SIGNALS
    tags: userspace
    extra_configs:
      - CONFIG_TEST_USERSPACE=y
      - CONFIG_USERSPACE=y
  portability.posix.threads_base.minimal:
    filter: not CONFIG_NATIVE_LIBC
    extra_configs:
      - CONFIG_MINIMAL_LIBC=y
  portability.posix.threads_base.newlib:
    platform_exclude:
      - intel_ehl_crb
      - lpcxpresso55s06
    filter: (not CONFIG_NATIVE_LIBC) and (TOOLCHAIN_HAS_NEWLIB == 1)
    extra_configs:
      - CONFIG_NEWLIB_LIBC=y
  portability.posix.threads_base.armclang_std_libc:
    filter: not CONFIG_NATIVE_LIBC
    toolchain_allow: armclang
    extra_configs:
      - CONFIG_ARMCLANG_STD_LIBC=y
  portability.posix.threads_base.arcmwdtlib:
    filter: not CONFIG_NATIVE_LIBC
    toolchain_allow: arcmwdt
    extra_configs:
      - CONFIG_ARCMWDT_LIBC=y
  portability.posix.threads_base.tls:
    platform_exclude:
      - intel_ehl_crb
    filter: (not CONFIG_NATIVE_LIBC) and CONFIG_ARCH_HAS_THREAD_LOCAL_STORAGE and CONFIG_TOOLCHAIN_SUPPORTS_THREAD_LOCAL_STORAGE
    extra_configs:
      - CONFIG_NEWLIB_LIBC=n
      - CONFIG_THREAD_LOCAL_STORAGE=y
  portability.posix.threads_base.tls.newlib:
    platform_exclude:
      - intel_ehl_crb
      - lpcxpresso55s06
    filter: (not CONFIG_NATIVE_LIBC) and (TOOLCHAIN_HAS_NEWLIB == 1) and CONFIG_ARCH_HAS_THREAD_LOCAL_STORAGE and
      CONFIG_TOOLCHAIN_SUPPORTS_THREAD_LOCAL_STORAGE
    extra_configs:
      - CONFIG_NEWLIB_LIBC=y
      - CONFIG_THREAD_LOCAL_STORAGE=y
  portability.posix.threads_base.picolibc:
    tags: picolibc
    filter: (not CONFIG_NATIVE_LIBC) and CONFIG_PICOLIBC_SUPPORTED
    extra_configs:
      - CONFIG_PICOLIBC=y
  portability.posix.threads_base.dynamic_stack:
    filter: not CONFIG_NATIVE_LIBC
    extra_configs:
      - CONFIG_SYS_THREAD_STACK_MIN_ADD_TEST=0
      - CONFIG_SYS_THREAD_THREAD_MIN_ADD_TEST=0
      - CONFIG_HEAP_MEM_POOL_SIZE=16384
  portability.posix.threads_base.linux_compat:
    tags: native
    platform_allow:
      - native_sim
      - native_sim/native/64
    filter: CONFIG_NATIVE_LIBC
    extra_configs:
      - CONFIG_POSIX_TEST_LINUX_COMPAT=y
```

## tests/posix/threads_cancel_cpp/testcase.yaml
```yaml
common:
  tags:
    - posix
    - threads
    - cancel
    - cpp
    - exceptions
  timeout: 10
  # 1 tier0 platform per supported architecture
  platform_key:
    - arch
    - simulation
  integration_platforms:
    - qemu_x86_64
  min_ram: 32
tests:
  posix.threads.cancel.cpp: {}
  posix.threads.cancel.cpp.userspace:
    filter: CONFIG_ARCH_SUPPORTS_USERSPACE_SIGNALS
    tags:
      - userspace
    extra_configs:
      - CONFIG_USERSPACE=y
```

## tests/posix/xsi_advanced_realtime/testcase.yaml
```yaml
common:
  filter: not CONFIG_NATIVE_LIBC
  tags:
    - xsi_advanced_realtime
  platform_key:
    - arch
    - simulation
  min_flash: 64
  min_ram: 32
tests:
  portability.posix.xsi_advanced_realtime: {}
```

## tests/posix/xsi_realtime_threads/testcase.yaml
```yaml
common:
  filter: not CONFIG_NATIVE_LIBC
  tags:
    - xsi_realtime_threads
  platform_key:
    - arch
    - simulation
  min_flash: 64
  min_ram: 32
tests:
  portability.posix.xsi_realtime_threads: {}
```
