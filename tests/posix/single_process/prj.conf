## CMakeLists.txt
```
# SPDX-License-Identifier: Apache-2.0

cmake_minimum_required(VERSION 3.20.0)
find_package(Zephyr REQUIRED HINTS $ENV{ZEPHYR_BASE})
project(posix_single_process)

FILE(GLOB app_sources src/*.c)

target_sources(app PRIVATE ${app_sources})

# For setenv() and unsetenv()
target_compile_options(app PRIVATE -U_POSIX_C_SOURCE -D_POSIX_C_SOURCE=200809L)
# For getenv_r() visibility and testing
if(CONFIG_NATIVE_LIBC)
  target_compile_definitions(app PRIVATE _DEFAULT_SOURCE)
else()
  target_compile_definitions(app PRIVATE _BSD_SOURCE)
endif()

target_include_directories(app PRIVATE ${CMAKE_CURRENT_SOURCE_DIR}/../common)
```

## Kconfig
```
# SPDX-FileCopyrightText: Copyright The Zephyr Project Contributors
# SPDX-License-Identifier: Apache-2.0

rsource "../Kconfig.test_common"

config TEST_POSIX_PROFILE_SUBTRACT
	bool "The chosen subprofile has Option Groups disabled on top of it"
	help
	  Set by the profile_subtract scenario: PSE52 with message passing and asynchronous
	  I/O disabled. The build asserts that the subtracted profile no longer claims PSE51
	  or PSE52 conformance while the base System Interfaces remain claimed.

config TEST_POSIX_PROFILE_PSE54
	bool "The PSE54 subprofile is chosen"
	help
	  Set by the profile_pse54 scenario. The build asserts that the profile claims the
	  PSE51 and PSE52 conformance it inherits and the PSE54 Option Groups it adds.

source "Kconfig.zephyr"
```

## prj.conf
```kconfig
CONFIG_ZTEST=y
CONFIG_POSIX_AEP_CHOICE_BASE=y
CONFIG_POSIX_SINGLE_PROCESS=y

CONFIG_COMMON_LIBC_MALLOC=y
CONFIG_COMMON_LIBC_MALLOC_ARENA_SIZE=256
```

## src/confstr.c
```c
/*
 * Copyright (c) 2024, Meta
 *
 * SPDX-License-Identifier: Apache-2.0
 */

#include <errno.h>
#include <string.h>
#include <unistd.h>

#include <zephyr/ztest.h>
#include <zephyr/sys/util.h>

#include "../../common/linux_compat_test.h"

#if defined(__x86_64__) || defined(__amd64__)
#define EXPECT_LP64_OFF64_CFLAGS     "-m64"
#define EXPECT_LP64_OFF64_LDFLAGS    "-m64"
#define EXPECT_WIDTH_RESTRICTED_ENVS "POSIX_V7_LP64_OFF64"
#elif defined(__aarch64__) || (defined(__riscv) && (__riscv_xlen == 64))
#define EXPECT_LP64_OFF64_CFLAGS     ""
#define EXPECT_LP64_OFF64_LDFLAGS    ""
#define EXPECT_WIDTH_RESTRICTED_ENVS "POSIX_V7_LP64_OFF64"
#else
#define EXPECT_LP64_OFF64_CFLAGS     ""
#define EXPECT_LP64_OFF64_LDFLAGS    ""
#define EXPECT_WIDTH_RESTRICTED_ENVS ""
#endif

#define EXPECT_PATH   "/bin:/usr/bin"
#define EXPECT_V7_ENV "POSIXLY_CORRECT=1"

static void check_confstr_empty(int name)
{
	char buf[8];
	size_t len;

	errno = 0;
	len = confstr(name, NULL, 0);
	zassert_equal(1, len, "name %d", name);
	zassert_equal(0, errno);

	buf[0] = 0xff;
	zassert_equal(1, confstr(name, buf, sizeof(buf)), "name %d", name);
	zassert_equal('\0', buf[0], "name %d", name);
}

static void _check_confstr_value(int name, const char *expected, char *name_str, int line)
{
	char buf[128];
	size_t len;
	size_t expected_len = strlen(expected) + 1;

	errno = 0;
	len = confstr(name, NULL, 0);
	zassert_equal(expected_len, len, "%s:%d: name %s (%d)", __FILE__, line, name_str, name);
	zassert_equal(0, errno);

	memset(buf, 0xff, sizeof(buf));
	zassert_equal(expected_len, confstr(name, buf, sizeof(buf)), "%s:%d: name %s (%d)",
		      __FILE__, line, name_str, name);
	zassert_mem_equal(expected, buf, expected_len, "%s:%d: name %s (%d)", __FILE__, line,
			  name_str, name);
}
#define check_confstr_value(name, expected) _check_confstr_value(name, expected, #name, __LINE__)

static void check_confstr_truncated(int name, const char *expected, size_t buflen)
{
	char buf[128];
	size_t full_len = strlen(expected) + 1;

	memset(buf, 0xff, sizeof(buf));
	zassert_equal(full_len, confstr(name, buf, buflen), "name %d", name);
	zassert_equal(0, strncmp(expected, buf, buflen - 1), "name %d", name);
	zassert_equal('\0', buf[buflen - 1], "name %d", name);
}

ZTEST(posix_single_process, test_confstr)
{
	char buf[64];
	size_t len;

	/* invalid name */
	{
		struct arg {
			int name;
			char *buf;
			size_t buflen;
		};

		const struct arg arg1s[] = {
			{-1, NULL, 0},          {-1, NULL, sizeof(buf)}, {-1, buf, 0},
			{-1, buf, sizeof(buf)}, {9999, NULL, 0},         {9999, buf, sizeof(buf)},
		};

		ARRAY_FOR_EACH_PTR(arg1s, arg) {
			errno = 0;
			zassert_equal(0, confstr(arg->name, arg->buf, arg->buflen));
			zassert_equal(errno, EINVAL);
		}
	}

	IF_NOT_NATIVE_LIBC({
		errno = 0;
		zassert_equal(0, confstr(_CS_V6_ENV + 1, NULL, 0));
		zassert_equal(errno, EINVAL);
	});

	len = confstr(_CS_PATH, NULL, 0);
	zassert_true(len > 0, "confstr(_CS_PATH) returned %zu", len);

	buf[0] = '\0';
	zassert_equal(len, confstr(_CS_PATH, buf, sizeof(buf)));
	zassert_true(strlen(buf) < sizeof(buf));

	errno = 0;
	buf[0] = 0xff;
	zassert_true(confstr(_CS_PATH, buf, 0) > 0);
	zassert_equal(errno, 0);
	zassert_equal((uint8_t)buf[0], 0xff);

	check_confstr_value(_CS_PATH, EXPECT_PATH);
	check_confstr_truncated(_CS_PATH, EXPECT_PATH, 4);

#if (_POSIX_C_SOURCE == 200809L)
#ifndef _CS_V7_ENV
#error "_CS_V7_ENV must be defined for Issue 7"
#endif
#endif

#if defined(_CS_V7_ENV)
	if (!(IS_ENABLED(CONFIG_ARCH_POSIX) || IS_ENABLED(CONFIG_ARCH_X86))) {
		check_confstr_empty(_CS_POSIX_V7_ILP32_OFF32_CFLAGS);
		check_confstr_empty(_CS_POSIX_V7_ILP32_OFFBIG_CFLAGS);
	}
	check_confstr_empty(_CS_POSIX_V7_LPBIG_OFFBIG_CFLAGS);
	check_confstr_empty(_CS_POSIX_V7_LP64_OFF64_LIBS);

	IF_NOT_NATIVE_LIBC({
		/* missing iny glibc */
		check_confstr_empty(_CS_POSIX_V7_THREADS_CFLAGS);
		check_confstr_empty(_CS_POSIX_V7_THREADS_LDFLAGS);
	});

	check_confstr_value(_CS_POSIX_V7_LP64_OFF64_CFLAGS, EXPECT_LP64_OFF64_CFLAGS);
	check_confstr_value(_CS_POSIX_V7_LP64_OFF64_LDFLAGS, EXPECT_LP64_OFF64_LDFLAGS);
	if (!(IS_ENABLED(CONFIG_ARCH_POSIX) || IS_ENABLED(CONFIG_ARCH_X86))) {
		check_confstr_value(_CS_POSIX_V7_WIDTH_RESTRICTED_ENVS,
				    EXPECT_WIDTH_RESTRICTED_ENVS);
	}
	check_confstr_value(_CS_V7_ENV, EXPECT_V7_ENV);
#endif

	check_confstr_value(_CS_POSIX_V6_LP64_OFF64_CFLAGS, EXPECT_LP64_OFF64_CFLAGS);
	check_confstr_value(_CS_POSIX_V6_LP64_OFF64_LDFLAGS, EXPECT_LP64_OFF64_LDFLAGS);
	if (!(IS_ENABLED(CONFIG_ARCH_POSIX) || IS_ENABLED(CONFIG_ARCH_X86))) {
		check_confstr_value(_CS_POSIX_V6_WIDTH_RESTRICTED_ENVS,
				    EXPECT_WIDTH_RESTRICTED_ENVS);
	}

	IF_NOT_NATIVE_LIBC({
		/* missing iny glibc */
		check_confstr_value(_CS_V6_ENV, EXPECT_V7_ENV);
		check_confstr_empty(_CS_POSIX_V6_ILP32_OFF32_CFLAGS);
	});
}
```

## src/env.c
```c
/*
 * Copyright (c) 2023, Meta
 *
 * SPDX-License-Identifier: Apache-2.0
 */

#include <stdio.h>
#include <stdlib.h>

#include <zephyr/ztest.h>

#include "linux_compat_test.h"

#define M_HOME "/home/zephyr"
#define M_UID  "1000"
#define M_PWD  "/tmp"

#define _m_alt_home "/this/path/is/much/longer/than" M_HOME

#define DEFINE_ENVIRON(_handle, _key, _val) char _handle[] = _key "=" _val
#define RESET_ENVIRON(_handle, _key, _val)                                                         \
	snprintf(_handle, ARRAY_SIZE(_handle), "%s=%s", _key, _val)

#if !defined(CONFIG_NATIVE_LIBC)
#if defined(CONFIG_NEWLIB_LIBC) || defined(CONFIG_PICOLIBC)
/* newlib headers seem to be missing this */
int getenv_r(const char *name, char *val, size_t len);
#endif
#endif

extern char **environ;
static char **old_environ;

static DEFINE_ENVIRON(home, "HOME", M_HOME);
static DEFINE_ENVIRON(uid, "UID", M_UID);
static DEFINE_ENVIRON(pwd, "PWD", M_PWD);

static char *environ_for_test[] = {home, uid, pwd, NULL};

ZTEST(posix_single_process, test_getenv)
{
	IF_NOT_NATIVE_LIBC({
		/* avoid glib c non-NULL warnings */
		zassert_equal(getenv(NULL), NULL);
	})
	zassert_equal(getenv(""), NULL);
	zassert_equal(getenv("invalid=key"), NULL);
	zassert_equal(getenv("HOME=" M_HOME), NULL);
	zassert_equal(getenv("PWDR"), NULL);

	zassert_mem_equal(getenv("HOME"), M_HOME, strlen(M_HOME) + 1);
	zassert_mem_equal(getenv("UID"), M_UID, strlen(M_UID) + 1);
	zassert_mem_equal(getenv("PWD"), M_PWD, strlen(M_PWD) + 1);
}

#ifndef CONFIG_NATIVE_LIBC
ZTEST(posix_single_process, test_getenv_r)
{
	static char buf[16];
	static const int exp_errno[] = {
		EINVAL, EINVAL, EINVAL, EINVAL, ENOENT, ENOENT, ENOENT, EINVAL, EINVAL, EINVAL,
	};
	static const struct args_s {
		const char *name;
		char *buf;
		size_t size;
	} args[] = {
		/* invalid input */
		{NULL, NULL, 0},
		{NULL, NULL, 42},
		{NULL, buf, 0},
		{NULL, buf, sizeof(buf)},
		{"hello", NULL, 0},
		{"hello", NULL, 42},
		{"hello", buf, 0},

		/* invalid names */
		{"", buf, sizeof(buf)},
		{"invalid=key", buf, sizeof(buf)},
		{"HOME=", buf, sizeof(buf)},
	};

	BUILD_ASSERT(ARRAY_SIZE(exp_errno) == ARRAY_SIZE(args));

	ARRAY_FOR_EACH(args, i) {
		errno = 0;
		zassert_equal(getenv_r(args[i].name, args[i].buf, args[i].size), -1,
			      "getenv_r(\"%s\", %p, %zu): expected to fail", args[i].name,
			      args[i].buf, args[i].size);
		zassert_equal(errno, exp_errno[i],
			      "getenv_r(\"%s\", %p, %zu): act_errno: %d exp_errno: %d",
			      args[i].name, args[i].buf, args[i].size, errno, exp_errno[i]);
	}

	errno = 0;
	zassert_equal(getenv_r("NO_SUCH_VAR", buf, sizeof(buf)), -1);
	zassert_equal(errno, ENOENT);

	errno = 0;
	zassert_equal(getenv_r("HOME", buf, 2), -1);
	zassert_equal(errno, ERANGE);

	zassert_ok(getenv_r("HOME", buf, sizeof(buf)));
	zassert_mem_equal(buf, M_HOME, strlen(M_HOME) + 1);

	zassert_mem_equal(getenv("HOME"), M_HOME, strlen(M_HOME) + 1);
	zassert_mem_equal(getenv("UID"), M_UID, strlen(M_UID) + 1);
	zassert_mem_equal(getenv("PWD"), M_PWD, strlen(M_PWD) + 1);
}
#endif /* CONFIG_NATIVE_LIBC */

ZTEST(posix_single_process, test_setenv)
{
	IF_NOT_NATIVE_LIBC({
		/* avoid glib c non-NULL warnings */
		zassert_equal(setenv(NULL, NULL, 0), -1);
		zassert_equal(errno, EINVAL);

		zassert_equal(setenv("HOME", NULL, 0), -1);
		zassert_equal(errno, EINVAL);
	})

	/*
	 * bug in picolibc / newlib
	 * https://github.com/picolibc/picolibc/issues/648
	 */
	zassert_equal(setenv("", "42", 0), -1);
	zassert_equal(errno, EINVAL);

	zassert_equal(setenv("invalid=key", "42", 0), -1);
	zassert_equal(errno, EINVAL);

	/* do not overwrite if environ[key] exists */
	zassert_ok(setenv("HOME", "/root", 0));
	zassert_mem_equal(getenv("HOME"), M_HOME, strlen(M_HOME) + 1);

	/* should overwrite (without malloc) */
	zassert_ok(setenv("HOME", "/root", 1));
	zassert_mem_equal(getenv("HOME"), "/root", strlen("/root") + 1);
}

ZTEST(posix_single_process, test_unsetenv)
{
	IF_NOT_NATIVE_LIBC({
		/* not hardened / application should fault */
		zassert_equal(unsetenv(NULL), -1);
		zassert_equal(errno, EINVAL);
	})

	errno = 0;
	/* bug in picolibc / newlib */
	zassert_equal(unsetenv(""), -1);
	zassert_equal(errno, EINVAL);

	zassert_equal(unsetenv("invalid=key"), -1);
	zassert_equal(errno, EINVAL);

	zassert_ok(unsetenv("NO_SUCH_VAR"));

	/* restore original environ */
	environ = old_environ;
	/* should overwrite (requires realloc) */
	zassert_ok(setenv("HOME", _m_alt_home, 1));
	zassert_mem_equal(getenv("HOME"), _m_alt_home, strlen(_m_alt_home) + 1);
	zassert_ok(unsetenv("HOME"));
	zassert_is_null(getenv("HOME"));
}

#ifndef CONFIG_NATIVE_LIBC
ZTEST(posix_single_process, test_watertight)
{
	extern size_t posix_env_get_allocated_space(void);

	char buf[4];

	/* restore original environ, which should support realloc, free, etc */
	environ = old_environ;

	for (int i = 0; i < 256; ++i) {
		snprintf(buf, sizeof(buf), "%d", i);
		zassert_ok(setenv("COUNTER", buf, 1));
		zassert_mem_equal(getenv("COUNTER"), buf, strlen(buf));
		zassert_ok(getenv_r("COUNTER", buf, sizeof(buf)));
		zassert_equal(atoi(buf), i);
		zassert_ok(unsetenv("COUNTER"));
	}

	zassert_equal(posix_env_get_allocated_space(), 0);
}
#endif /* CONFIG_NATIVE_LIBC */

void test_env_before(void)
{
	old_environ = environ;

	RESET_ENVIRON(home, "HOME", M_HOME);
	RESET_ENVIRON(uid, "UID", M_UID);
	RESET_ENVIRON(pwd, "PWD", M_PWD);
	environ_for_test[0] = home;
	environ_for_test[1] = uid;
	environ_for_test[2] = pwd;

	zassert_equal((environ = environ_for_test), environ_for_test);
}

void test_env_after(void)
{
	environ = old_environ;
}
```

## src/errno.c
```c
/*
 * SPDX-FileCopyrightText: Copyright The Zephyr Project Contributors
 *
 * SPDX-License-Identifier: Apache-2.0
 */

#include <errno.h>

#include <zephyr/ztest.h>

ZTEST(posix_single_process, test_errno)
{
	errno = 0;
	zassert_equal(errno, 0);
	errno = ERANGE;
	zassert_equal(errno, ERANGE);
	errno = 0;
}
```

## src/sysconf.c
```c
/*
 * Copyright (c) 2023, Meta
 * Copyright (c) 2024, Adam Wojasinski <awojasinski@baylibre.com>
 *
 * SPDX-License-Identifier: Apache-2.0
 */

#include <errno.h>
#include <limits.h>
#include <unistd.h>

#include <zephyr/sys/util.h>
#include <zephyr/ztest.h>

#ifdef CONFIG_TEST_POSIX_PROFILE_SUBTRACT
#if defined(_POSIX_AEP_REALTIME_MINIMAL) || defined(_POSIX_AEP_REALTIME_CONTROLLER)
#error "a subprofile with a constituent disabled must not claim conformance"
#endif
#if !defined(_POSIX_VERSION) || defined(_POSIX_ASYNCHRONOUS_IO) || defined(_POSIX_MESSAGE_PASSING)
#error "the remaining Option Groups must still be reported"
#endif
#endif /* CONFIG_TEST_POSIX_PROFILE_SUBTRACT */

#ifdef CONFIG_TEST_POSIX_PROFILE_PSE54
#if !defined(_POSIX_AEP_REALTIME_MINIMAL) || !defined(_POSIX_AEP_REALTIME_CONTROLLER)
#error "PSE54 inherits PSE51 and PSE52"
#endif
#if !defined(_POSIX_ADVISORY_INFO) || !defined(_POSIX_JOB_CONTROL) || !defined(_POSIX_REGEXP) ||  \
	!defined(_POSIX_THREAD_PROCESS_SHARED) || !defined(_XOPEN_UNIX)
#error "PSE54 adds advisory information, job control, regular expressions, process-shared " \
	"objects and XSI"
#endif
#endif /* CONFIG_TEST_POSIX_PROFILE_PSE54 */

#ifdef CONFIG_POSIX_SYSCONF_IMPL_FULL

enum sysconf_expect {
	/* Must be supported with a positive value on all platforms. */
	SYSCONF_POSITIVE,
	/*
	 * Optional limit: unsupported (-1), disabled (0), or a positive value.
	 * Matches Linux/glibc and Zephyr without platform-specific tables.
	 */
	SYSCONF_LIMIT,
	/*
	 * Optional feature: unsupported (-1) or supported (> 0).
	 */
	SYSCONF_OPTION,
	/* Known unsupported on Linux and Zephyr. */
	SYSCONF_UNSUPPORTED,
};

struct sysconf_case {
	int name;
	enum sysconf_expect kind;
};

static void assert_sysconf(int name, long ret, enum sysconf_expect kind)
{
	switch (kind) {
	case SYSCONF_POSITIVE:
		zassert_true(ret > 0, "sysconf(%d) returned %ld", name, ret);
		break;
	case SYSCONF_LIMIT:
		zassert_true(ret == -1L || ret >= 0L,
			     "sysconf(%d) returned %ld, expected -1 or >= 0", name, ret);
		break;
	case SYSCONF_OPTION:
		zassert_true(ret == -1L || ret > 0L,
			     "sysconf(%d) returned %ld, expected -1 or > 0", name, ret);
		break;
	case SYSCONF_UNSUPPORTED:
		zassert_equal(ret, -1L, "sysconf(%d) returned %ld, expected -1", name, ret);
		break;
	default:
		zassert_unreachable("unexpected sysconf expectation kind");
		break;
	}
}

#ifndef _SC_XOPEN_UUCP
#define _SC_XOPEN_UUCP 124
#endif

static const struct sysconf_case sysconf_cases[] = {
	{_SC_ADVISORY_INFO, SYSCONF_OPTION},
	{_SC_ASYNCHRONOUS_IO, SYSCONF_OPTION},
	{_SC_BARRIERS, SYSCONF_OPTION},
	{_SC_CLOCK_SELECTION, SYSCONF_OPTION},
	{_SC_CPUTIME, SYSCONF_OPTION},
	{_SC_FSYNC, SYSCONF_OPTION},
	{_SC_IPV6, SYSCONF_OPTION},
	{_SC_JOB_CONTROL, SYSCONF_OPTION},
	{_SC_MAPPED_FILES, SYSCONF_OPTION},
	{_SC_MEMLOCK, SYSCONF_OPTION},
	{_SC_MEMLOCK_RANGE, SYSCONF_OPTION},
	{_SC_MEMORY_PROTECTION, SYSCONF_OPTION},
	{_SC_MESSAGE_PASSING, SYSCONF_OPTION},
	{_SC_MONOTONIC_CLOCK, SYSCONF_OPTION},
	{_SC_PRIORITIZED_IO, SYSCONF_OPTION},
	{_SC_PRIORITY_SCHEDULING, SYSCONF_OPTION},
	{_SC_RAW_SOCKETS, SYSCONF_OPTION},
	{_SC_RE_DUP_MAX, SYSCONF_OPTION},
	{_SC_READER_WRITER_LOCKS, SYSCONF_OPTION},
	{_SC_REALTIME_SIGNALS, SYSCONF_OPTION},
	{_SC_REGEXP, SYSCONF_OPTION},
	{_SC_SAVED_IDS, SYSCONF_OPTION},
	{_SC_SEMAPHORES, SYSCONF_OPTION},
	{_SC_SHARED_MEMORY_OBJECTS, SYSCONF_OPTION},
	{_SC_SHELL, SYSCONF_OPTION},
	{_SC_SPAWN, SYSCONF_OPTION},
	{_SC_SPIN_LOCKS, SYSCONF_OPTION},
	{_SC_SPORADIC_SERVER, SYSCONF_OPTION},
	{_SC_SS_REPL_MAX, SYSCONF_OPTION},
	{_SC_SYNCHRONIZED_IO, SYSCONF_OPTION},
	{_SC_THREAD_ATTR_STACKADDR, SYSCONF_OPTION},
	{_SC_THREAD_ATTR_STACKSIZE, SYSCONF_OPTION},
	{_SC_THREAD_CPUTIME, SYSCONF_OPTION},
	{_SC_THREAD_PRIO_INHERIT, SYSCONF_OPTION},
	{_SC_THREAD_PRIO_PROTECT, SYSCONF_OPTION},
	{_SC_THREAD_PRIORITY_SCHEDULING, SYSCONF_OPTION},
	{_SC_THREAD_PROCESS_SHARED, SYSCONF_OPTION},
	{_SC_THREAD_ROBUST_PRIO_INHERIT, SYSCONF_OPTION},
	{_SC_THREAD_ROBUST_PRIO_PROTECT, SYSCONF_OPTION},
	{_SC_THREAD_SAFE_FUNCTIONS, SYSCONF_OPTION},
	{_SC_THREAD_SPORADIC_SERVER, SYSCONF_OPTION},
	{_SC_THREADS, SYSCONF_OPTION},
	{_SC_TIMEOUTS, SYSCONF_OPTION},
	{_SC_TIMERS, SYSCONF_OPTION},
	{_SC_TRACE, SYSCONF_UNSUPPORTED},
	{_SC_TRACE_EVENT_FILTER, SYSCONF_UNSUPPORTED},
	{_SC_TRACE_EVENT_NAME_MAX, SYSCONF_OPTION},
	{_SC_TRACE_INHERIT, SYSCONF_UNSUPPORTED},
	{_SC_TRACE_LOG, SYSCONF_UNSUPPORTED},
	{_SC_TRACE_NAME_MAX, SYSCONF_OPTION},
	{_SC_TRACE_SYS_MAX, SYSCONF_OPTION},
	{_SC_TRACE_USER_EVENT_MAX, SYSCONF_OPTION},
	{_SC_TYPED_MEMORY_OBJECTS, SYSCONF_UNSUPPORTED},
	{_SC_VERSION, SYSCONF_POSITIVE},
	{_SC_V7_ILP32_OFF32, SYSCONF_OPTION},
	{_SC_V7_ILP32_OFFBIG, SYSCONF_OPTION},
	{_SC_V7_LP64_OFF64, SYSCONF_OPTION},
	{_SC_V7_LPBIG_OFFBIG, SYSCONF_OPTION},
	{_SC_BC_BASE_MAX, SYSCONF_OPTION},
	{_SC_BC_DIM_MAX, SYSCONF_OPTION},
	{_SC_BC_SCALE_MAX, SYSCONF_OPTION},
	{_SC_BC_STRING_MAX, SYSCONF_OPTION},
	{_SC_2_C_BIND, SYSCONF_OPTION},
	{_SC_2_C_DEV, SYSCONF_OPTION},
	{_SC_2_CHAR_TERM, SYSCONF_OPTION},
	{_SC_COLL_WEIGHTS_MAX, SYSCONF_OPTION},
	{_SC_DELAYTIMER_MAX, SYSCONF_LIMIT},
	{_SC_EXPR_NEST_MAX, SYSCONF_OPTION},
	{_SC_2_FORT_DEV, SYSCONF_OPTION},
	{_SC_2_FORT_RUN, SYSCONF_OPTION},
	{_SC_LINE_MAX, SYSCONF_OPTION},
	{_SC_2_LOCALEDEF, SYSCONF_OPTION},
	{_SC_2_PBS, SYSCONF_OPTION},
	{_SC_2_PBS_ACCOUNTING, SYSCONF_OPTION},
	{_SC_2_PBS_CHECKPOINT, SYSCONF_OPTION},
	{_SC_2_PBS_LOCATE, SYSCONF_OPTION},
	{_SC_2_PBS_MESSAGE, SYSCONF_OPTION},
	{_SC_2_PBS_TRACK, SYSCONF_OPTION},
	{_SC_2_SW_DEV, SYSCONF_OPTION},
	{_SC_2_UPE, SYSCONF_OPTION},
	{_SC_2_VERSION, SYSCONF_OPTION},
	{_SC_XOPEN_CRYPT, SYSCONF_UNSUPPORTED},
	{_SC_XOPEN_ENH_I18N, SYSCONF_OPTION},
	{_SC_XOPEN_REALTIME, SYSCONF_OPTION},
	{_SC_XOPEN_REALTIME_THREADS, SYSCONF_OPTION},
	{_SC_XOPEN_SHM, SYSCONF_OPTION},
	{_SC_XOPEN_STREAMS, SYSCONF_OPTION},
	{_SC_XOPEN_UNIX, SYSCONF_OPTION},
	{_SC_XOPEN_UUCP, SYSCONF_OPTION},
	{_SC_XOPEN_VERSION, SYSCONF_LIMIT},
	{_SC_CLK_TCK, SYSCONF_POSITIVE},
	{_SC_GETGR_R_SIZE_MAX, SYSCONF_LIMIT},
	{_SC_GETPW_R_SIZE_MAX, SYSCONF_LIMIT},
	{_SC_AIO_LISTIO_MAX, SYSCONF_OPTION},
	{_SC_AIO_MAX, SYSCONF_OPTION},
	{_SC_AIO_PRIO_DELTA_MAX, SYSCONF_LIMIT},
	{_SC_ARG_MAX, SYSCONF_POSITIVE},
	{_SC_ATEXIT_MAX, SYSCONF_POSITIVE},
	{_SC_CHILD_MAX, SYSCONF_LIMIT},
	{_SC_HOST_NAME_MAX, SYSCONF_LIMIT},
	{_SC_IOV_MAX, SYSCONF_POSITIVE},
	{_SC_LOGIN_NAME_MAX, SYSCONF_POSITIVE},
	{_SC_NGROUPS_MAX, SYSCONF_LIMIT},
	{_SC_MQ_OPEN_MAX, SYSCONF_LIMIT},
	{_SC_MQ_PRIO_MAX, SYSCONF_OPTION},
	{_SC_OPEN_MAX, SYSCONF_POSITIVE},
	{_SC_PAGE_SIZE, SYSCONF_POSITIVE},
	{_SC_THREAD_DESTRUCTOR_ITERATIONS, SYSCONF_POSITIVE},
	{_SC_THREAD_KEYS_MAX, SYSCONF_LIMIT},
	{_SC_THREAD_STACK_MIN, SYSCONF_LIMIT},
	{_SC_THREAD_THREADS_MAX, SYSCONF_LIMIT},
	{_SC_RTSIG_MAX, SYSCONF_LIMIT},
	{_SC_SEM_NSEMS_MAX, SYSCONF_LIMIT},
	{_SC_SEM_VALUE_MAX, SYSCONF_LIMIT},
	{_SC_SIGQUEUE_MAX, SYSCONF_OPTION},
	{_SC_STREAM_MAX, SYSCONF_POSITIVE},
	{_SC_SYMLOOP_MAX, SYSCONF_OPTION},
	{_SC_TIMER_MAX, SYSCONF_LIMIT},
	{_SC_TTY_NAME_MAX, SYSCONF_POSITIVE},
	{_SC_TZNAME_MAX, SYSCONF_OPTION},
};

#if defined(CONFIG_NEWLIB_LIBC) || defined(CONFIG_PICOLIBC)
/* a prebuilt libc calls sysconf() with its own numbering: dlmalloc uses sysconf(8) */
BUILD_ASSERT(_SC_PAGESIZE == 8, "sysconf() does not use the libc's _SC_* numbering");
#endif

ZTEST_USER(posix_single_process, test_sysconf_known_values)
{
	long page_size;

	ARRAY_FOR_EACH(sysconf_cases, i) {
		long ret = sysconf(sysconf_cases[i].name);

		assert_sysconf(sysconf_cases[i].name, ret, sysconf_cases[i].kind);
	}

	page_size = sysconf(_SC_PAGE_SIZE);
	zassert_equal(sysconf(_SC_PAGESIZE), page_size);
	/* a prebuilt libc allocator aligns with (page_size - 1) */
	zassert_true((page_size & (page_size - 1)) == 0, "page size %ld is not a power of two",
		     page_size);
}

ZTEST_USER(posix_single_process, test_sysconf_invalid_name)
{
	long ret;

	errno = 0;
	ret = sysconf(99999);
	zassert_equal(ret, -1L, "sysconf returned unexpected value %ld", ret);
	zassert_equal(errno, EINVAL, "errno %d", errno);
}

#else /* CONFIG_POSIX_SYSCONF_IMPL_MACRO */

#define CHECK_SYSCONF(_name, _exp) zassert_equal(sysconf(_name), (long)(_exp))

ZTEST_USER(posix_single_process, test_sysconf_known_values)
{
	CHECK_SYSCONF(_SC_ADVISORY_INFO, -1L);
	CHECK_SYSCONF(_SC_ASYNCHRONOUS_IO,
		      COND_CODE_1(CONFIG_POSIX_ASYNCHRONOUS_IO, (_POSIX_ASYNCHRONOUS_IO), (-1L)));
	CHECK_SYSCONF(_SC_BARRIERS,
		      COND_CODE_1(CONFIG_POSIX_BARRIERS, (_POSIX_BARRIERS), (-1L)));
	CHECK_SYSCONF(_SC_CLOCK_SELECTION,
		      COND_CODE_1(CONFIG_POSIX_CLOCK_SELECTION, (_POSIX_CLOCK_SELECTION), (-1L)));
	CHECK_SYSCONF(_SC_CPUTIME, COND_CODE_1(CONFIG_POSIX_CPUTIME, (_POSIX_CPUTIME), (-1L)));
	CHECK_SYSCONF(_SC_FSYNC, COND_CODE_1(CONFIG_POSIX_FSYNC, (_POSIX_FSYNC), (-1L)));
	CHECK_SYSCONF(_SC_IPV6, COND_CODE_1(CONFIG_NET_IPV6, (_POSIX_VERSION), (-1L)));
	CHECK_SYSCONF(_SC_VERSION,
		      COND_CODE_1(CONFIG_POSIX_SYSTEM_INTERFACES, (_POSIX_VERSION), (0)));
	CHECK_SYSCONF(_SC_CLK_TCK, 100L);
	CHECK_SYSCONF(_SC_OPEN_MAX, OPEN_MAX);
	CHECK_SYSCONF(_SC_PAGE_SIZE, CONFIG_POSIX_PAGE_SIZE);
	CHECK_SYSCONF(_SC_PAGESIZE, CONFIG_POSIX_PAGE_SIZE);
	CHECK_SYSCONF(_SC_SEMAPHORES,
		      COND_CODE_1(CONFIG_POSIX_SEMAPHORES, (_POSIX_SEMAPHORES), (-1L)));
	CHECK_SYSCONF(_SC_THREADS, COND_CODE_1(CONFIG_POSIX_THREADS, (_POSIX_THREADS), (-1L)));
	CHECK_SYSCONF(_SC_TIMERS, COND_CODE_1(CONFIG_POSIX_TIMERS, (_POSIX_TIMERS), (-1)));
}

#endif /* CONFIG_POSIX_SYSCONF_IMPL_FULL */
```

## src/uname.c
```c
/*
 * Copyright (c) 2023 meta
 *
 * SPDX-License-Identifier: Apache-2.0
 */

#include <string.h>
#include <sys/utsname.h>
#include <unistd.h>

#include <zephyr/ztest.h>

#if defined(__linux__)
#define EXPECTED_SYSNAME "Linux"
#elif defined(__ZEPHYR__)
#define EXPECTED_SYSNAME "Zephyr"
#else
#error "Unsupported platform"
#endif

ZTEST(posix_single_process, test_uname)
{
	struct utsname info;

	zassert_ok(uname(&info));
	zassert_ok(strncmp(info.sysname, EXPECTED_SYSNAME, sizeof(info.sysname)),
		"expected: %s actual: %s", EXPECTED_SYSNAME, info.sysname);
	zassert_true(strlen(info.release) > 0);
	zassert_true(strlen(info.version) > 0);
	zassert_true(strlen(info.machine) > 0);
	zassert_true(strlen(info.nodename) > 0);
}
```
