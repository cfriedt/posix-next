## CMakeLists.txt
```
# SPDX-License-Identifier: Apache-2.0

cmake_minimum_required(VERSION 3.20.0)

find_package(Zephyr REQUIRED HINTS $ENV{ZEPHYR_BASE})
project(posix_hello_world)

target_sources(app PRIVATE src/main.c)

target_compile_options(app PRIVATE -U_POSIX_C_SOURCE -D_POSIX_C_SOURCE=200809L)
target_compile_options(app PRIVATE -U_XOPEN_SOURCE -D_XOPEN_SOURCE=700)
```

## Kconfig
```
# Copyright (c) The Zephyr Project Contributors
# SPDX-License-Identifier: Apache-2.0

rsource "../../../tests/posix/Kconfig.test_common"
source "Kconfig.zephyr"
```

## sample.yaml
```
sample:
  description: POSIX hello world sample
  name: posix hello world
common:
  tags: posix
  integration_platforms:
    - native_sim
    - qemu_riscv64
  harness: console
  harness_config:
    type: multi_line
    ordered: true
    regex:
      - "Hello World! .* from pthread_t 0x[0-9a-f]+"
      - "pthread_t returned 42"
tests:
  sample.posix.hello_world: {}
```

## prj.conf
```kconfig
CONFIG_POSIX_AEP_CHOICE_PSE51=y

# To enable automatic thread and thread stack allocation
CONFIG_SYS_THREAD_STACK_MIN_ADD_TEST=1
CONFIG_SYS_THREAD_THREAD_MIN_ADD_TEST=1
```

## src/main.c
```c
/*
 * Copyright (c) The Zephyr Project Contributors
 *
 * SPDX-License-Identifier: Apache-2.0
 */

#include <pthread.h>
#include <stdio.h>
#include <stdint.h>

static void *worker(void *arg)
{
	printf("Hello World! %s from pthread_t %p\n", CONFIG_BOARD_TARGET,
	       (void *)(uintptr_t)pthread_self());

	return (void *)(intptr_t)42;
}

int main(void)
{
	void *res;
	pthread_t tid;

	pthread_create(&tid, NULL, worker, NULL);
	pthread_join(tid, &res);

	printf("pthread_t returned %d\n", (int)(intptr_t)res);

	return 0;
}
```
