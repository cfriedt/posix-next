## subsys/kcl/linux/Kconfig
```kconfig
# SPDX-FileCopyrightText: Copyright The Zephyr Project Contributors
# SPDX-License-Identifier: Apache-2.0

config KCL_LINUX_ARCH
	string
	default "x86_64" if X86_64
	default "i386" if X86
	default "arm64" if ARM64
	default "arm" if ARM
	default "riscv64" if RISCV && 64BIT
	default "riscv32" if RISCV

config KCL_LINUX
	bool "Linux kernel compatibility layer"
	depends on USERSPACE
	depends on KCL_LINUX_ARCH != ""
	depends on ARCH_HAS_USER_THREAD_POINTER && THREAD_LOCAL_STORAGE
	depends on LLEXT && FILE_SYSTEM
	# the executable's AT_RANDOM and its getrandom() want random bytes
	depends on ENTROPY_HAS_DRIVER || TEST_RANDOM_GENERATOR
	select USER_THREAD_POINTER
	select USER_SYSCALL_ABI if ARCH_HAS_USER_SYSCALL_ABI
	# what the system calls are built on: all on by default, each one optional
	imply PROCESS
	imply SYS_PROCESS
	imply SYS_PROCESS_EXEC
	imply SYS_THREAD
	imply SIGNAL
	imply ZVFS
	imply ZVFS_FDTABLE
	imply ZVFS_FS
	imply ZVFS_POLL
	imply ZVFS_PIPE
	imply ZVFS_FIFO
	imply PROCESS_STOP
	help
	  The Linux system call interface: every Linux system call of this
	  architecture is a system call of this image at its Linux number, so a
	  user-mode thread executing Linux binary code has its system calls
	  dispatched here. Calls the layer does not provide, and calls switched
	  off (see the system call options), fail with ENOSYS.

if KCL_LINUX

rsource "Kconfig.syscalls"

config KCL_LINUX_EXEC
	def_bool y
	depends on SYS_PROCESS_EXEC
	help
	  Run static Linux executables (ET_EXEC or position-independent ET_DYN
	  images without an interpreter) as processes: sys_exec_load() loads
	  them, so any process creation over it takes them like any image.

config KCL_LINUX_STACK_SIZE
	int "Initial stack of a Linux process (bytes)"
	depends on KCL_LINUX_EXEC
	default 65536
	help
	  Size of the stack a loaded Linux executable starts on. Its top holds
	  the argument, environment and auxiliary vectors.

config KCL_LINUX_BRK_SIZE
	int "Program break area of a Linux process (bytes)"
	depends on KCL_LINUX_EXEC
	default 262144
	help
	  Memory reserved after an executable's data for brk() growth; brk()
	  fails once it is used up, and C libraries then fall back to mmap().

config SIGNAL_SET_SIZE_MIN_KCL_LINUX
	def_int 64
	help
	  Linux numbers its signals 1 to 64. Its C library keeps 32 and 33
	  for itself, where the kernel's cancellation signal already is; the
	  kernel's timer and message queue signals take the top two of the
	  real-time range, as glibc's own helpers take theirs from it.

config SIGNAL_ACTION_DB_SIZE_MIN_KCL_LINUX
	def_int 64
	help
	  Signal handlers of Linux processes, all of them together: a process
	  installs its own and every fork() copies the parent's, so the
	  database holds each handler once per process that has it.

config SIGNAL_QUEUE_SIZE_ADD_KCL_LINUX
	def_int 16
	help
	  Signals in flight between Linux processes: kill(), tgkill() and the
	  child status notifications of their fork() children.

config KCL_LINUX_FUTEX_WAITERS
	int "Concurrent futex waiters"
	default 8
	help
	  How many threads of Linux processes can block in futex() at once.

module = KCL_LINUX
module-str = kcl_linux
source "subsys/logging/Kconfig.template.log_config"

endif # KCL_LINUX
```

## subsys/kcl/linux/Kconfig.syscalls
```kconfig
# SPDX-FileCopyrightText: Copyright The Zephyr Project Contributors
# SPDX-License-Identifier: Apache-2.0

# One option per Linux system call the layer implements: on by default, each
# depending on the Zephyr service its implementation is built on, so that a
# service switched off takes its system calls with it, and any one call can
# be dropped on its own. A call that is off answers ENOSYS.

menu "Linux system calls"

menu "Files and descriptors"

config KCL_LINUX_SYSCALL_OPEN
	bool "open"
	default y
	depends on ZVFS_FS

config KCL_LINUX_SYSCALL_OPENAT
	bool "openat"
	default y
	depends on ZVFS_FS

config KCL_LINUX_SYSCALL_CLOSE
	bool "close"
	default y
	depends on ZVFS_FDTABLE

config KCL_LINUX_SYSCALL_READ
	bool "read"
	default y
	depends on ZVFS_FDTABLE

config KCL_LINUX_SYSCALL_WRITE
	bool "write"
	default y
	depends on ZVFS_FDTABLE

config KCL_LINUX_SYSCALL_READV
	bool "readv"
	default y
	depends on ZVFS_FDTABLE

config KCL_LINUX_SYSCALL_WRITEV
	bool "writev"
	default y
	depends on ZVFS_FDTABLE

config KCL_LINUX_SYSCALL_LSEEK
	bool "lseek"
	default y
	depends on ZVFS_FDTABLE

config KCL_LINUX_SYSCALL_FSTAT
	bool "fstat"
	default y
	depends on ZVFS_FDTABLE

config KCL_LINUX_SYSCALL_NEWFSTATAT
	bool "newfstatat"
	default y
	depends on ZVFS_FS

config KCL_LINUX_SYSCALL_STAT
	bool "stat"
	default y
	depends on ZVFS_FS

config KCL_LINUX_SYSCALL_LSTAT
	bool "lstat"
	default y
	depends on ZVFS_FS

config KCL_LINUX_SYSCALL_FACCESSAT
	bool "faccessat"
	default y
	depends on ZVFS_FS

config KCL_LINUX_SYSCALL_FACCESSAT2
	bool "faccessat2"
	default y
	depends on ZVFS_FS

config KCL_LINUX_SYSCALL_ACCESS
	bool "access"
	default y
	depends on ZVFS_FS

config KCL_LINUX_SYSCALL_TRUNCATE
	bool "truncate"
	default y
	depends on ZVFS_FS

config KCL_LINUX_SYSCALL_FTRUNCATE
	bool "ftruncate"
	default y
	depends on ZVFS_FDTABLE

config KCL_LINUX_SYSCALL_FSYNC
	bool "fsync"
	default y
	depends on ZVFS_FDTABLE

config KCL_LINUX_SYSCALL_DUP
	bool "dup"
	default y
	depends on ZVFS_FDTABLE

config KCL_LINUX_SYSCALL_DUP2
	bool "dup2"
	default y
	depends on ZVFS_FDTABLE

config KCL_LINUX_SYSCALL_DUP3
	bool "dup3"
	default y
	depends on ZVFS_FDTABLE

config KCL_LINUX_SYSCALL_FCNTL
	bool "fcntl"
	default y
	depends on ZVFS_FDTABLE

config KCL_LINUX_SYSCALL_IOCTL
	bool "ioctl"
	default y
	depends on ZVFS_FDTABLE

config KCL_LINUX_SYSCALL_UMASK
	bool "umask"
	default y

config KCL_LINUX_SYSCALL_PIPE2
	bool "pipe2"
	default y
	depends on ZVFS_PIPE

config KCL_LINUX_SYSCALL_PIPE
	bool "pipe"
	default y
	depends on ZVFS_PIPE

config KCL_LINUX_SYSCALL_POLL
	bool "poll"
	default y
	depends on NET_SOCKETS && ZVFS_POLL

config KCL_LINUX_SYSCALL_PPOLL
	bool "ppoll"
	default y
	depends on NET_SOCKETS && ZVFS_POLL

endmenu # Files and descriptors

menu "Directories and links"

config KCL_LINUX_SYSCALL_CHDIR
	bool "chdir"
	default y
	depends on ZVFS_FS

config KCL_LINUX_SYSCALL_GETCWD
	bool "getcwd"
	default y
	depends on ZVFS_FS

config KCL_LINUX_SYSCALL_GETDENTS64
	bool "getdents64"
	default y
	depends on ZVFS_FS

config KCL_LINUX_SYSCALL_MKDIRAT
	bool "mkdirat"
	default y
	depends on ZVFS_FS

config KCL_LINUX_SYSCALL_MKDIR
	bool "mkdir"
	default y
	depends on ZVFS_FS

config KCL_LINUX_SYSCALL_UNLINKAT
	bool "unlinkat"
	default y
	depends on ZVFS_FS

config KCL_LINUX_SYSCALL_UNLINK
	bool "unlink"
	default y
	depends on ZVFS_FS

config KCL_LINUX_SYSCALL_RMDIR
	bool "rmdir"
	default y
	depends on ZVFS_FS

config KCL_LINUX_SYSCALL_RENAMEAT
	bool "renameat"
	default y
	depends on ZVFS_FS

config KCL_LINUX_SYSCALL_RENAME
	bool "rename"
	default y
	depends on ZVFS_FS

config KCL_LINUX_SYSCALL_RENAMEAT2
	bool "renameat2"
	default y
	depends on ZVFS_FS

config KCL_LINUX_SYSCALL_SYMLINKAT
	bool "symlinkat"
	default y
	depends on ZVFS_FS

config KCL_LINUX_SYSCALL_SYMLINK
	bool "symlink"
	default y
	depends on ZVFS_FS

config KCL_LINUX_SYSCALL_READLINKAT
	bool "readlinkat"
	default y
	depends on ZVFS_FS

config KCL_LINUX_SYSCALL_READLINK
	bool "readlink"
	default y
	depends on ZVFS_FS

config KCL_LINUX_SYSCALL_MKNODAT
	bool "mknodat"
	default y
	depends on ZVFS_FIFO

config KCL_LINUX_SYSCALL_MKNOD
	bool "mknod"
	default y
	depends on ZVFS_FIFO

endmenu # Directories and links

menu "Processes"

config KCL_LINUX_SYSCALL_EXECVE
	bool "execve"
	default y
	depends on KCL_LINUX_EXEC

config KCL_LINUX_SYSCALL_FORK
	bool "fork"
	default y
	depends on PROCESS_VM

config KCL_LINUX_SYSCALL_VFORK
	bool "vfork"
	default y
	depends on PROCESS_VM

config KCL_LINUX_SYSCALL_CLONE
	bool "clone"
	default y
	depends on PROCESS

config KCL_LINUX_SYSCALL_EXIT
	bool "exit"
	default y
	depends on PROCESS

config KCL_LINUX_SYSCALL_EXIT_GROUP
	bool "exit_group"
	default y
	depends on PROCESS

config KCL_LINUX_SYSCALL_WAIT4
	bool "wait4"
	default y
	depends on PROCESS

config KCL_LINUX_SYSCALL_GETPID
	bool "getpid"
	default y
	depends on PROCESS

config KCL_LINUX_SYSCALL_GETPPID
	bool "getppid"
	default y
	depends on PROCESS

config KCL_LINUX_SYSCALL_GETTID
	bool "gettid"
	default y
	depends on PROCESS

config KCL_LINUX_SYSCALL_GETPGID
	bool "getpgid"
	default y
	depends on PROCESS

config KCL_LINUX_SYSCALL_GETPGRP
	bool "getpgrp"
	default y
	depends on PROCESS

config KCL_LINUX_SYSCALL_GETUID
	bool "getuid"
	default y

config KCL_LINUX_SYSCALL_GETEUID
	bool "geteuid"
	default y

config KCL_LINUX_SYSCALL_GETGID
	bool "getgid"
	default y

config KCL_LINUX_SYSCALL_GETEGID
	bool "getegid"
	default y

config KCL_LINUX_SYSCALL_GETGROUPS
	bool "getgroups"
	default y

config KCL_LINUX_SYSCALL_GETRLIMIT
	bool "getrlimit"
	default y

config KCL_LINUX_SYSCALL_PRLIMIT64
	bool "prlimit64"
	default y

config KCL_LINUX_SYSCALL_UNAME
	bool "uname"
	default y

config KCL_LINUX_SYSCALL_SCHED_YIELD
	bool "sched_yield"
	default y

config KCL_LINUX_SYSCALL_SCHED_GETAFFINITY
	bool "sched_getaffinity"
	default y

config KCL_LINUX_SYSCALL_SET_TID_ADDRESS
	bool "set_tid_address"
	default y

config KCL_LINUX_SYSCALL_SET_ROBUST_LIST
	bool "set_robust_list"
	default y

endmenu # Processes

menu "Signals"

config KCL_LINUX_SYSCALL_KILL
	bool "kill"
	default y
	depends on SIGNAL

config KCL_LINUX_SYSCALL_TGKILL
	bool "tgkill"
	default y
	depends on SIGNAL

config KCL_LINUX_SYSCALL_TKILL
	bool "tkill"
	default y
	depends on SIGNAL

config KCL_LINUX_SYSCALL_RT_SIGACTION
	bool "rt_sigaction"
	default y
	depends on SIGNAL

config KCL_LINUX_SYSCALL_RT_SIGPROCMASK
	bool "rt_sigprocmask"
	default y
	depends on SIGNAL

endmenu # Signals

menu "Memory"

config KCL_LINUX_SYSCALL_BRK
	bool "brk"
	default y
	depends on KCL_LINUX_EXEC

config KCL_LINUX_SYSCALL_MMAP
	bool "mmap"
	default y
	depends on KCL_LINUX_EXEC

config KCL_LINUX_SYSCALL_MUNMAP
	bool "munmap"
	default y
	depends on KCL_LINUX_EXEC

config KCL_LINUX_SYSCALL_MPROTECT
	bool "mprotect"
	default y
	depends on KCL_LINUX_EXEC

config KCL_LINUX_SYSCALL_MSYNC
	bool "msync"
	default y
	depends on KCL_LINUX_EXEC

config KCL_LINUX_SYSCALL_MADVISE
	bool "madvise"
	default y
	depends on KCL_LINUX_EXEC

config KCL_LINUX_SYSCALL_FUTEX
	bool "futex"
	default y

endmenu # Memory

menu "Time and entropy"

config KCL_LINUX_SYSCALL_CLOCK_GETTIME
	bool "clock_gettime"
	default y

config KCL_LINUX_SYSCALL_GETTIMEOFDAY
	bool "gettimeofday"
	default y

config KCL_LINUX_SYSCALL_CLOCK_NANOSLEEP
	bool "clock_nanosleep"
	default y

config KCL_LINUX_SYSCALL_NANOSLEEP
	bool "nanosleep"
	default y

config KCL_LINUX_SYSCALL_GETRANDOM
	bool "getrandom"
	default y

endmenu # Time and entropy

menu "Sockets"

config KCL_LINUX_SYSCALL_SOCKET
	bool "socket"
	default y
	depends on NET_SOCKETS

config KCL_LINUX_SYSCALL_BIND
	bool "bind"
	default y
	depends on NET_SOCKETS

config KCL_LINUX_SYSCALL_CONNECT
	bool "connect"
	default y
	depends on NET_SOCKETS

config KCL_LINUX_SYSCALL_LISTEN
	bool "listen"
	default y
	depends on NET_SOCKETS

config KCL_LINUX_SYSCALL_ACCEPT4
	bool "accept4"
	default y
	depends on NET_SOCKETS

config KCL_LINUX_SYSCALL_ACCEPT
	bool "accept"
	default y
	depends on NET_SOCKETS

config KCL_LINUX_SYSCALL_GETSOCKNAME
	bool "getsockname"
	default y
	depends on NET_SOCKETS

config KCL_LINUX_SYSCALL_GETPEERNAME
	bool "getpeername"
	default y
	depends on NET_SOCKETS

config KCL_LINUX_SYSCALL_GETSOCKOPT
	bool "getsockopt"
	default y
	depends on NET_SOCKETS

config KCL_LINUX_SYSCALL_SETSOCKOPT
	bool "setsockopt"
	default y
	depends on NET_SOCKETS

config KCL_LINUX_SYSCALL_SHUTDOWN
	bool "shutdown"
	default y
	depends on NET_SOCKETS

config KCL_LINUX_SYSCALL_SENDTO
	bool "sendto"
	default y
	depends on NET_SOCKETS

config KCL_LINUX_SYSCALL_SENDMSG
	bool "sendmsg"
	default y
	depends on NET_SOCKETS

config KCL_LINUX_SYSCALL_RECVFROM
	bool "recvfrom"
	default y
	depends on NET_SOCKETS

config KCL_LINUX_SYSCALL_RECVMSG
	bool "recvmsg"
	default y
	depends on NET_SOCKETS

endmenu # Sockets

menu "Architecture"

config KCL_LINUX_SYSCALL_ARCH_PRCTL
	bool "arch_prctl"
	default y
	depends on X86_64

endmenu # Architecture

endmenu # Linux system calls
```

## tests/posix/asynchronous_io/testcase.yaml
```yaml
common:
  tags:
    - posix
    - posix_asynchronous_io
  # 1 tier0 platform per supported architecture
  platform_key:
    - arch
    - simulation
  min_flash: 64
  # the FAT-formatted RAM disk alone needs 80 KiB of RAM
  min_ram: 128
tests:
  portability.posix.asynchronous_io:
    filter: not CONFIG_NATIVE_LIBC
  portability.posix.asynchronous_io.userspace:
    filter: (not CONFIG_NATIVE_LIBC) and CONFIG_ARCH_SUPPORTS_USERSPACE_SIGNALS
    tags: userspace
    extra_configs:
      - CONFIG_TEST_USERSPACE=y
      - CONFIG_USERSPACE=y
  portability.posix.asynchronous_io.no_priority:
    filter: not CONFIG_NATIVE_LIBC
    extra_configs:
      - CONFIG_POSIX_PRIORITIZED_IO=n
  portability.posix.asynchronous_io.static_only:
    filter: not CONFIG_NATIVE_LIBC
    extra_configs:
      # equal to the accumulated SYS_AIO_MIN (SYS_AIO_MIN_ADD_TEST=4): no dynamic requests
      - CONFIG_SYS_AIO_MAX=4
  portability.posix.asynchronous_io.minimal:
    filter: not CONFIG_NATIVE_LIBC
    extra_configs:
      - CONFIG_MINIMAL_LIBC=y
  portability.posix.asynchronous_io.newlib:
    filter: (not CONFIG_NATIVE_LIBC) and (TOOLCHAIN_HAS_NEWLIB == 1)
    extra_configs:
      - CONFIG_NEWLIB_LIBC=y
  portability.posix.asynchronous_io.picolibc:
    tags: picolibc
    filter: (not CONFIG_NATIVE_LIBC) and CONFIG_PICOLIBC_SUPPORTED
    extra_configs:
      - CONFIG_PICOLIBC=y
  portability.posix.asynchronous_io.linux_compat:
    tags: native
    platform_allow:
      - native_sim
      - native_sim/native/64
    filter: CONFIG_NATIVE_LIBC
    extra_configs:
      - CONFIG_POSIX_TEST_LINUX_COMPAT=y
      - CONFIG_NATIVE_SIM_SLOWDOWN_TO_REAL_TIME=y
```

## tests/posix/c_lang_wide_char/testcase.yaml
```yaml
common:
  tags:
    - posix_c_lang_wide_char
  # 1 tier0 platform per supported architecture
  platform_key:
    - arch
    - simulation
tests:
  portability.posix.c_lang_wide_char.newlib:
    filter: (not CONFIG_NATIVE_LIBC) and (TOOLCHAIN_HAS_NEWLIB == 1)
    extra_configs:
      - CONFIG_NEWLIB_LIBC=y
  portability.posix.c_lang_wide_char.picolibc:
    tags: picolibc
    filter: (not CONFIG_NATIVE_LIBC) and CONFIG_PICOLIBC_SUPPORTED
    extra_configs:
      - CONFIG_PICOLIBC=y
  portability.posix.c_lang_wide_char.picolibc.userspace:
    tags:
      - picolibc
      - userspace
    filter: (not CONFIG_NATIVE_LIBC) and CONFIG_PICOLIBC_SUPPORTED and CONFIG_ARCH_HAS_USERSPACE
    extra_configs:
      - CONFIG_PICOLIBC=y
      - CONFIG_TEST_USERSPACE=y
      - CONFIG_USERSPACE=y
  portability.posix.c_lang_wide_char.tls.newlib:
    filter: (not CONFIG_NATIVE_LIBC) and (TOOLCHAIN_HAS_NEWLIB == 1) and
      CONFIG_ARCH_HAS_THREAD_LOCAL_STORAGE and CONFIG_TOOLCHAIN_SUPPORTS_THREAD_LOCAL_STORAGE
    extra_configs:
      - CONFIG_NEWLIB_LIBC=y
      - CONFIG_THREAD_LOCAL_STORAGE=y
  portability.posix.c_lang_wide_char.linux_compat:
    tags: native
    platform_allow:
      - native_sim
      - native_sim/native/64
    filter: CONFIG_NATIVE_LIBC
    extra_configs:
      - CONFIG_POSIX_TEST_LINUX_COMPAT=y
      - CONFIG_ZVFS_OPEN_MAX=7
```
