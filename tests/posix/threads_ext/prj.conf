## CMakeLists.txt
```
# SPDX-License-Identifier: Apache-2.0

cmake_minimum_required(VERSION 3.20.0)
find_package(Zephyr REQUIRED HINTS $ENV{ZEPHYR_BASE})
project(posix_threads_ext)

target_sources(app PRIVATE
  src/main.c
  ../shared/msleep.c
  ../shared/test_mutex_common.c
)

target_compile_options(app PRIVATE -U_POSIX_C_SOURCE -D_POSIX_C_SOURCE=200809L)
```

## prj.conf
```kconfig
CONFIG_ZTEST=y
CONFIG_POSIX_AEP_CHOICE_BASE=y
CONFIG_POSIX_THREADS_EXT=y
CONFIG_HEAP_MEM_POOL_SIZE=16384
CONFIG_COMMON_LIBC_MALLOC_ARENA_SIZE=16384
CONFIG_TEST_EXTRA_STACK_SIZE=4096
CONFIG_SIGNAL_QUEUE_SIZE=6
```

## src/main.c
```c
/*
 * Copyright (c) 2024, Meta
 *
 * SPDX-License-Identifier: Apache-2.0
 */

#include <pthread.h>

#include <zephyr/sys/util.h>
#include <zephyr/ztest.h>

#include "../../shared/linux_compat_test.h"

void test_mutex_common(int type);

#define BIOS_FOOD           0xB105F00D
#define SCHED_INVALID       4242
#define INVALID_DETACHSTATE 7373

static bool attr_valid;
static pthread_attr_t attr;
__maybe_unused static const pthread_attr_t uninit_attr;

ZTEST(posix_threads_ext, test_pthread_attr_getguardsize)
{
	size_t guardsize;

	/* degenerate cases */
	IF_NOT_NATIVE_LIBC({
		if (false) {
			/* undefined behaviour */
			zassert_equal(pthread_attr_getguardsize(NULL, NULL), EINVAL);
			zassert_equal(pthread_attr_getguardsize(NULL, &guardsize), EINVAL);
			zassert_equal(pthread_attr_getguardsize(&uninit_attr, &guardsize), EINVAL);
		}
		zassert_equal(pthread_attr_getguardsize(&attr, NULL), EINVAL);
	})

	guardsize = BIOS_FOOD;
	zassert_ok(pthread_attr_getguardsize(&attr, &guardsize));
	zassert_not_equal(guardsize, BIOS_FOOD);
}

ZTEST(posix_threads_ext, test_pthread_attr_setguardsize)
{
	size_t guardsize;

	zassert_ok(pthread_attr_getguardsize(&attr, &guardsize));

	/* valid values */
	size_t sizes[] = {
		0, guardsize / 2, guardsize, guardsize * 2, SIZE_MAX,
	};

	/* degenerate cases */
	{
		/* Fun fact! Linux (glibc, Ubuntu 24.04.3 LTS) segfaults with attr == NULL,
		 * and succeeds with an uninitialized attribute, so skipping those tests here
		 */
	}

	ARRAY_FOR_EACH(sizes, i) {
		zassert_ok(pthread_attr_setguardsize(&attr, sizes[i]));
		guardsize = ~sizes[i];
		zassert_ok(pthread_attr_getguardsize(&attr, &guardsize));
		zassert_equal(guardsize, sizes[i]);
	}
}

ZTEST(posix_threads_ext, test_pthread_mutexattr_gettype)
{
	int type;
	pthread_mutexattr_t attr;

	/* degenerate cases */
	IF_NOT_NATIVE_LIBC({
		if (false) {
			/* undefined behaviour */
			zassert_equal(EINVAL, pthread_mutexattr_gettype(&attr, &type));
		}
		zassert_equal(EINVAL, pthread_mutexattr_gettype(NULL, NULL));
		zassert_equal(EINVAL, pthread_mutexattr_gettype(NULL, &type));
		zassert_equal(EINVAL, pthread_mutexattr_gettype(&attr, NULL));
	})

	zassert_ok(pthread_mutexattr_init(&attr));
	zassert_ok(pthread_mutexattr_gettype(&attr, &type));
	zassert_equal(type, PTHREAD_MUTEX_DEFAULT);
	zassert_ok(pthread_mutexattr_destroy(&attr));
}

ZTEST(posix_threads_ext, test_pthread_mutexattr_settype)
{
	int type;
	pthread_mutexattr_t attr;

	/* degenerate cases */
	IF_NOT_NATIVE_LIBC({
		if (false) {
			/* undefined behaviour */
			zassert_equal(EINVAL,
				      pthread_mutexattr_settype(&attr, PTHREAD_MUTEX_DEFAULT));
		}
		zassert_equal(EINVAL, pthread_mutexattr_settype(NULL, 42));
		zassert_equal(EINVAL, pthread_mutexattr_settype(NULL, PTHREAD_MUTEX_NORMAL));
		zassert_equal(EINVAL, pthread_mutexattr_settype(&attr, 42));
	})

	zassert_ok(pthread_mutexattr_init(&attr));

	zassert_ok(pthread_mutexattr_settype(&attr, PTHREAD_MUTEX_DEFAULT));
	zassert_ok(pthread_mutexattr_gettype(&attr, &type));
	zassert_equal(type, PTHREAD_MUTEX_DEFAULT);

	zassert_ok(pthread_mutexattr_settype(&attr, PTHREAD_MUTEX_NORMAL));
	zassert_ok(pthread_mutexattr_gettype(&attr, &type));
	zassert_equal(type, PTHREAD_MUTEX_NORMAL);

	zassert_ok(pthread_mutexattr_settype(&attr, PTHREAD_MUTEX_RECURSIVE));
	zassert_ok(pthread_mutexattr_gettype(&attr, &type));
	zassert_equal(type, PTHREAD_MUTEX_RECURSIVE);

	zassert_ok(pthread_mutexattr_settype(&attr, PTHREAD_MUTEX_ERRORCHECK));
	zassert_ok(pthread_mutexattr_gettype(&attr, &type));
	zassert_equal(type, PTHREAD_MUTEX_ERRORCHECK);

	zassert_ok(pthread_mutexattr_destroy(&attr));

	test_mutex_common(PTHREAD_MUTEX_NORMAL);
	test_mutex_common(PTHREAD_MUTEX_RECURSIVE);
	test_mutex_common(PTHREAD_MUTEX_ERRORCHECK);
}

static void before(void *arg)
{
	ARG_UNUSED(arg);

	zassert_ok(pthread_attr_init(&attr));
	attr_valid = true;
}

static void after(void *arg)
{
	ARG_UNUSED(arg);

	if (attr_valid) {
		(void)pthread_attr_destroy(&attr);
		attr_valid = false;
	}
}

ZTEST_SUITE(posix_threads_ext, NULL, NULL, before, after, NULL);
```
