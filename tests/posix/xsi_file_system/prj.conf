## CMakeLists.txt
```
# SPDX-License-Identifier: Apache-2.0

cmake_minimum_required(VERSION 3.20.0)
find_package(Zephyr REQUIRED HINTS $ENV{ZEPHYR_BASE})
project(xsi_file_system)

FILE(GLOB app_sources src/*.c)
target_sources(app PRIVATE ${app_sources})

target_compile_options(app PRIVATE -U_POSIX_C_SOURCE -D_POSIX_C_SOURCE=200809L)
target_compile_options(app PRIVATE -U_XOPEN_SOURCE -D_XOPEN_SOURCE=700)
```

## prj.conf
```kconfig
CONFIG_ZTEST=y

CONFIG_POSIX_AEP_CHOICE_BASE=y
CONFIG_XSI=y
CONFIG_XSI_FILE_SYSTEM=y
# the group stands alone: the suite observes through ZVFS, not POSIX_FILE_SYSTEM
CONFIG_POSIX_FILE_SYSTEM=n

CONFIG_FILE_SYSTEM=y
CONFIG_FILE_SYSTEM_TMPFS=y
# the fixture plants symbolic links for realpath() and the walks to follow
CONFIG_FILE_SYSTEM_SYMLINKS=y

CONFIG_EVENTFD=n

# stdio (3) + a lock test file + the walk's directory streams
CONFIG_ZVFS_OPEN_IGNORE_MIN=y
CONFIG_ZVFS_OPEN_MAX=12
CONFIG_ZVFS_DIR_MAX=4

CONFIG_MAIN_STACK_SIZE=4096
# realpath() and the tree walk keep PATH_MAX buffers per level
CONFIG_ZTEST_STACK_SIZE=8192
CONFIG_TEST_EXTRA_STACK_SIZE=4096

CONFIG_HEAP_MEM_POOL_SIZE=16384
CONFIG_COMMON_LIBC_MALLOC_ARENA_SIZE=16384
```

## src/main.c
```c
/*
 * SPDX-FileCopyrightText: Copyright The Zephyr Project Contributors
 * SPDX-License-Identifier: Apache-2.0
 */

#include "xsi_file_system_tests.h"

#include <stdio.h>
#include <string.h>

#include <zephyr/fs/fs.h>
#include <zephyr/kernel.h>

#ifdef CONFIG_USERSPACE
extern struct k_mem_partition zvfs_dir_partition;
#endif

static struct fs_mount_t fs_mnt = {
	.type = FS_TMPFS,
	.mnt_point = "/",
};

static void tree_file(const char *path, const char *content)
{
	struct fs_file_t file;

	fs_file_t_init(&file);
	zassert_ok(fs_open(&file, path, FS_O_CREATE | FS_O_WRITE | FS_O_TRUNC));
	zassert_equal(fs_write(&file, content, strlen(content)), (ssize_t)strlen(content));
	zassert_ok(fs_close(&file));
}

/* removing an entry moves the ones behind it: take the first entry afresh each time */
static void tree_rmtree(const char *path)
{
	struct fs_dir_t dir;
	struct fs_dirent ent;
	char child[64];

	for (;;) {
		fs_dir_t_init(&dir);
		if (fs_opendir(&dir, path) != 0) {
			break;
		}
		ent.name[0] = '\0';
		(void)fs_readdir(&dir, &ent);
		(void)fs_closedir(&dir);
		if (ent.name[0] == '\0') {
			break;
		}
		if (snprintf(child, sizeof(child), "%s/%s", path, ent.name) >= (int)sizeof(child)) {
			break;
		}
		if (ent.type == FS_DIR_ENTRY_DIR) {
			tree_rmtree(child);
		} else {
			(void)fs_unlink(child);
		}
	}
	(void)fs_unlink(path);
}

static void before(void *arg)
{
	ARG_UNUSED(arg);

	tree_rmtree(TEST_ROOT);
	zassert_ok(fs_mkdir(TEST_ROOT));
	zassert_ok(fs_mkdir(TEST_DIR));
	zassert_ok(fs_mkdir(TEST_DEEP));
	zassert_ok(fs_mkdir(TEST_EMPTY));
	tree_file(TEST_FILE, TEST_CONTENT);
	tree_file(TEST_SUB, TEST_CONTENT);
	tree_file(TEST_LEAF, TEST_CONTENT);
	zassert_ok(fs_symlink("dir/sub.txt", TEST_LINK));
	zassert_ok(fs_symlink("nope", TEST_DANGLING));
}

static void *setup(void)
{
	zassert_ok(fs_mount(&fs_mnt));
	zassert_ok(fs_mkdir(FS_TMPDIR));
#ifdef CONFIG_USERSPACE
	zassert_ok(k_mem_domain_add_partition(&k_mem_domain_default, &zvfs_dir_partition));
#endif
	return NULL;
}

static void teardown(void *arg)
{
	ARG_UNUSED(arg);
	tree_rmtree(TEST_ROOT);
	(void)fs_unlink(FS_TMPDIR);
	(void)fs_unmount(&fs_mnt);
}

ZTEST_SUITE(xsi_file_system, NULL, setup, before, NULL, teardown);
```

## src/basename.c
```c
/*
 * SPDX-FileCopyrightText: Copyright The Zephyr Project Contributors
 * SPDX-License-Identifier: Apache-2.0
 */

#include "xsi_file_system_tests.h"

#include <libgen.h>
#include <string.h>

ZTEST_USER(xsi_file_system, test_basename)
{
	static const struct {
		const char *in;
		const char *out;
	} cases[] = {
		{"usr", "usr"},          {"usr/", "usr"},    {"", "."},          {"/", "/"},
		{"///", "/"},            {"//usr//lib//", "lib"}, {"/usr/", "usr"}, {"/usr/lib", "lib"},
	};
	char buf[32];

	ARRAY_FOR_EACH(cases, i) {
		strcpy(buf, cases[i].in);
		zassert_str_equal(basename(buf), cases[i].out, "basename(\"%s\")", cases[i].in);
	}
	zassert_str_equal(basename(NULL), ".");
}
```

## src/dirname.c
```c
/*
 * SPDX-FileCopyrightText: Copyright The Zephyr Project Contributors
 * SPDX-License-Identifier: Apache-2.0
 */

#include "xsi_file_system_tests.h"

#include <libgen.h>
#include <string.h>

ZTEST_USER(xsi_file_system, test_dirname)
{
	static const struct {
		const char *in;
		const char *out;
	} cases[] = {
		{"usr", "."},  {"usr/", "."},            {"", "."},        {"/", "/"},
		{"///", "/"},  {"//usr//lib//", "//usr"}, {"/usr/", "/"},   {"/usr/lib", "/usr"},
	};
	char buf[32];

	ARRAY_FOR_EACH(cases, i) {
		strcpy(buf, cases[i].in);
		zassert_str_equal(dirname(buf), cases[i].out, "dirname(\"%s\")", cases[i].in);
	}
	zassert_str_equal(dirname(NULL), ".");
}
```

## src/ftw.c
```c
/*
 * SPDX-FileCopyrightText: Copyright The Zephyr Project Contributors
 * SPDX-License-Identifier: Apache-2.0
 */

#include "xsi_file_system_tests.h"

#include <errno.h>
#include <ftw.h>
#include <libgen.h>
#include <limits.h>
#include <string.h>

#include <zephyr/sys/zvfs_fs.h>

struct walk_entry {
	char path[48];
	int flag;
	int level;
	int base;
};

ZTEST_BMEM static struct walk_entry seen[TEST_TREE_OBJECTS + 1];
ZTEST_BMEM static int nseen;
ZTEST_BMEM static int stop_after;
ZTEST_BMEM static int cwd_mismatches;

static void walk_reset(int stop)
{
	memset(seen, 0, sizeof(seen));
	nseen = 0;
	stop_after = stop;
	cwd_mismatches = 0;
}

static int walk_record(const char *path, int flag, int level, int base)
{
	if (nseen < (int)ARRAY_SIZE(seen)) {
		strncpy(seen[nseen].path, path, sizeof(seen[nseen].path) - 1);
		seen[nseen].flag = flag;
		seen[nseen].level = level;
		seen[nseen].base = base;
	}
	nseen++;

	return ((stop_after != 0) && (nseen >= stop_after)) ? 7 : 0;
}

static int ftw_cb(const char *path, const struct stat *st, int flag)
{
	ARG_UNUSED(st);

	return walk_record(path, flag, -1, -1);
}

static int nftw_cb(const char *path, const struct stat *st, int flag, struct FTW *ftwbuf)
{
	ARG_UNUSED(st);

	return walk_record(path, flag, ftwbuf->level, ftwbuf->base);
}

/* FTW_CHDIR: the working directory is the one holding the reported object */
static int chdir_cb(const char *path, const struct stat *st, int flag, struct FTW *ftwbuf)
{
	char cwd[PATH_MAX];
	char parent[PATH_MAX];

	ARG_UNUSED(st);

	strcpy(parent, path);
	if ((zvfs_getcwd(cwd, sizeof(cwd)) < 0) || (strcmp(cwd, dirname(parent)) != 0)) {
		cwd_mismatches++;
	}

	return walk_record(path, flag, ftwbuf->level, ftwbuf->base);
}

static const struct walk_entry *walk_find(const char *path)
{
	for (int i = 0; i < MIN(nseen, (int)ARRAY_SIZE(seen)); i++) {
		if (strcmp(seen[i].path, path) == 0) {
			return &seen[i];
		}
	}

	return NULL;
}

static void walk_expect(const char *path, int flag, int level)
{
	const struct walk_entry *e = walk_find(path);

	zassert_not_null(e, "%s not reported", path);
	zassert_equal(e->flag, flag, "%s: flag %d", path, e->flag);
	if (level >= 0) {
		zassert_equal(e->level, level, "%s: level %d", path, e->level);
		zassert_equal(e->base, (int)(strrchr(path, '/') - path) + 1, "%s: base %d", path,
			      e->base);
	}
}

/* the fixture tree, links followed */
static void walk_expect_tree(int level_known)
{
	int l = level_known ? 0 : -1;

	zassert_equal(nseen, TEST_TREE_OBJECTS, "%d objects reported", nseen);
	walk_expect(TEST_ROOT, FTW_D, l);
	walk_expect(TEST_FILE, FTW_F, level_known ? 1 : -1);
	walk_expect(TEST_DIR, FTW_D, level_known ? 1 : -1);
	walk_expect(TEST_SUB, FTW_F, level_known ? 2 : -1);
	walk_expect(TEST_DEEP, FTW_D, level_known ? 2 : -1);
	walk_expect(TEST_LEAF, FTW_F, level_known ? 3 : -1);
	walk_expect(TEST_EMPTY, FTW_D, level_known ? 1 : -1);
	walk_expect(TEST_LINK, FTW_F, level_known ? 1 : -1);
	walk_expect(TEST_DANGLING, FTW_SLN, level_known ? 1 : -1);
}

ZTEST_USER(xsi_file_system, test_ftw)
{
	walk_reset(0);
	zassert_ok(ftw(TEST_ROOT, ftw_cb, 8));
	walk_expect_tree(false);

	/* a file as the starting point */
	walk_reset(0);
	zassert_ok(ftw(TEST_FILE, ftw_cb, 8));
	zassert_equal(nseen, 1);
	walk_expect(TEST_FILE, FTW_F, -1);

	/* the callback's nonzero return ends the walk and is returned */
	walk_reset(3);
	zassert_equal(ftw(TEST_ROOT, ftw_cb, 8), 7);
	zassert_equal(nseen, 3);

	errno = 0;
	zassert_equal(ftw(TEST_NOENT, ftw_cb, 8), -1);
	zassert_equal(errno, ENOENT);
	errno = 0;
	zassert_equal(ftw(TEST_ROOT, ftw_cb, 0), -1);
	zassert_equal(errno, EINVAL);
	errno = 0;
	zassert_equal(ftw(TEST_ROOT, NULL, 8), -1);
	zassert_equal(errno, EINVAL);
}

ZTEST_USER(xsi_file_system, test_nftw)
{
	const struct walk_entry *e;

	walk_reset(0);
	zassert_ok(nftw(TEST_ROOT, nftw_cb, 8, 0));
	walk_expect_tree(true);

	/* FTW_PHYS reports the links themselves */
	walk_reset(0);
	zassert_ok(nftw(TEST_ROOT, nftw_cb, 8, FTW_PHYS));
	zassert_equal(nseen, TEST_TREE_OBJECTS);
	walk_expect(TEST_LINK, FTW_SL, 1);
	walk_expect(TEST_DANGLING, FTW_SL, 1);

	/* FTW_DEPTH reports a directory after its contents */
	walk_reset(0);
	zassert_ok(nftw(TEST_DIR, nftw_cb, 8, FTW_DEPTH));
	zassert_equal(nseen, 4);
	walk_expect(TEST_DIR, FTW_DP, 0);
	walk_expect(TEST_DEEP, FTW_DP, 1);
	e = &seen[nseen - 1];
	zassert_str_equal(e->path, TEST_DIR);
	zassert_true(walk_find(TEST_LEAF) < walk_find(TEST_DEEP), "deep before its leaf");

	/* one descriptor: directories are given up and returned to */
	walk_reset(0);
	zassert_ok(nftw(TEST_ROOT, nftw_cb, 1, 0));
	walk_expect_tree(true);

	/* FTW_MOUNT: one file system here, nothing is skipped */
	walk_reset(0);
	zassert_ok(nftw(TEST_ROOT, nftw_cb, 8, FTW_MOUNT));
	zassert_equal(nseen, TEST_TREE_OBJECTS);

	/* FTW_CHDIR: the callback runs in the object's directory; the caller's is restored */
	zassert_ok(zvfs_chdir(TEST_EMPTY));
	walk_reset(0);
	zassert_ok(nftw(TEST_ROOT, chdir_cb, 8, FTW_CHDIR | FTW_PHYS));
	zassert_equal(nseen, TEST_TREE_OBJECTS);
	zassert_equal(cwd_mismatches, 0);
	{
		char cwd[PATH_MAX];

		zassert_ok(zvfs_getcwd(cwd, sizeof(cwd)));
		zassert_str_equal(cwd, TEST_EMPTY);
	}

	/* a relative starting path keeps resolving from the caller's directory between callbacks */
	zassert_ok(zvfs_chdir(FS_TMPDIR));
	walk_reset(0);
	zassert_ok(nftw(TEST_REL_ROOT, nftw_cb, 8, FTW_CHDIR));
	zassert_equal(nseen, TEST_TREE_OBJECTS, "%d objects reported", nseen);
	walk_expect(TEST_REL_ROOT "/dir/sub.txt", FTW_F, 2);
	walk_expect(TEST_REL_ROOT "/dir/deep/leaf.txt", FTW_F, 3);
	walk_expect(TEST_REL_ROOT "/empty", FTW_D, 1);
	walk_reset(0);
	zassert_ok(nftw(TEST_REL_ROOT, nftw_cb, 1, FTW_CHDIR | FTW_DEPTH));
	zassert_equal(nseen, TEST_TREE_OBJECTS, "%d objects reported", nseen);
	walk_expect(TEST_REL_ROOT "/dir", FTW_DP, 1);
	zassert_ok(zvfs_chdir("/"));

	/* a directory that cannot be read is reported once, as FTW_DNR */
	{
		struct zvfs_dirstream *held[CONFIG_ZVFS_DIR_MAX];
		int n = 0;

		while ((n < (int)ARRAY_SIZE(held)) &&
		       ((held[n] = zvfs_opendir(TEST_EMPTY)) != NULL)) {
			n++;
		}
		zassert_equal(n, (int)ARRAY_SIZE(held), "%d directory streams", n);
		walk_reset(0);
		zassert_ok(nftw(TEST_ROOT, nftw_cb, 8, 0));
		zassert_equal(nseen, 1, "%d objects reported", nseen);
		walk_expect(TEST_ROOT, FTW_DNR, 0);
		while (n > 0) {
			zassert_ok(zvfs_close(held[--n]->fd));
		}
	}

	/* the callback's nonzero return ends the walk and is returned */
	walk_reset(3);
	zassert_equal(nftw(TEST_ROOT, nftw_cb, 8, 0), 7);
	zassert_equal(nseen, 3);

	errno = 0;
	zassert_equal(nftw(TEST_NOENT, nftw_cb, 8, 0), -1);
	zassert_equal(errno, ENOENT);
	errno = 0;
	zassert_equal(nftw(TEST_ROOT, nftw_cb, 0, 0), -1);
	zassert_equal(errno, EINVAL);
	errno = 0;
	zassert_equal(nftw(TEST_ROOT, nftw_cb, 8, 0x100), -1);
	zassert_equal(errno, EINVAL);
	errno = 0;
	zassert_equal(nftw("", nftw_cb, 8, 0), -1);
	zassert_equal(errno, ENOENT);
}
```

## src/lockf.c
```c
/*
 * SPDX-FileCopyrightText: Copyright The Zephyr Project Contributors
 * SPDX-License-Identifier: Apache-2.0
 */

#include "xsi_file_system_tests.h"

#include <errno.h>
#include <unistd.h>

#include <zephyr/sys/fdtable.h>
#include <zephyr/sys/zvfs.h>
#include <zephyr/sys/zvfs_fs.h>

ZTEST_USER(xsi_file_system, test_lockf)
{
	int fd = zvfs_openat(ZVFS_AT_FDCWD, TEST_FILE, ZVFS_O_RDWR, 0);

	zassert_true(fd >= 0, "errno %d", errno);

	/* from the offset to the end; the holder's own lock does not conflict */
	zassert_ok(lockf(fd, F_LOCK, 0));
	zassert_ok(lockf(fd, F_TEST, 0));
	zassert_ok(lockf(fd, F_TLOCK, 0));
	zassert_ok(lockf(fd, F_ULOCK, 0));

	/* a region before the offset */
	zassert_equal(zvfs_lseek(fd, 8, ZVFS_SEEK_SET), 8);
	zassert_ok(lockf(fd, F_TLOCK, -4));
	zassert_ok(lockf(fd, F_ULOCK, -4));
	errno = 0;
	zassert_equal(lockf(fd, F_LOCK, -16), -1);
	zassert_equal(errno, EINVAL);

	errno = 0;
	zassert_equal(lockf(fd, 42, 0), -1);
	zassert_equal(errno, EINVAL);
	zassert_ok(zvfs_close(fd));

	errno = 0;
	zassert_equal(lockf(-1, F_LOCK, 0), -1);
	zassert_equal(errno, EBADF);
}
```

## src/mknod.c
```c
/*
 * SPDX-FileCopyrightText: Copyright The Zephyr Project Contributors
 * SPDX-License-Identifier: Apache-2.0
 */

#include "xsi_file_system_tests.h"

#include <errno.h>
#include <sys/stat.h>

#include <zephyr/sys/fdtable.h>
#include <zephyr/sys/zvfs_fs.h>

ZTEST_USER(xsi_file_system, test_mknod)
{
	struct zvfs_stat st;

	zassert_ok(mknod(TEST_SCRATCH, S_IFIFO | 0644, 0));
	zassert_ok(zvfs_statat(ZVFS_AT_FDCWD, TEST_SCRATCH, &st, 0));
	zassert_equal(st.mode & ZVFS_MODE_IFMT, ZVFS_MODE_IFIFO);
	errno = 0;
	zassert_equal(mknod(TEST_SCRATCH, S_IFIFO | 0644, 0), -1);
	zassert_equal(errno, EEXIST);
	zassert_ok(zvfs_unlinkat(ZVFS_AT_FDCWD, TEST_SCRATCH, 0));

	/* a regular file, empty; no type at all is a regular file too */
	zassert_ok(mknod(TEST_SCRATCH, S_IFREG | 0644, 0));
	zassert_ok(zvfs_statat(ZVFS_AT_FDCWD, TEST_SCRATCH, &st, 0));
	zassert_equal(st.mode & ZVFS_MODE_IFMT, ZVFS_MODE_IFREG);
	zassert_equal(st.size, 0);
	zassert_ok(zvfs_unlinkat(ZVFS_AT_FDCWD, TEST_SCRATCH, 0));
	zassert_ok(mknod(TEST_SCRATCH, 0644, 0));
	zassert_ok(zvfs_statat(ZVFS_AT_FDCWD, TEST_SCRATCH, &st, 0));
	zassert_equal(st.mode & ZVFS_MODE_IFMT, ZVFS_MODE_IFREG);
	zassert_ok(zvfs_unlinkat(ZVFS_AT_FDCWD, TEST_SCRATCH, 0));

	/* no device special files exist to make */
	errno = 0;
	zassert_equal(mknod(TEST_SCRATCH, S_IFCHR | 0644, 0), -1);
	zassert_equal(errno, EINVAL);

	errno = 0;
	zassert_equal(mknod(TEST_NOENT "/x", S_IFREG | 0644, 0), -1);
	zassert_equal(errno, ENOENT);
}
```

## src/realpath.c
```c
/*
 * SPDX-FileCopyrightText: Copyright The Zephyr Project Contributors
 * SPDX-License-Identifier: Apache-2.0
 */

#include "xsi_file_system_tests.h"

#include <errno.h>
#include <limits.h>
#include <stdlib.h>
#include <string.h>

#include <zephyr/sys/zvfs_fs.h>

#define expect_path(in, out)                                                                       \
	do {                                                                                       \
		char *res = realpath(in, buf);                                                     \
		zassert_not_null(res, "realpath(\"%s\"): errno %d", in, errno);                    \
		zassert_str_equal(res, out, "realpath(\"%s\")", in);                               \
	} while (0)

ZTEST_USER(xsi_file_system, test_realpath)
{
	char buf[PATH_MAX];
	char *r;

	/* dot, dot-dot and repeated slashes */
	expect_path(TEST_ROOT "/dir/../dir/./sub.txt", TEST_SUB);
	expect_path(TEST_ROOT "//dir//", TEST_DIR);
	expect_path(FS_TMPDIR "/..", "/");
	expect_path("/", "/");

	/* a symbolic link on the way */
	expect_path(TEST_LINK, TEST_SUB);

	/* relative to the working directory */
	zassert_ok(zvfs_chdir(TEST_DIR));
	expect_path("sub.txt", TEST_SUB);
	expect_path("..", TEST_ROOT);
	expect_path(".", TEST_DIR);
	zassert_ok(zvfs_chdir("/"));

	/* no buffer: one is allocated */
	r = realpath(TEST_FILE, NULL);
	zassert_not_null(r);
	zassert_str_equal(r, TEST_FILE);
	free(r);

	errno = 0;
	zassert_is_null(realpath(TEST_NOENT, buf));
	zassert_equal(errno, ENOENT);
	errno = 0;
	zassert_is_null(realpath(TEST_DANGLING, buf));
	zassert_equal(errno, ENOENT);
	errno = 0;
	zassert_is_null(realpath(TEST_FILE "/x", buf));
	zassert_equal(errno, ENOTDIR);
	errno = 0;
	zassert_is_null(realpath("", buf));
	zassert_equal(errno, ENOENT);
	errno = 0;
	zassert_is_null(realpath(NULL, buf));
	zassert_equal(errno, EINVAL);
}
```

## src/seekdir.c
```c
/*
 * SPDX-FileCopyrightText: Copyright The Zephyr Project Contributors
 * SPDX-License-Identifier: Apache-2.0
 */

#include "xsi_file_system_tests.h"

#include <dirent.h>
#include <string.h>

#include <zephyr/sys/zvfs_fs.h>

ZTEST_USER(xsi_file_system, test_seekdir)
{
	char first[ZVFS_NAME_MAX + 1];
	char second[ZVFS_NAME_MAX + 1];
	DIR *d = test_opendir(TEST_DIR);

	zassert_not_null(d);
	zassert_equal(zvfs_readdir(d->fd, &d->ent), 0);
	strcpy(first, d->ent.d_name);
	zassert_equal(zvfs_readdir(d->fd, &d->ent), 0);
	strcpy(second, d->ent.d_name);
	zassert_equal(zvfs_readdir(d->fd, &d->ent), 1);

	/* back to a reported position, then forward again; past the end reads nothing */
	seekdir(d, 0);
	zassert_equal(zvfs_readdir(d->fd, &d->ent), 0);
	zassert_str_equal(d->ent.d_name, first);
	seekdir(d, 1);
	zassert_equal(zvfs_readdir(d->fd, &d->ent), 0);
	zassert_str_equal(d->ent.d_name, second);
	seekdir(d, 0);
	seekdir(d, 2);
	zassert_equal(zvfs_readdir(d->fd, &d->ent), 1);
	zassert_ok(zvfs_close(d->fd));

	/* no stream: nothing happens */
	seekdir(NULL, 0);
}
```

## src/sync.c
```c
/*
 * SPDX-FileCopyrightText: Copyright The Zephyr Project Contributors
 * SPDX-License-Identifier: Apache-2.0
 */

#include "xsi_file_system_tests.h"

#include <errno.h>
#include <string.h>
#include <unistd.h>

#include <zephyr/sys/fdtable.h>
#include <zephyr/sys/zvfs.h>
#include <zephyr/sys/zvfs_fs.h>

ZTEST_USER(xsi_file_system, test_sync)
{
	struct zvfs_stat st;
	int fd = zvfs_openat(ZVFS_AT_FDCWD, TEST_SCRATCH, ZVFS_O_RDWR | ZVFS_O_CREAT | ZVFS_O_EXCL,
			     0600);

	zassert_true(fd >= 0, "errno %d", errno);
	zassert_equal(zvfs_write(fd, TEST_CONTENT, strlen(TEST_CONTENT)), strlen(TEST_CONTENT));

	/* the buffered write reaches the file; errno is left alone */
	errno = 0;
	sync();
	zassert_equal(errno, 0);
	zassert_ok(zvfs_statat(ZVFS_AT_FDCWD, TEST_SCRATCH, &st, 0));
	zassert_equal(st.size, (off_t)strlen(TEST_CONTENT));

	zassert_ok(zvfs_close(fd));
	zassert_ok(zvfs_unlinkat(ZVFS_AT_FDCWD, TEST_SCRATCH, 0));

	/* nothing open: nothing to do */
	sync();
}
```

## src/telldir.c
```c
/*
 * SPDX-FileCopyrightText: Copyright The Zephyr Project Contributors
 * SPDX-License-Identifier: Apache-2.0
 */

#include "xsi_file_system_tests.h"

#include <dirent.h>
#include <errno.h>

#include <zephyr/sys/zvfs_fs.h>

ZTEST_USER(xsi_file_system, test_telldir)
{
	DIR *d = test_opendir(TEST_DIR);

	zassert_not_null(d);

	/* the position counts the entries read; a rewind resets it */
	zassert_equal(telldir(d), 0);
	zassert_equal(zvfs_readdir(d->fd, &d->ent), 0);
	zassert_equal(telldir(d), 1);
	zassert_equal(zvfs_readdir(d->fd, &d->ent), 0);
	zassert_equal(telldir(d), 2);
	zassert_ok(zvfs_rewinddir(d->fd));
	zassert_equal(telldir(d), 0);
	zassert_ok(zvfs_close(d->fd));

	errno = 0;
	zassert_equal(telldir(NULL), -1);
	zassert_equal(errno, EBADF);
}
```

## src/tempnam.c
```c
/*
 * SPDX-FileCopyrightText: Copyright The Zephyr Project Contributors
 * SPDX-License-Identifier: Apache-2.0
 */

#include "xsi_file_system_tests.h"

#include <errno.h>
#include <stdio.h>
#include <stdlib.h>
#include <string.h>

#include <zephyr/sys/zvfs_fs.h>

ZTEST_USER(xsi_file_system, test_tempnam)
{
	char *a = tempnam(TEST_DIR, "pfx");
	char *b = tempnam(TEST_DIR, "pfx");
	char *c;

	/* in the directory, with the prefix, naming nothing that exists */
	zassert_not_null(a);
	zassert_not_null(b);
	zassert_equal(strncmp(a, TEST_DIR "/pfx", strlen(TEST_DIR "/pfx")), 0, "%s", a);
	zassert_equal(strlen(a), strlen(TEST_DIR "/pfx") + 6);
	errno = 0;
	zassert_equal(zvfs_accessat(ZVFS_AT_FDCWD, a, ZVFS_F_OK, 0), -1);
	zassert_equal(errno, ENOENT);
	zassert_true(strcmp(a, b) != 0, "two names: %s", a);
	free(a);
	free(b);

	/* at most five characters of the prefix; no prefix at all */
	c = tempnam(TEST_DIR, "abcdefgh");
	zassert_not_null(c);
	zassert_equal(strncmp(c, TEST_DIR "/abcde", strlen(TEST_DIR "/abcde")), 0, "%s", c);
	zassert_equal(strlen(c), strlen(TEST_DIR "/abcde") + 6);
	free(c);
	c = tempnam(TEST_DIR, NULL);
	zassert_not_null(c);
	zassert_equal(strlen(c), strlen(TEST_DIR "/") + 6);
	free(c);

	/* no usable directory given: P_tmpdir */
	c = tempnam(NULL, "t");
	zassert_not_null(c);
	zassert_equal(strncmp(c, P_tmpdir "/t", strlen(P_tmpdir "/t")), 0, "%s", c);
	free(c);
	c = tempnam(TEST_NOENT, "t");
	zassert_not_null(c);
	zassert_equal(strncmp(c, P_tmpdir "/t", strlen(P_tmpdir "/t")), 0, "%s", c);
	free(c);
}
```

## src/xsi_file_system_tests.h
```c
/*
 * SPDX-FileCopyrightText: Copyright The Zephyr Project Contributors
 * SPDX-License-Identifier: Apache-2.0
 */

#ifndef POSIX_TESTS_XSI_FILE_SYSTEM_TESTS_H_
#define POSIX_TESTS_XSI_FILE_SYSTEM_TESTS_H_

#include <zephyr/sys/zvfs_fs.h>
#include <zephyr/ztest.h>

/*
 * The XSI File System option group stands alone: the fixture is built with the Zephyr file
 * system API in kernel mode, and the tests observe through ZVFS system calls, which every
 * POSIX file function bottoms out in, so the suite builds with the other groups off.
 */
#define FS_TMPDIR     "/tmp"
#define TEST_ROOT     FS_TMPDIR "/pxsifs"
/* TEST_ROOT, relative to FS_TMPDIR */
#define TEST_REL_ROOT "pxsifs"
#define TEST_FILE     TEST_ROOT "/file.txt"
#define TEST_DIR      TEST_ROOT "/dir"
#define TEST_SUB      TEST_DIR "/sub.txt"
#define TEST_DEEP     TEST_DIR "/deep"
#define TEST_LEAF     TEST_DEEP "/leaf.txt"
#define TEST_EMPTY    TEST_ROOT "/empty"
#define TEST_LINK     TEST_ROOT "/link"
#define TEST_DANGLING TEST_ROOT "/dangling"
#define TEST_NOENT    TEST_ROOT "/nope"
#define TEST_SCRATCH  TEST_ROOT "/scratch"
#define TEST_CONTENT  "The quick brown fox jumps over the lazy dog!"

/* objects nftw() finds below TEST_ROOT, the root included */
#define TEST_TREE_OBJECTS 9

#endif /* POSIX_TESTS_XSI_FILE_SYSTEM_TESTS_H_ */
```
