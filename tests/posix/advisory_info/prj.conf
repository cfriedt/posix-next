## CMakeLists.txt
```
# SPDX-License-Identifier: Apache-2.0

cmake_minimum_required(VERSION 3.20.0)
find_package(Zephyr REQUIRED HINTS $ENV{ZEPHYR_BASE})
project(posix_advisory_info)

FILE(GLOB app_sources src/*.c)
target_sources(app PRIVATE ${app_sources})

target_compile_options(app PRIVATE -U_POSIX_C_SOURCE -D_POSIX_C_SOURCE=200809L)
target_compile_options(app PRIVATE -U_XOPEN_SOURCE -D_XOPEN_SOURCE=700)
```

## prj.conf
```kconfig
CONFIG_ZTEST=y

CONFIG_POSIX_AEP_CHOICE_PSE52=y
CONFIG_POSIX_ADVISORY_INFO=y
# XSI provides the S_IF* constants and the XSI struct stat members
CONFIG_XSI=y

CONFIG_FILE_SYSTEM=y
CONFIG_FAT_FILESYSTEM_ELM=y

CONFIG_EVENTFD=n

# stdio (3) + fixture rw/ro (2) + scratch
CONFIG_ZVFS_OPEN_IGNORE_MIN=y
CONFIG_ZVFS_OPEN_MAX=12

CONFIG_MAIN_STACK_SIZE=4096
CONFIG_ZTEST_STACK_SIZE=4096
CONFIG_TEST_EXTRA_STACK_SIZE=4096

CONFIG_HEAP_MEM_POOL_SIZE=32768
CONFIG_COMMON_LIBC_MALLOC_ARENA_SIZE=32768
# posix_fallocate() accepts a shared memory object
CONFIG_POSIX_SHARED_MEMORY_OBJECTS=y
```

## src/main.c
```c
/*
 * SPDX-FileCopyrightText: Copyright The Zephyr Project Contributors
 * SPDX-License-Identifier: Apache-2.0
 */

#include "advisory_info_tests.h"

#include <fcntl.h>
#include <string.h>
#include <sys/stat.h>
#include <unistd.h>

#include <zephyr/kernel.h>
#ifndef CONFIG_NATIVE_LIBC
#include <ff.h>
#include <zephyr/fs/fs.h>
#endif
#ifdef CONFIG_USERSPACE
#include <zephyr/sys/fdtable.h>
#include <zephyr/sys/internal/fdtable_priv.h>
extern struct k_mem_partition zvfs_dir_partition;
#endif

ZTEST_BMEM int fs_test_fd = -1;
ZTEST_BMEM int fs_test_rofd = -1;
ZTEST_BMEM int fs_test_dirfd = -1;

#ifndef CONFIG_NATIVE_LIBC
static FATFS fat_fs;
static struct fs_mount_t fs_mnt = {
	.type = FS_FATFS,
	.mnt_point = "/",
	.fs_data = &fat_fs,
};
#endif

static void grant_fd(int fd)
{
#ifdef CONFIG_USERSPACE
	if (fd >= 0) {
		k_object_access_all_grant(zvfs_fd_entry_get(fd));
	}
#else
	ARG_UNUSED(fd);
#endif
}

static int open_granted(const char *path, int flags)
{
	int fd = open(path, flags);

	zassert_true(fd >= 0, "open(%s) failed: %d", path, errno);
	grant_fd(fd);
	return fd;
}

static void before(void *arg)
{
	int fd;

	ARG_UNUSED(arg);

	(void)unlink(TEST_FILE);
	(void)rmdir(TEST_ROOT);
	zassert_ok(mkdir(TEST_ROOT, 0777));
	fd = open(TEST_FILE, O_WRONLY | O_CREAT | O_TRUNC, 0600);
	zassert_true(fd >= 0);
	zassert_equal(write(fd, TEST_CONTENT, strlen(TEST_CONTENT)), strlen(TEST_CONTENT));
	zassert_ok(close(fd));

	fs_test_fd = open_granted(TEST_FILE, O_RDWR);
	fs_test_rofd = open_granted(TEST_FILE, O_RDONLY);
	fs_test_dirfd = open_granted(TEST_ROOT, O_RDONLY | O_DIRECTORY);
}

static void after(void *arg)
{
	int *fds[] = {&fs_test_fd, &fs_test_rofd, &fs_test_dirfd};

	ARG_UNUSED(arg);

	ARRAY_FOR_EACH_PTR(fds, fd) {
		if (**fd >= 0) {
			close(**fd);
			**fd = -1;
		}
	}
}

static void *setup(void)
{
#ifndef CONFIG_NATIVE_LIBC
	memset(&fat_fs, 0, sizeof(fat_fs));
	zassert_ok(fs_mount(&fs_mnt));
#endif
	(void)mkdir(FS_TMPDIR, 0777);
#ifdef CONFIG_USERSPACE
	zassert_ok(k_mem_domain_add_partition(&k_mem_domain_default, &zvfs_dir_partition));
#endif
	return NULL;
}

static void teardown(void *arg)
{
	ARG_UNUSED(arg);

	(void)unlink(TEST_FILE);
	(void)rmdir(TEST_ROOT);
#ifndef CONFIG_NATIVE_LIBC
	(void)fs_unmount(&fs_mnt);
#endif
}

ZTEST_SUITE(posix_advisory_info, NULL, setup, before, after, teardown);
```

## src/advisory_info_tests.h
```c
/*
 * SPDX-FileCopyrightText: Copyright The Zephyr Project Contributors
 * SPDX-License-Identifier: Apache-2.0
 */

#ifndef POSIX_TESTS_ADVISORY_INFO_TESTS_H_
#define POSIX_TESTS_ADVISORY_INFO_TESTS_H_

#include <zephyr/ztest.h>

#include "../../shared/linux_compat_test.h"

/*
 * The file system is mounted at "/", and /tmp exists in both worlds (the FAT
 * RAM disk under Zephyr, the host filesystem under CONFIG_NATIVE_LIBC), so
 * every path constant is identical for the linux_compat variant.
 */
#define FS_TMPDIR    "/tmp"
#define TEST_ROOT    FS_TMPDIR "/padv"
#define TEST_FILE    TEST_ROOT "/file.txt"
#define TEST_CONTENT "The quick brown fox jumps over the lazy dog!"

/* fixture descriptors, opened and granted per test */
extern int fs_test_fd;   /* TEST_FILE, O_RDWR */
extern int fs_test_rofd; /* TEST_FILE, O_RDONLY */
extern int fs_test_dirfd; /* TEST_ROOT, O_RDONLY */

#endif /* POSIX_TESTS_ADVISORY_INFO_TESTS_H_ */
```

## src/posix_fadvise.c
```c
/*
 * SPDX-FileCopyrightText: Copyright The Zephyr Project Contributors
 * SPDX-License-Identifier: Apache-2.0
 */

#include "advisory_info_tests.h"

#include <errno.h>
#include <fcntl.h>

ZTEST_USER(posix_advisory_info, test_posix_fadvise)
{
	static const int advice[] = {POSIX_FADV_NORMAL,   POSIX_FADV_RANDOM,
				     POSIX_FADV_SEQUENTIAL, POSIX_FADV_WILLNEED,
				     POSIX_FADV_DONTNEED,  POSIX_FADV_NOREUSE};

	/* every pattern, over a region, to the end, or the whole file, on any open mode */
	ARRAY_FOR_EACH(advice, i) {
		zassert_ok(posix_fadvise(fs_test_fd, 0, 16, advice[i]));
		zassert_ok(posix_fadvise(fs_test_fd, 8, 0, advice[i]));
		zassert_ok(posix_fadvise(fs_test_rofd, 0, 0, advice[i]));
	}

	/* a positive error number comes back, errno is not involved */
	zassert_equal(posix_fadvise(fs_test_fd, 0, 0, -1), EINVAL);
	zassert_equal(posix_fadvise(fs_test_fd, 0, 0, 4242), EINVAL);
	zassert_equal(posix_fadvise(-1, 0, 0, POSIX_FADV_NORMAL), EBADF);
	/* a negative region is rejected (the host takes it) */
	IF_NOT_NATIVE_LIBC({
		zassert_equal(posix_fadvise(fs_test_fd, -1, 0, POSIX_FADV_NORMAL), EINVAL);
		zassert_equal(posix_fadvise(fs_test_fd, 0, -1, POSIX_FADV_NORMAL), EINVAL);
	});
}
```

## src/posix_fallocate.c
```c
/*
 * SPDX-FileCopyrightText: Copyright The Zephyr Project Contributors
 * SPDX-License-Identifier: Apache-2.0
 */

#include "advisory_info_tests.h"

#include <errno.h>
#include <fcntl.h>
#include <string.h>
#include <sys/mman.h>
#include <sys/stat.h>
#include <unistd.h>

ZTEST_USER(posix_advisory_info, test_posix_fallocate)
{
	const size_t len = strlen(TEST_CONTENT);
	int ret;
	struct stat st;
	char buf[8];

	/* a region inside the file leaves it alone */
	zassert_ok(posix_fallocate(fs_test_fd, 0, len));
	zassert_ok(fstat(fs_test_fd, &st));
	zassert_equal(st.st_size, len);

	/* a region past the end extends it, with zeros */
	zassert_ok(posix_fallocate(fs_test_fd, len + 4, 8));
	zassert_ok(fstat(fs_test_fd, &st));
	zassert_equal(st.st_size, len + 12);
	zassert_equal(lseek(fs_test_fd, len, SEEK_SET), len);
	zassert_equal(read(fs_test_fd, buf, sizeof(buf)), sizeof(buf));
	zassert_mem_equal(buf, "\0\0\0\0\0\0\0\0", sizeof(buf));

	/* a shorter region never shrinks it */
	zassert_ok(posix_fallocate(fs_test_fd, 0, 1));
	zassert_ok(fstat(fs_test_fd, &st));
	zassert_equal(st.st_size, len + 12);

	if (IS_ENABLED(CONFIG_POSIX_SHARED_MEMORY_OBJECTS)) {
		/* a shared memory object is a file too; it is sized once */
		int shm = shm_open("/fallocate", O_CREAT | O_RDWR, 0600);

		zassert_true(shm >= 0, "shm_open() failed: %d", errno);
		zassert_ok(ftruncate(shm, 4096));
		ret = posix_fallocate(shm, 0, 4096);
		zassert_equal(ret, 0, "posix_fallocate() on a shared memory object: %d", ret);
		/* Zephyr sizes a shared memory object once; the host grows it */
		zassert_equal(posix_fallocate(shm, 0, 8192), IS_ENABLED(CONFIG_NATIVE_LIBC) ? 0 : EBUSY);
		zassert_ok(close(shm));
		zassert_ok(shm_unlink("/fallocate"));
	}

	zassert_equal(posix_fallocate(fs_test_fd, 0, 0), EINVAL);
	zassert_equal(posix_fallocate(fs_test_fd, -1, 8), EINVAL);
	zassert_equal(posix_fallocate(fs_test_fd, 0, -1), EINVAL);
	zassert_equal(posix_fallocate(-1, 0, 8), EBADF);
	/* not open for writing */
	zassert_equal(posix_fallocate(fs_test_rofd, 0, 8), EBADF);
}
```

## src/posix_madvise.c
```c
/*
 * SPDX-FileCopyrightText: Copyright The Zephyr Project Contributors
 * SPDX-License-Identifier: Apache-2.0
 */

#include "advisory_info_tests.h"

#include <errno.h>
#include <sys/mman.h>

/* the host wants page-aligned regions */
static ZTEST_BMEM __aligned(4096) char region[4096];

ZTEST_USER(posix_advisory_info, test_posix_madvise)
{
	static const int advice[] = {POSIX_MADV_NORMAL, POSIX_MADV_RANDOM, POSIX_MADV_SEQUENTIAL,
				     POSIX_MADV_WILLNEED, POSIX_MADV_DONTNEED};

	ARRAY_FOR_EACH(advice, i) {
		zassert_ok(posix_madvise(region, sizeof(region), advice[i]));
		zassert_ok(posix_madvise(region, 0, advice[i]));
	}

	zassert_equal(posix_madvise(region, sizeof(region), -1), EINVAL);
	zassert_equal(posix_madvise(region, sizeof(region), 4242), EINVAL);
}
```

## src/posix_memalign.c
```c
/*
 * SPDX-FileCopyrightText: Copyright The Zephyr Project Contributors
 * SPDX-License-Identifier: Apache-2.0
 */

#include "advisory_info_tests.h"

#include <errno.h>
#include <stdint.h>
#include <stdlib.h>
#include <string.h>

ZTEST_USER(posix_advisory_info, test_posix_memalign)
{
	static const size_t alignments[] = {sizeof(void *), 16, 64, 256, 4096};
	void *p;

	ARRAY_FOR_EACH(alignments, i) {
		p = NULL;
		zassert_ok(posix_memalign(&p, alignments[i], 100));
		zassert_not_null(p);
		zassert_equal((uintptr_t)p % alignments[i], 0, "%p not aligned to %zu", p,
			      alignments[i]);
		memset(p, 0x5a, 100);
		free(p);
	}

	/* a power of two that is a multiple of the pointer size, or nothing */
	zassert_equal(posix_memalign(&p, 3, 100), EINVAL);
	zassert_equal(posix_memalign(&p, sizeof(void *) / 2, 100), EINVAL);
	zassert_equal(posix_memalign(&p, 0, 100), EINVAL);
	zassert_equal(posix_memalign(&p, 16, SIZE_MAX - 1024), ENOMEM);
}
```
