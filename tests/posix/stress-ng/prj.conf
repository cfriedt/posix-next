## CMakeLists.txt
```
# SPDX-FileCopyrightText: Copyright The Zephyr Project Contributors
# SPDX-License-Identifier: Apache-2.0

cmake_minimum_required(VERSION 3.20.0)
find_package(Zephyr REQUIRED HINTS $ENV{ZEPHYR_BASE})
project(posix_stress_ng)

target_sources(app PRIVATE src/main.c)
```

## Kconfig
```
# SPDX-FileCopyrightText: Copyright The Zephyr Project Contributors
# SPDX-License-Identifier: Apache-2.0

config TEST_STRESS_NG_TIMEOUT
	int "Run time of each stressor in seconds"
	default 2
	help
	  Every stressor is run once, on its own thread, for this long (the
	  stress-ng --timeout), with verification enabled.

rsource "../Kconfig.test_common"
source "Kconfig.zephyr"
```

## prj.conf
```kconfig
CONFIG_ZTEST=y
# a POSIX program is a user process: the stressor runs on the test thread, in user mode
CONFIG_USERSPACE=y
CONFIG_TEST_USERSPACE=y
CONFIG_ZTEST_STACK_SIZE=131072

CONFIG_STRESS_NG=y

CONFIG_HEAP_MEM_POOL_SIZE=4194304
# the stressors malloc() freely; this is the libc arena, not the kernel heap: a
# 256 KiB start that grows by anonymous mappings, so a fork copies what a stressor
# uses rather than the largest heap any of them needs
CONFIG_COMMON_LIBC_MALLOC_ARENA_SIZE=262144
CONFIG_COMMON_LIBC_MALLOC_GROW=y
# and no further than the 2 MiB arena the stressors ran with: forkheavy's 3 MiB
# resource table is meant to fail, or it opens resources until the domain's
# partition slots are gone and no child can be forked
CONFIG_COMMON_LIBC_MALLOC_GROW_MAX=2097152

# temporary files on a tmpfs at /tmp (CONFIG_STRESS_NG_TEMP_PATH)
CONFIG_FILE_SYSTEM=y
CONFIG_FILE_SYSTEM_TMPFS=y
# many stressors map and open freely
CONFIG_ZVFS_MMAP_MAX=128
CONFIG_MAIN_STACK_SIZE=16384
# a random source for the net stack and getentropy() on boards without entropy hardware
CONFIG_TEST_RANDOM_GENERATOR=y
# default pthread stacks: stressor threads carry PATH_MAX buffers
CONFIG_SYS_THREAD_STACK_SIZE=16384
# stress-ng keeps its lock table in pthread spin locks on ARM
CONFIG_MAX_PTHREAD_SPINLOCK_COUNT=64
# stress-ng names files with a 64-bit random suffix
CONFIG_FILE_SYSTEM_MAX_FILE_NAME=64
# and nests them under a per-instance temp dir
CONFIG_ZVFS_PATH_MAX=256
CONFIG_PICOLIBC_IO_FLOAT=y
# fork copies megabytes and the stressors memcpy() freely: the byte-per-iteration
# string routines of the size-optimized library would dominate
CONFIG_LIBC_SPEED_OPTIMIZED=y
# system calls nest deep (file paths on the kernel stack, mapping and lock tables)
CONFIG_PRIVILEGED_STACK_SIZE=8192
# every granted mapping of a user thread is a partition of its memory domain
CONFIG_MAX_DOMAIN_PARTITIONS=64
# the kernel object hash table is sized from the first link; the many objects of a
# stress-ng image move it past the default 16-byte reserve
CONFIG_KOBJECT_RODATA_AREA_EXTRA_BYTES=256

# stressors assume Linux pipe capacity: session leaves one status record per
# iteration unread, and a 512-byte pipe fills in two seconds on a fast board
CONFIG_ZVFS_PIPE_BUF_SIZE=65536
# a POSIX process is preemptible: forked children inherit the test thread priority
CONFIG_ZTEST_THREAD_PRIORITY=0
```

## boards/mps2_an385.conf
```kconfig
CONFIG_HEAP_MEM_POOL_SIZE=524288
CONFIG_COMMON_LIBC_MALLOC_ARENA_SIZE=524288
CONFIG_ZVFS_MMAP_MAX=32
# 8-region MPU: stack guard + thread stack leave 3 domain slots; the stressor stack needs a 4th
CONFIG_TEST_USERSPACE_WITHOUT_HW_STACK_PROTECTION=y
```

## boards/qemu_cortex_a53.conf
```kconfig
CONFIG_MAX_XLAT_TABLES=32
CONFIG_KERNEL_VM_SIZE=0x1800000
```

## boards/qemu_riscv64.conf
```kconfig
CONFIG_MAX_XLAT_TABLES=64
CONFIG_KERNEL_VM_SIZE=0x1800000
```

## boards/qemu_x86_64_atom.conf
```kconfig
# anonymous mappings, pthread stacks and tmpfs pages all come from this; the sweeps ran with 24 MiB
CONFIG_KERNEL_VM_SIZE=0x1800000
```

## src/main.c
```c
/*
 * SPDX-FileCopyrightText: Copyright The Zephyr Project Contributors
 * SPDX-License-Identifier: Apache-2.0
 */

#include <stdio.h>

#include <stress_ng.h>

#include <zephyr/fs/fs.h>
#include <zephyr/ztest.h>

extern struct k_mem_partition zvfs_dir_partition;

static struct fs_mount_t tmp_mnt = {
	.type = FS_TMPFS,
	.mnt_point = CONFIG_STRESS_NG_TEMP_PATH,
};

static void *stress_ng_setup(void)
{
	zassert_ok(fs_mount(&tmp_mnt));
#if defined(CONFIG_USERSPACE) && defined(CONFIG_ZVFS_FS) && defined(CONFIG_MMU)
	/*
	 * Directory streams live in their own partition, as every file suite grants.
	 * An 8-region MPU has no slot left for it beside libc, malloc, ztest and the
	 * stressor stacks: there the stressors that read directories stay out.
	 */
	zassert_ok(k_mem_domain_add_partition(&k_mem_domain_default, &zvfs_dir_partition));
#endif

	return NULL;
}

/* a stressor that could not clean up after itself must not starve the next one */
static void tmp_wipe(const char *dir, int depth)
{
	struct fs_dir_t d;
	struct fs_dirent entry;
	char path[CONFIG_ZVFS_PATH_MAX];

	fs_dir_t_init(&d);
	if ((depth > 8) || (fs_opendir(&d, dir) != 0)) {
		return;
	}
	while ((fs_readdir(&d, &entry) == 0) && (entry.name[0] != '\0')) {
		if (snprintf(path, sizeof(path), "%s/%s", dir, entry.name) >= (int)sizeof(path)) {
			continue;
		}
		if (entry.type == FS_DIR_ENTRY_DIR) {
			tmp_wipe(path, depth + 1);
		}
		(void)fs_unlink(path);
	}
	(void)fs_closedir(&d);
}

static void stress_ng_after(void *fixture)
{
	ARG_UNUSED(fixture);
	tmp_wipe(CONFIG_STRESS_NG_TEMP_PATH, 0);
}

/* one test per stressor built in: run it once, with verification, for the configured time */
static void run_stressor(const char *name)
{
	const struct stress_ng_opts opts = {
		.timeout_s = CONFIG_TEST_STRESS_NG_TIMEOUT,
	};
	int rc = stress_ng_run(name, &opts);

	switch (rc) {
	case STRESS_NG_EXIT_SUCCESS:
		break;
	case STRESS_NG_EXIT_NOT_IMPLEMENTED:
	case STRESS_NG_EXIT_NO_RESOURCE:
		ztest_test_skip();
		break;
	default:
		zassert_equal(rc, STRESS_NG_EXIT_SUCCESS, "%s: %s", name, stress_ng_strexit(rc));
		break;
	}
}

#define STRESS_NG_STRESSOR(sym, name)                                                              \
	ZTEST_USER(stress_ng, test_##sym)                                                          \
	{                                                                                          \
		run_stressor(name);                                                                \
	}
#include <stress_ng_stressors.h>
#undef STRESS_NG_STRESSOR

ZTEST_SUITE(stress_ng, NULL, stress_ng_setup, NULL, stress_ng_after, NULL);
```
