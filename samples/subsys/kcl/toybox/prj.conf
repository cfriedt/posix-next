## CMakeLists.txt
```
# SPDX-FileCopyrightText: Copyright The Zephyr Project Contributors
# SPDX-License-Identifier: Apache-2.0

cmake_minimum_required(VERSION 3.20.0)
find_package(Zephyr REQUIRED HINTS $ENV{ZEPHYR_BASE})
project(kcl_linux_toybox)

# toybox as a Linux program: built for the host from a pristine export of the
# toybox module (its checkout carries the Zephyr platform patches), with the
# host's compiler and C library, static and position independent, so the
# sample only runs on the qemu target of the host's own architecture.
set(GUEST "" CACHE FILEPATH "A prebuilt static-pie toybox to run instead")
set(GUEST_APPLETS "" CACHE FILEPATH "The applets of a prebuilt toybox, one per line (default: ask it)")
if(GUEST)
  set(guest ${GUEST})
else()
  # toybox is a Linux program for the target: the host's own compiler when the
  # architectures agree, a Linux cross compiler with a static-PIE C library
  # otherwise
  if(CONFIG_X86_64)
    set(guest_cc_names x86_64-linux-gnu-gcc cc gcc)
  elseif(CONFIG_ARM64)
    set(guest_cc_names aarch64-linux-gnu-gcc)
  elseif(CONFIG_RISCV AND CONFIG_64BIT)
    set(guest_cc_names riscv64-linux-gnu-gcc)
  else()
    message(FATAL_ERROR "no Linux toybox build for this architecture")
  endif()
  find_program(HOST_CC NAMES ${guest_cc_names})
  if(NOT HOST_CC)
    message(FATAL_ERROR "Linux compiler for the target not found (one of: ${guest_cc_names}); "
                        "install the distribution's cross toolchain, or pass -DGUEST=<prebuilt>")
  endif()
  find_program(BUILD_CC NAMES cc gcc REQUIRED)
  find_program(GIT git REQUIRED)
  execute_process(COMMAND uname -srm OUTPUT_VARIABLE host_uname OUTPUT_STRIP_TRAILING_WHITESPACE)
  message(STATUS "toybox: compiled for the target with ${HOST_CC} on the build machine, ${host_uname}")
  if(NOT ZEPHYR_TOYBOX_MODULE_DIR)
    message(FATAL_ERROR "the toybox module is not in the workspace")
  endif()
  set(tb_src ${CMAKE_CURRENT_BINARY_DIR}/toybox-src)
  set(guest ${tb_src}/toybox)
  add_custom_command(
    OUTPUT ${guest}
    COMMAND ${CMAKE_COMMAND} -E rm -rf ${tb_src}
    COMMAND ${CMAKE_COMMAND} -E make_directory ${tb_src}
    COMMAND sh -c "${GIT} -C ${ZEPHYR_TOYBOX_MODULE_DIR} archive --format=tar HEAD | tar -x -C ${tb_src}"
    # the pending vi applet loses its buffer after :w (upstream toybox 0.8.14)
    COMMAND patch -s -p1 -d ${tb_src} -i ${CMAKE_CURRENT_SOURCE_DIR}/guest/vi-write-reload.patch
    COMMAND ${CMAKE_COMMAND} -E env --unset=CROSS_COMPILE CC=${HOST_CC} HOSTCC=${BUILD_CC}
            make -C ${tb_src} -s defconfig
    # the shell and the editor in, the applets that need libcrypt and /etc/shadow out
    COMMAND sed -i -E -e "s/^# CONFIG_SH is not set/CONFIG_SH=y/" -e "s/^# CONFIG_VI is not set/CONFIG_VI=y/"
                      -e "s/^CONFIG_(MKPASSWD|LOGIN|SU|PASSWD|CHSH|SULOGIN)=y/# CONFIG_\\1 is not set/" ${tb_src}/.config
    COMMAND ${CMAKE_COMMAND} -E env --unset=CROSS_COMPILE CC=${HOST_CC} HOSTCC=${BUILD_CC}
            CFLAGS=-fPIE LDFLAGS=-static-pie make -C ${tb_src} -s
    # the applets it was built with, from the build's own host-side lister
    COMMAND sh -c "${CMAKE_COMMAND} -E env --unset=CROSS_COMPILE CC=${HOST_CC} HOSTCC=${BUILD_CC} make -C ${tb_src} -s list | tr ' ' '\\n' | grep . > ${tb_src}/applets.txt"
    DEPENDS ${ZEPHYR_TOYBOX_MODULE_DIR}/toys.h ${ZEPHYR_TOYBOX_MODULE_DIR}/main.c
            ${CMAKE_CURRENT_SOURCE_DIR}/guest/vi-write-reload.patch
    COMMENT "Building toybox for the target with ${HOST_CC}"
    VERBATIM
  )
  set(GUEST_APPLETS ${tb_src}/applets.txt)
endif()
# the applets: a list file, else what toybox prints when run without arguments
set(commands_inc ${ZEPHYR_BINARY_DIR}/include/generated/toybox_commands.inc)
if(GUEST_APPLETS)
  set(list_applets "cat ${GUEST_APPLETS}")
else()
  set(list_applets ${guest})
endif()
add_custom_command(
  OUTPUT ${commands_inc}
  COMMAND sh -c "${list_applets} | tr ' ' '\\n' | grep . | sed 's/.*/\"&\",/' > ${commands_inc}"
  DEPENDS ${guest}
  COMMENT "Listing the toybox applets"
  VERBATIM
)
# stripped and compressed: the image carries the .xz stream and inflates it
# into the root file system at boot (a dictionary the size of the data loses
# nothing against a larger one and is what the decoder allocates)
find_program(XZ xz REQUIRED)
set(guest_xz ${CMAKE_CURRENT_BINARY_DIR}/toybox.xz)
add_custom_command(
  OUTPUT ${guest_xz}
  COMMAND ${CMAKE_STRIP} -o ${guest_xz}.elf ${guest}
  COMMAND sh -c "${XZ} --format=xz --check=crc32 --lzma2=preset=9e,dict=2MiB -c ${guest_xz}.elf > ${guest_xz}"
  DEPENDS ${guest}
  COMMENT "Stripping and compressing toybox"
  VERBATIM
)
add_custom_target(guest DEPENDS ${guest} ${guest_xz} ${commands_inc})
add_dependencies(app guest)

target_sources(app PRIVATE src/main.c src/fatal.c)
target_sources_ifdef(CONFIG_TRACING_USER app PRIVATE ../hello/src/trace.c)
generate_inc_file_for_target(app ${guest_xz} ${ZEPHYR_BINARY_DIR}/include/generated/toybox.inc)
generate_inc_file_for_target(app ${CMAKE_CURRENT_SOURCE_DIR}/guest/demo.sh
                             ${ZEPHYR_BINARY_DIR}/include/generated/demo_sh.inc)
```

## Kconfig
```
# SPDX-FileCopyrightText: Copyright The Zephyr Project Contributors
# SPDX-License-Identifier: Apache-2.0

mainmenu "toybox for Linux on Zephyr"

config KCL_LINUX_TOYBOX_COMMAND
	string "Command line for the shell"
	default ""
	help
	  Run toysh on this command line (sh -c "...") instead of an
	  interactive shell on the console. The installed /root/demo.sh
	  tours the applets and ends in the interactive shell.

config KCL_LINUX_TOYBOX_PROMPT_LINE
	bool "End the interactive shell's first prompt line"
	help
	  Print a line a few seconds after the shell starts. The console
	  test harness reads whole lines, so the shell's prompt, which
	  ends without a newline, is only seen when something follows it.

source "Kconfig.zephyr"
```

## sample.yaml
```
sample:
  description: run toybox, built for Linux with the host's compiler, with an interactive shell
  name: kcl linux toybox
common:
  tags:
    - kcl
    - posix
  # the guest is a Linux program for the target: the host's own compiler, or a
  # Linux cross toolchain with a static-PIE C library (see the README)
  platform_allow:
    - qemu_x86_64
    - qemu_cortex_a53
    - qemu_riscv64
  integration_platforms:
    - qemu_x86_64
  harness: console
  timeout: 420
tests:
  sample.kcl.toybox:
    # the interactive shell: its prompt has no newline, so a line is printed after it
    extra_configs:
      - CONFIG_KCL_LINUX_TOYBOX_PROMPT_LINE=y
    harness_config:
      type: multi_line
      ordered: true
      regex:
        - "running sh interactively"
        - "^\\$ toybox shell is up"
  sample.kcl.toybox.demo:
    # the tour in /root/demo.sh: commands, pipelines, files, links, FIFOs, a
    # signal-ended child and loopback pings, then the interactive shell
    extra_configs:
      - CONFIG_KCL_LINUX_TOYBOX_COMMAND="sh /root/demo.sh"
    harness_config:
      type: multi_line
      ordered: true
      regex:
        - "running sh -c"
        - "^jello, world!"
        - "^Linux zephyr .* Toybox"
        - "^zephyr$"
        - "^0$"
        - "^0$"
        - "^foo.txt$"
        - "^/tmp$"
        - "^/bin/toybox: ELF"
        - "^/: directory"
        - "^/tmp/foo.txt: ASCII text"
        - "tmp\\."
        - "^jello, world!"
        - "foo -> /tmp/foo.txt"
        - "^/tmp/foo.txt$"
        - "^/tmp/foo$"
        - "^/tmp/foo.txt$"
        - "^prw.* /tmp/fifo"
        - "^through the fifo"
        - "^prw.* /tmp/pipe"
        - "^1$"
        - "^2$"
        - "^[0-9]+$"
        - "3 packets transmitted, 3 received"
        - "64 bytes from ::1"
        - "3 packets transmitted, 3 received"
        - "^signal status 143"
        - "^demo complete"
```

## prj.conf
```kconfig
# SPDX-FileCopyrightText: Copyright The Zephyr Project Contributors
# SPDX-License-Identifier: Apache-2.0

CONFIG_USERSPACE=y
# nothing of the POSIX API: the layer selects the services it is built on
CONFIG_POSIX_AEP_CHOICE_NONE=y

# loopback networking, host-independent (see samples/posix/toybox)
CONFIG_NETWORKING=y
CONFIG_NET_TEST=y
CONFIG_NET_DRIVERS=y
CONFIG_NET_LOOPBACK=y
CONFIG_NET_IPV4=y
CONFIG_NET_IPV6=y
CONFIG_NET_SOCKETS=y
CONFIG_NET_SOCKETS_INET_RAW=y
CONFIG_NET_TX_STACK_SIZE=8192
CONFIG_NET_RX_STACK_SIZE=8192
CONFIG_SYSTEM_WORKQUEUE_STACK_SIZE=4096

# the Linux kernel compatibility layer, for the executable's system calls
CONFIG_KCL=y
CONFIG_KCL_LINUX=y

# toysh runs its commands in fork()ed children
CONFIG_PROCESS_VM=y
CONFIG_CURRENT_THREAD_USE_TLS=n

CONFIG_LLEXT=y
CONFIG_LLEXT_TYPE_ELF_RELOCATABLE=y
CONFIG_LLEXT_HEAP_SIZE=16

# the root file system lives in pages mapped as it fills; the guest arrives
# in it from the image's .xz stream
CONFIG_FILE_SYSTEM=y
CONFIG_FILE_SYSTEM_TMPFS=y
CONFIG_XZ_DEC=y
# random bytes for the executable's AT_RANDOM and its getrandom()
CONFIG_TEST_RANDOM_GENERATOR=y
CONFIG_ZVFS_STDIN_CONSOLE=y
CONFIG_ZVFS_PIPE=y
CONFIG_ZVFS_PIPE_MAX=8
# Linux-sized pipe buffers: toysh keeps a pipeline's read end open as its own
# stdin until the pipeline is done, so a writer must not have to wait for it
CONFIG_ZVFS_PIPE_BUF_SIZE=65536
CONFIG_ZVFS_OPEN_MAX=32
CONFIG_ZVFS_PROC_OPEN_MAX=16

CONFIG_SYS_PROCESS_MIN=16
CONFIG_SYS_PROCESS_MAX=64
CONFIG_SYS_THREAD_THREAD_MAX=8
CONFIG_SYS_THREAD_STACK_MAX=8
CONFIG_SYS_THREAD_STACK_SIZE=8192
CONFIG_PRIVILEGED_STACK_SIZE=8192
CONFIG_MAIN_STACK_SIZE=8192
CONFIG_MAX_DOMAIN_PARTITIONS=16
# permission indexes: one per process, the option groups' own threads included
CONFIG_MAX_THREAD_BYTES=8
# the 2 MiB toybox, its copy in the file system, the heap it and its forks live in
CONFIG_HEAP_MEM_POOL_SIZE=25165824
```

## boards/qemu_cortex_a53.conf
```kconfig
# SPDX-FileCopyrightText: Copyright The Zephyr Project Contributors
# SPDX-License-Identifier: Apache-2.0

# the board maps 8 MiB by default: the heap, the RAM disk and the process
# tree's copied memory need more
CONFIG_KERNEL_VM_SIZE=0x6000000
CONFIG_MAX_XLAT_TABLES=512
# Linux executables use the SIMD and floating-point registers
CONFIG_FPU=y
CONFIG_FPU_SHARING=y
```

## boards/qemu_riscv64.conf
```kconfig
# SPDX-FileCopyrightText: Copyright The Zephyr Project Contributors
# SPDX-License-Identifier: Apache-2.0

# the board maps 8 MiB by default: the heap, the RAM disk and the process
# tree's copied memory need more
CONFIG_KERNEL_VM_SIZE=0x6000000
CONFIG_MAX_XLAT_TABLES=512
# Linux executables use the floating-point registers (lp64d)
CONFIG_FPU=y
CONFIG_FPU_SHARING=y
```

## boards/qemu_x86_64.conf
```kconfig
# SPDX-FileCopyrightText: Copyright The Zephyr Project Contributors
# SPDX-License-Identifier: Apache-2.0

# per-process address spaces need the kernel out of the user page tables
CONFIG_X86_KPTI=n
# every process is a memory domain whose page tables come from a pool that
# never shrinks, and each VM-cloned child copies its parent's writable
# memory: give the process tree room (64 MiB of RAM: boards/qemu_x86_64.overlay)
CONFIG_X86_MAX_ADDITIONAL_MEM_DOMAINS=32
CONFIG_KERNEL_VM_SIZE=0x5000000
```

## boards/qemu_x86_64.overlay
```dts
/*
 * SPDX-FileCopyrightText: Copyright The Zephyr Project Contributors
 *
 * SPDX-License-Identifier: Apache-2.0
 */

/* 64 MiB: the process tree's page tables and copied frames live here */
&dram0 {
	reg = <0x0 DT_SIZE_M(64)>;
};
```

## src/main.c
```c
/*
 * SPDX-FileCopyrightText: Copyright The Zephyr Project Contributors
 * SPDX-License-Identifier: Apache-2.0
 */

#include <stdio.h>
#include <string.h>

#include <zephyr/fs/fs.h>
#include <zephyr/kernel.h>
#include <zephyr/sys/process.h>
#include <zephyr/sys/thread.h>
#include <zephyr/xz/extract.h>

#define TOYBOX_PATH "/bin/toybox"

/* the root: pages mapped as it fills, nothing of it in the image */
static struct fs_mount_t root_mnt = {
	.type = FS_TMPFS,
	.mnt_point = "/",
};

/* toybox, stripped and compressed; inflated into the root at boot */
static const uint8_t toybox_xz[] __aligned(8) = {
#include "toybox.inc"
};

static const unsigned char demo_script[] = {
#include "demo_sh.inc"
};

static int write_file(const char *path, const void *data, size_t len)
{
	struct fs_file_t f;
	int ret;

	fs_file_t_init(&f);
	ret = fs_open(&f, path, FS_O_CREATE | FS_O_WRITE);
	if (ret < 0) {
		printf("creating %s failed: %d\n", path, ret);
		return ret;
	}
	for (size_t off = 0; off < len;) {
		ssize_t n = fs_write(&f, (const uint8_t *)data + off, MIN(1024, len - off));

		if (n <= 0) {
			printf("writing %s at %zu failed: %zd\n", path, off, n);
			ret = -1;
			break;
		}
		off += n;
	}
	(void)fs_close(&f);

	return (ret < 0) ? ret : 0;
}

/* toybox dispatches on the name it was invoked by: /bin/<applet> -> toybox */
static const char *const applets[] = {
#include "toybox_commands.inc"
};

static int populate(void)
{
	static const char passwd[] = "root:x:0:0:root:/root:/bin/sh\n";
	static const char group[] = "root:x:0:\n";
	static const char motd[] = "Hello from toybox for Linux on Zephyr!\n";
	static const char hostname[] = "zephyr\n";
	static const char hosts[] = "127.0.0.1 localhost\n::1 localhost ip6-localhost\n";
	static const char nsswitch[] = "hosts: files\n";
	long n;
	int ret;

	ret = fs_mount(&root_mnt);
	if (ret < 0) {
		printf("mount failed: %d\n", ret);
		return ret;
	}
	(void)fs_mkdir("/bin");
	(void)fs_mkdir("/etc");
	(void)fs_mkdir("/tmp");
	(void)fs_mkdir("/root");
	if ((write_file("/etc/passwd", passwd, strlen(passwd)) < 0) ||
	    (write_file("/etc/group", group, strlen(group)) < 0) ||
	    (write_file("/etc/motd", motd, strlen(motd)) < 0) ||
	    (write_file("/etc/hostname", hostname, strlen(hostname)) < 0) ||
	    (write_file("/etc/hosts", hosts, strlen(hosts)) < 0) ||
	    (write_file("/etc/nsswitch.conf", nsswitch, strlen(nsswitch)) < 0) ||
	    (write_file("/root/demo.sh", demo_script, sizeof(demo_script)) < 0)) {
		return -1;
	}
	n = xz_extract(toybox_xz, sizeof(toybox_xz), TOYBOX_PATH);
	if (n < 0) {
		printf("extracting %s failed: %ld\n", TOYBOX_PATH, n);
		return (int)n;
	}
	printf("toybox for Linux: %zu bytes compressed, %ld at %s\n", sizeof(toybox_xz), n,
	       TOYBOX_PATH);
	for (size_t i = 0; i < ARRAY_SIZE(applets); i++) {
		char path[48];

		(void)snprintf(path, sizeof(path), "/bin/%s", applets[i]);
		ret = fs_symlink("toybox", path);
		if (ret < 0) {
			printf("linking %s failed: %d\n", path, ret);
			return ret;
		}
	}
	printf("%zu applets linked in /bin\n", ARRAY_SIZE(applets));

	return 0;
}

/* the shell starts with nothing blocked, as it would on Linux */
static const struct k_sig_set nothing_blocked;

static int spawn(k_pid_t *child, const char *path, char *const argv[], char *const envp[])
{
	struct sys_clone_args args = {
		.flags = SYS_CLONE_PAUSED,
		.prio = k_thread_priority_get(k_current_get()),
		.options = K_USER,
		.sigmask = &nothing_blocked,
		.argv = argv,
		.envp = envp,
	};
	int ret;

	ret = sys_clone(&args, child);
	if (ret < 0) {
		return ret;
	}
	/* the image is loaded into the paused leader, then it is released */
	ret = sys_exec_load(*child, path);
	if (ret < 0) {
		k_thread_abort(*child);
		(void)k_waitpid(*child, NULL, NULL, 0, K_FOREVER);
		return ret;
	}
	k_thread_start(*child);

	return 0;
}

int main(void)
{
	static char *const envp[] = {"PATH=/bin", "HOME=/root", "USER=root", "TERM=vt100", NULL};
	char *const interactive[] = {"sh", "-i", NULL};
	char *const scripted[] = {"sh", "-c", CONFIG_KCL_LINUX_TOYBOX_COMMAND, NULL};
	char *const *argv = (CONFIG_KCL_LINUX_TOYBOX_COMMAND[0] != '\0') ? scripted : interactive;
	int status = 0;
	k_pid_t pid;
	int ret;

	if (populate() < 0) {
		return -1;
	}
	printf("running sh%s\n", (argv == scripted) ? " -c" : " interactively");

	ret = spawn(&pid, "/bin/sh", argv, envp);
	if (ret < 0) {
		printf("spawning /bin/sh failed: %d\n", ret);
		return ret;
	}
	if (IS_ENABLED(CONFIG_KCL_LINUX_TOYBOX_PROMPT_LINE) && (argv == interactive)) {
		k_sleep(K_SECONDS(5));
		printf("toybox shell is up\n");
	}
	ret = k_waitpid(pid, NULL, &status, 0, K_FOREVER);
	if (ret < 0) {
		printf("waiting for sh failed: %d\n", ret);
		return ret;
	}
	if (K_WIFEXITED(status)) {
		printf("sh exited with status %d\n", K_WEXITSTATUS(status));
	} else if (K_WIFSIGNALED(status)) {
		printf("sh killed by signal %d\n", K_WTERMSIG(status));
	}
	printf("kcl linux toybox sample complete\n");

	return 0;
}
```

## src/fatal.c
```c
/*
 * SPDX-FileCopyrightText: Copyright The Zephyr Project Contributors
 * SPDX-License-Identifier: Apache-2.0
 */

/*
 * A crashing program is not a crashing system: a fatal error in a user-mode
 * thread only ends that thread's process, as a signal would on Linux. Its
 * descriptors close here and now, so that the other end of a pipe sees the
 * end of the stream before the process is reaped. Anything else halts the
 * system as usual.
 */

#include <stdio.h>

#include <zephyr/kernel.h>
#include <zephyr/logging/log_ctrl.h>
#include <zephyr/sys/process.h>
#include <zephyr/sys/zvfs.h>

void k_sys_fatal_error_handler(unsigned int reason, const struct arch_esf *esf)
{
	k_tid_t self = k_current_get();

	ARG_UNUSED(esf);
	if ((reason != K_ERR_KERNEL_PANIC) && ((self->base.user_options & K_USER) != 0U)) {
		printf("process %d: fatal error %u, terminated\n", sys_process_id(k_getpid()),
		       reason);
		for (int fd = 0; fd < CONFIG_ZVFS_OPEN_MAX; fd++) {
			(void)zvfs_close(fd);
		}
		return;
	}
	LOG_PANIC();
	printf("Halting system\n");
	k_fatal_halt(reason);
}
```
