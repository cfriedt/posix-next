## tests/posix/clock_selection/testcase.yaml
```yaml
common:
  tags:
    - posix_clock_selection
  # 1 tier0 platform per supported architecture
  platform_key:
    - arch
    - simulation
  min_flash: 64
  min_ram: 32
tests:
  portability.posix.clock_selection:
    filter: not CONFIG_NATIVE_LIBC
  portability.posix.clock_selection.minimal:
    filter: not CONFIG_NATIVE_LIBC
    extra_configs:
      - CONFIG_MINIMAL_LIBC=y
  portability.posix.clock_selection.newlib:
    filter: (not CONFIG_NATIVE_LIBC) and (TOOLCHAIN_HAS_NEWLIB == 1)
    extra_configs:
      - CONFIG_NEWLIB_LIBC=y
      - CONFIG_NEWLIB_LIBC_MIN_REQUIRED_HEAP_SIZE=8192
  portability.posix.clock_selection.picolibc:
    tags: picolibc
    filter: (not CONFIG_NATIVE_LIBC) and CONFIG_PICOLIBC_SUPPORTED
    extra_configs:
      - CONFIG_PICOLIBC=y
  portability.posix.clock_selection.linux_compat:
    tags: native
    platform_allow:
      - native_sim
      - native_sim/native/64
    filter: CONFIG_NATIVE_LIBC
    extra_configs:
      - CONFIG_POSIX_TEST_LINUX_COMPAT=y
```
