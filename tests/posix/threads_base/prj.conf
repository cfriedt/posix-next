## CMakeLists.txt
```
# SPDX-License-Identifier: Apache-2.0

cmake_minimum_required(VERSION 3.20.0)
find_package(Zephyr REQUIRED HINTS $ENV{ZEPHYR_BASE})
project(posix_threads_base)

file(GLOB app_sources src/*.c)
zephyr_include_directories(${CMAKE_CURRENT_SOURCE_DIR}/../../../lib/posix)

target_sources(app PRIVATE
  ${app_sources}
  ../common/msleep.c
  ../common/test_sigmask_common.c
)

target_include_directories(app PRIVATE
  ${ZEPHYR_POSIX_NEXT_MODULE_DIR}/lib/posix/options/timers
  ${ZEPHYR_POSIX_NEXT_MODULE_DIR}/lib/posix/options/shared
)

target_compile_options(app PRIVATE -U_POSIX_C_SOURCE -D_POSIX_C_SOURCE=200809L)
target_compile_options(app PRIVATE -U_XOPEN_SOURCE -D_XOPEN_SOURCE=700)
```

## Kconfig
```
# Copyright (c) 2023, Meta
# SPDX-License-Identifier: Apache-2.0

rsource "../Kconfig.test_common"
source "Kconfig.zephyr"
```

## prj.conf
```kconfig
CONFIG_POSIX_AEP_CHOICE_PSE51=y
CONFIG_ZTEST=y
CONFIG_POSIX_THREAD_PRIORITY_SCHEDULING=y
CONFIG_POSIX_THREAD_ATTR_STACKSIZE=y
CONFIG_POSIX_THREAD_PROCESS_SHARED=y
CONFIG_HEAP_MEM_POOL_SIZE=16384
CONFIG_COMMON_LIBC_MALLOC_ARENA_SIZE=16384
CONFIG_THREAD_STACK_INFO=y
CONFIG_THREAD_SPECIFIC_STORAGE_KEYS_MAX=3
CONFIG_TEST_EXTRA_STACK_SIZE=4096
CONFIG_SIGNAL_QUEUE_SIZE=6

CONFIG_SYS_THREAD_STACK_MIN_ADD_TEST=6
CONFIG_SYS_THREAD_THREAD_MIN_ADD_TEST=6
CONFIG_POSIX_THREAD_ATFORK_MAX=2
```

## prj_nosignal.conf
```kconfig
CONFIG_POSIX_AEP_CHOICE_PSE51=y
CONFIG_ZTEST=y
CONFIG_POSIX_THREAD_PRIORITY_SCHEDULING=y
CONFIG_POSIX_THREAD_ATTR_STACKSIZE=y
CONFIG_POSIX_THREAD_PROCESS_SHARED=y
CONFIG_HEAP_MEM_POOL_SIZE=16384
CONFIG_COMMON_LIBC_MALLOC_ARENA_SIZE=16384
CONFIG_THREAD_STACK_INFO=y
CONFIG_THREAD_SPECIFIC_STORAGE_KEYS_MAX=3
CONFIG_TEST_EXTRA_STACK_SIZE=4096

CONFIG_SYS_THREAD_STACK_MIN_ADD_TEST=6
CONFIG_SYS_THREAD_THREAD_MIN_ADD_TEST=6
CONFIG_POSIX_THREAD_ATFORK_MAX=2

# the threads group without the signal subsystem: pthread_kill() and pthread_sigmask() fail with ENOTSUP
CONFIG_SIGNAL=n
CONFIG_POSIX_SIGNALS=n
CONFIG_POSIX_REALTIME_SIGNALS=n
```

## src/_common.c
```c
/*
 * Copyright (c) 2024, Meta
 *
 * SPDX-License-Identifier: Apache-2.0
 */

#include "../../shared/linux_compat_test.h"
#include "_main.h"

#include <pthread.h>

#include <zephyr/kernel.h>
#include <zephyr/sys/util.h>
#include <zephyr/ztest.h>

ZTEST_BMEM pthread_attr_t test_attr;
ZTEST_BMEM bool test_attr_valid;
const pthread_attr_t uninit_attr;
static ZTEST_BMEM bool detached_thread_has_finished;

static void *thread_entry(void *arg)
{
	bool joinable = (bool)POINTER_TO_UINT(arg);

	if (!joinable) {
		detached_thread_has_finished = true;
	}

	return NULL;
}

void create_thread_common_entry(const pthread_attr_t *attrp, bool expect_success, bool joinable,
				void *(*entry)(void *arg), void *arg)
{
	pthread_t th;

	if (!joinable) {
		detached_thread_has_finished = false;
	}

	if (expect_success) {
		zassert_ok(pthread_create(&th, attrp, entry, arg));
	} else {
		zassert_not_ok(pthread_create(&th, attrp, entry, arg));
		return;
	}

	if (joinable) {
		zassert_ok(pthread_join(th, NULL), "failed to join joinable thread");
		return;
	}

	/*
	 * Should not be able to join a detached thread. POSIX leaves this
	 * undefined; Zephyr detects it and fails the join, but ASAN's
	 * pthread_join interceptor aborts on it before the implementation
	 * can return.
	 */
	if (!IS_ENABLED(CONFIG_ASAN)) {
		zassert_not_ok(pthread_join(th, NULL));
	}

	/* bounded by real time: under parallel load sim time can lag far behind */
	for (uint32_t t0 = now_ms(); !detached_thread_has_finished && (now_ms() - t0) < 5000;) {
		msleep(2 * CONFIG_PTHREAD_RECYCLER_DELAY_MS);
	}

	zassert_true(detached_thread_has_finished, "detached thread did not seem to finish");
}

void create_thread_common(const pthread_attr_t *attrp, bool expect_success, bool joinable)
{
	create_thread_common_entry(attrp, expect_success, joinable, thread_entry,
				   UINT_TO_POINTER(joinable));
}

void can_create_thread(const pthread_attr_t *attrp)
{
	create_thread_common(attrp, true, true);
}

void cannot_create_thread(const pthread_attr_t *attrp)
{
	create_thread_common(attrp, false, true);
}

void pthread_attr_before(void *fixture)
{
	ARG_UNUSED(fixture);

	zassert_ok(pthread_attr_init(&test_attr));
	test_attr_valid = true;
}

void pthread_attr_after(void *fixture)
{
	ARG_UNUSED(fixture);

	if (test_attr_valid) {
		(void)pthread_attr_destroy(&test_attr);
		test_attr_valid = false;
	}
}
```

## src/_main.c
```c
/*
 * Copyright (c) 2026, Friedt Professional Engineering Services, Inc.
 *
 * SPDX-License-Identifier: Apache-2.0
 */

#include "_main.h"

#include <zephyr/sys/util.h>
#include <zephyr/ztest.h>

static const struct posix_threads_base_module modules[] = {
	{
		.setup = pthread_signal_setup,
	},
	{
		.before = pthread_attr_before,
		.after = pthread_attr_after,
	},
	{
		.before = mutex_before,
	},
};

static void *setup(void)
{
	ARRAY_FOR_EACH(modules, i) {
		if (modules[i].setup != NULL) {
			modules[i].setup();
		}
	}

	return NULL;
}

static void before(void *fixture)
{
	ARRAY_FOR_EACH(modules, i) {
		if (modules[i].before != NULL) {
			modules[i].before(fixture);
		}
	}
}

static void after(void *fixture)
{
	ARRAY_FOR_EACH(modules, i) {
		if (modules[i].after != NULL) {
			modules[i].after(fixture);
		}
	}
}

static void teardown(void *fixture)
{
	for (size_t i = ARRAY_SIZE(modules); i > 0; i--) {
		if (modules[i - 1].teardown != NULL) {
			modules[i - 1].teardown(fixture);
		}
	}
}

ZTEST_SUITE(posix_threads_base, NULL, setup, before, after, teardown);
```

## src/_main.h
```c
/*
 * Copyright (c) 2026, Friedt Professional Engineering Services, Inc.
 *
 * SPDX-License-Identifier: Apache-2.0
 */

#ifndef THREADS_BASE_MAIN_H_
#define THREADS_BASE_MAIN_H_

#include <stddef.h>

#include <zephyr/ztest.h>

typedef void (*posix_threads_base_setup_fn)(void);
typedef void (*posix_threads_base_hook_fn)(void *fixture);

struct posix_threads_base_module {
	posix_threads_base_setup_fn setup;
	posix_threads_base_hook_fn before;
	posix_threads_base_hook_fn after;
	posix_threads_base_hook_fn teardown;
};

#ifdef CONFIG_USERSPACE
#define ZTEST_THREADS_BASE_USER(fn) \
	ZTEST_USER(posix_threads_base, fn##_user) { fn(); }
#else
#define ZTEST_THREADS_BASE_USER(fn)
#endif

#define ZTEST_THREADS_BASE(fn)  \
	ZTEST(posix_threads_base, fn) \
	{                             \
		fn();                 \
	}                             \
	ZTEST_THREADS_BASE_USER(fn)

void mutex_before(void *fixture);
void pthread_attr_before(void *fixture);
void pthread_attr_after(void *fixture);
void pthread_signal_setup(void);

#endif /* THREADS_BASE_MAIN_H_ */
```

## src/cond.c
```c
/*
 * Copyright (c) 2022 Meta
 *
 * SPDX-License-Identifier: Apache-2.0
 */

#include <errno.h>
#include <pthread.h>
#include <time.h>

#include <zephyr/kernel.h>
#include <zephyr/sys/timeutil.h>
#include <zephyr/sys/util.h>
#include <zephyr/ztest.h>

#include "../../shared/linux_compat_test.h"
#include "_main.h"

#define TIMEDWAIT_TIMEOUT_MS       200
#define TIMEDWAIT_TIMEOUT_DELAY_MS 100

BUILD_ASSERT(TIMEDWAIT_TIMEOUT_DELAY_MS >= 100, "TIMEDWAIT_TIMEOUT_DELAY_MS too small");
BUILD_ASSERT(TIMEDWAIT_TIMEOUT_MS >= 2 * TIMEDWAIT_TIMEOUT_DELAY_MS,
	     "TIMEDWAIT_TIMEOUT_MS too small");

static inline void timespec_add_ms(struct timespec *ts, uint32_t ms)
{
	struct timespec addend;

	timespec_from_timeout(K_MSEC(ms), &addend);
	timespec_add(ts, &addend);
}

/**
 * @brief Test to that there are no condition variable resource leaks
 *
 * @details Demonstrate that condition variables may be used over and over again.
 */
ZTEST(posix_threads_base, test_cond_resource_leak)
{
	posix_test_skip_if_native_libc();
	pthread_cond_t cond;

	for (size_t i = 0; i < 8; ++i) {
		zassert_ok(pthread_cond_init(&cond, NULL), "failed to init cond %zu", i);
		zassert_ok(pthread_cond_destroy(&cond), "failed to destroy cond %zu", i);
	}
}

static void test_pthread_condattr(void)
{
	pthread_condattr_t att = {0};

	/* degenerate cases */
	IF_NOT_NATIVE_LIBC({
		zassert_equal(pthread_condattr_init(NULL), EINVAL);
		zassert_equal(pthread_condattr_destroy(NULL), EINVAL);
	})

	zassert_ok(pthread_condattr_init(&att));

	zassert_ok(pthread_condattr_destroy(&att));
}

ZTEST_THREADS_BASE(test_pthread_condattr);

static void test_cond_init_existing_initialized_condattr(void)
{
	pthread_cond_t cond;
	pthread_condattr_t att = {0};

	IF_NOT_NATIVE_LIBC({
		/* an uninitialized condattr is rejected */
		zassert_equal(pthread_cond_init(&cond, &att), EINVAL);
	})

	zassert_ok(pthread_condattr_init(&att));
	zassert_ok(pthread_cond_init(&cond, &att), "pthread_cond_init failed with valid attr");

	/* Clean up */
	zassert_ok(pthread_cond_destroy(&cond));
	zassert_ok(pthread_condattr_destroy(&att));
}

ZTEST_THREADS_BASE(test_cond_init_existing_initialized_condattr);

static void test_cond_broadcast_static_init_pthread_cond_t(void)
{
	pthread_cond_t cond = PTHREAD_COND_INITIALIZER;

	zassert_ok(pthread_cond_broadcast(&cond));
	zassert_ok(pthread_cond_destroy(&cond));
}

ZTEST_THREADS_BASE(test_cond_broadcast_static_init_pthread_cond_t);

static void test_cond_signal_static_init_pthread_cond_t(void)
{
	pthread_cond_t cond = PTHREAD_COND_INITIALIZER;

	zassert_ok(pthread_cond_signal(&cond));
	zassert_ok(pthread_cond_destroy(&cond));
}

ZTEST_THREADS_BASE(test_cond_signal_static_init_pthread_cond_t);

static ZTEST_BMEM pthread_mutex_t cond_wait_mtx;
static ZTEST_BMEM pthread_cond_t cond_wait_cv;
static ZTEST_BMEM bool cond_wait_done;

static void *cond_wait_fn(void *arg)
{
	ARG_UNUSED(arg);

	zassert_ok(pthread_mutex_lock(&cond_wait_mtx));
	while (!cond_wait_done) {
		zassert_ok(pthread_cond_wait(&cond_wait_cv, &cond_wait_mtx));
	}
	zassert_ok(pthread_mutex_unlock(&cond_wait_mtx));

	return NULL;
}

static void test_pthread_cond_wait(void)
{
	pthread_t th;

	posix_test_skip_if_native_libc();

	cond_wait_done = false;
	zassert_ok(pthread_mutex_init(&cond_wait_mtx, NULL));
	zassert_ok(pthread_cond_init(&cond_wait_cv, NULL));

	zassert_ok(pthread_create(&th, NULL, cond_wait_fn, NULL));

	k_msleep(TIMEDWAIT_TIMEOUT_DELAY_MS);

	zassert_ok(pthread_mutex_lock(&cond_wait_mtx));
	cond_wait_done = true;
	zassert_ok(pthread_cond_signal(&cond_wait_cv));
	zassert_ok(pthread_mutex_unlock(&cond_wait_mtx));

	zassert_ok(pthread_join(th, NULL));

	zassert_ok(pthread_cond_destroy(&cond_wait_cv));
	zassert_ok(pthread_mutex_destroy(&cond_wait_mtx));
}

ZTEST_THREADS_BASE(test_pthread_cond_wait);

static void *cond_timedwait_fn(void *arg)
{
	int ret;
	struct timespec time_point;
	pthread_mutex_t *mtx = (pthread_mutex_t *)arg;

	zassume_ok(clock_gettime(CLOCK_REALTIME, &time_point));
	timespec_add_ms(&time_point, TIMEDWAIT_TIMEOUT_MS);

	zassert_ok(pthread_mutex_lock(mtx));
	ret = pthread_cond_timedwait(&cond_wait_cv, mtx, &time_point);
	zassert_ok(pthread_mutex_unlock(mtx));

	return INT_TO_POINTER(ret);
}

static void test_pthread_cond_timedwait(void)
{
	void *ret;
	pthread_t th;

	posix_test_skip_if_native_libc();

	zassert_ok(pthread_mutex_init(&cond_wait_mtx, NULL));
	zassert_ok(pthread_cond_init(&cond_wait_cv, NULL));

	printk("Expecting timedwait with timeout of %d ms to fail\n", TIMEDWAIT_TIMEOUT_MS);
	zassert_ok(pthread_create(&th, NULL, cond_timedwait_fn, &cond_wait_mtx));
	zassert_ok(pthread_join(th, &ret));
	zassert_equal(ETIMEDOUT, POINTER_TO_INT(ret));

	printk("Expecting timedwait with timeout of %d ms to succeed after %d ms\n",
	       TIMEDWAIT_TIMEOUT_MS, TIMEDWAIT_TIMEOUT_DELAY_MS);
	zassert_ok(pthread_create(&th, NULL, cond_timedwait_fn, &cond_wait_mtx));
	k_msleep(TIMEDWAIT_TIMEOUT_DELAY_MS);
	zassert_ok(pthread_mutex_lock(&cond_wait_mtx));
	zassert_ok(pthread_cond_signal(&cond_wait_cv));
	zassert_ok(pthread_mutex_unlock(&cond_wait_mtx));
	zassert_ok(pthread_join(th, &ret));
	zassert_equal(0, POINTER_TO_INT(ret));

	IF_NOT_NATIVE_LIBC({
		zassert_ok(pthread_mutex_lock(&cond_wait_mtx));
		zassert_equal(EINVAL, pthread_cond_timedwait(&cond_wait_cv, &cond_wait_mtx, NULL));
		zassert_ok(pthread_mutex_unlock(&cond_wait_mtx));
	})

	/* an already-past absolute deadline times out without blocking, mutex re-acquired */
	IF_NOT_NATIVE_LIBC({
		int rc;
		int64_t start;
		const struct timespec past = {0};

		zassert_ok(pthread_mutex_lock(&cond_wait_mtx));
		start = k_uptime_get();
		rc = pthread_cond_timedwait(&cond_wait_cv, &cond_wait_mtx, &past);
		zassert_equal(rc, ETIMEDOUT, "expected ETIMEDOUT, got %d", rc);
		zassert_true(k_uptime_get() - start < TIMEDWAIT_TIMEOUT_DELAY_MS,
			     "past deadline blocked");
		zassert_ok(pthread_mutex_unlock(&cond_wait_mtx));
	})

	/* the first wait on a statically-initialized cond allocates it */
	{
		int rc;
		pthread_cond_t static_cv = PTHREAD_COND_INITIALIZER;
		const struct timespec past = {0};

		zassert_ok(pthread_mutex_lock(&cond_wait_mtx));
		rc = pthread_cond_timedwait(&static_cv, &cond_wait_mtx, &past);
		zassert_equal(rc, ETIMEDOUT, "expected ETIMEDOUT, got %d", rc);
		zassert_ok(pthread_mutex_unlock(&cond_wait_mtx));
		zassert_ok(pthread_cond_destroy(&static_cv));
	}

	zassert_ok(pthread_cond_destroy(&cond_wait_cv));
	zassert_ok(pthread_mutex_destroy(&cond_wait_mtx));
}

ZTEST_THREADS_BASE(test_pthread_cond_timedwait);
```

## src/key.c
```c
/*
 * Copyright (c) 2018 Intel Corporation
 *
 * SPDX-License-Identifier: Apache-2.0
 */

#include <errno.h>
#include <limits.h>
#include <pthread.h>
#include <sched.h>

#include <zephyr/sys/atomic.h>
#include <zephyr/sys/util.h>
#include <zephyr/ztest.h>

#include "../../common/linux_compat_test.h"
#include "_main.h"

#define N_THR 2
#define N_KEY 2

static ZTEST_BMEM pthread_key_t keys[N_KEY];
static ZTEST_BMEM int alloc_count_t0;
static ZTEST_BMEM int alloc_count_t1;

static void *thread_top(void *p1)
{
	void *value = (void *)0x42;

	ARG_UNUSED(p1);

	zassert_ok(pthread_setspecific(keys[0], value), "pthread_setspecific failed");
	zassert_equal(pthread_getspecific(keys[0]), value,
		      "set and retrieved values are different");

	return NULL;
}

static void *thread_func(void *p1)
{
	void *value = (void *)0x73;

	ARG_UNUSED(p1);

	for (int i = 0; i < N_KEY; i++) {
		zassert_ok(pthread_setspecific(keys[i], value), "pthread_setspecific failed");
		zassert_equal(pthread_getspecific(keys[i]), value,
			      "set and retrieved values are different");
	}

	return NULL;
}

static void make_key(void)
{
	zassert_ok(pthread_key_create(&keys[0], NULL), "insufficient memory to create key");
}

static void make_keys(void)
{
	for (int i = 0; i < N_KEY; i++) {
		zassert_ok(pthread_key_create(&keys[i], NULL),
			   "insufficient memory to create keys");
	}
}

static void test_key_1toN_thread(void)
{
	void *retval;
	pthread_t newthread[N_THR];

	make_key();

	for (int i = 0; i < N_THR; i++) {
		zassert_ok(pthread_create(&newthread[i], NULL, thread_top, NULL),
			   "attempt to create thread %d failed", i);
	}

	for (int i = 0; i < N_THR; i++) {
		zassert_ok(pthread_join(newthread[i], &retval), "failed to join thread %d", i);
	}

	zassert_ok(pthread_key_delete(keys[0]), "attempt to delete key failed");
}

static void test_key_Nto1_thread(void)
{
	pthread_t newthread;

	make_keys();

	zassert_ok(pthread_create(&newthread, NULL, thread_func, NULL),
		   "attempt to create thread failed");

	zassert_ok(pthread_join(newthread, NULL), "failed to join thread");

	for (int i = 0; i < N_KEY; i++) {
		zassert_ok(pthread_key_delete(keys[i]), "attempt to delete keys[%d] failed", i);
	}
}

ZTEST_THREADS_BASE(test_key_1toN_thread);
ZTEST_THREADS_BASE(test_key_Nto1_thread);

ZTEST(posix_threads_base, test_key_resource_leak)
{
	pthread_key_t leak_key;

	for (size_t i = 0; i < CONFIG_POSIX_THREAD_KEYS_MAX; ++i) {
		zassert_ok(pthread_key_create(&leak_key, NULL), "failed to create key %zu", i);
		zassert_ok(pthread_key_delete(leak_key), "failed to delete key %zu", i);
	}
}

static void test_correct_key_is_deleted(void)
{
	pthread_key_t deleted_key;
	size_t j = CONFIG_POSIX_THREAD_KEYS_MAX - 1;
	pthread_key_t all_keys[CONFIG_POSIX_THREAD_KEYS_MAX];

	for (size_t i = 0; i < ARRAY_SIZE(all_keys); ++i) {
		zassert_ok(pthread_key_create(&all_keys[i], NULL), "failed to create key %zu", i);
	}

	deleted_key = all_keys[j];
	zassert_ok(pthread_key_delete(all_keys[j]));
	zassert_ok(pthread_key_create(&all_keys[j], NULL), "failed to create key %zu", j);

	zassert_equal(deleted_key, all_keys[j], "deleted key %lx instead of key %lx", (long)all_keys[j],
		      (long)deleted_key);

	for (size_t i = 0; i < ARRAY_SIZE(all_keys); ++i) {
		zassert_ok(pthread_key_delete(all_keys[i]), "failed to delete key %zu", i);
	}
}

ZTEST_THREADS_BASE(test_correct_key_is_deleted);

static void *setspecific_thread(void *count)
{
	int value = 42;
	int *alloc_count = count;

	while (1) {
		pthread_key_t tkey;

		if (*alloc_count == CONFIG_POSIX_THREAD_KEYS_MAX / N_THR) {
			break;
		}

		if (pthread_key_create(&tkey, NULL) < 0) {
			break;
		}
		if (pthread_setspecific(tkey, &value) == ENOMEM) {
			break;
		}
		*alloc_count += 1;
	}

	return NULL;
}

static void test_thread_specific_data_deallocation(void)
{
	pthread_t thread;

	alloc_count_t0 = 0;
	alloc_count_t1 = 0;

	zassert_ok(pthread_create(&thread, NULL, setspecific_thread, &alloc_count_t0),
		   "attempt to create thread failed");
	zassert_ok(pthread_join(thread, NULL), "failed to join thread");
	printk("first thread allocated %d keys\n", alloc_count_t0);

	zassert_ok(pthread_create(&thread, NULL, setspecific_thread, &alloc_count_t1),
		   "attempt to create thread failed");
	zassert_ok(pthread_join(thread, NULL), "failed to join thread");
	printk("second thread allocated %d keys\n", alloc_count_t1);

	zassert_equal(alloc_count_t0, alloc_count_t1,
		      "failed to deallocate thread specific data");
}

ZTEST_THREADS_BASE(test_thread_specific_data_deallocation);

static void test_pthread_key_create(void)
{
	int ret;
	size_t n = 0;
	pthread_key_t k[CONFIG_POSIX_THREAD_KEYS_MAX + 1];

	posix_test_skip_if_native_libc();

	/* exhausting the key pool fails with EAGAIN */
	for (; n < ARRAY_SIZE(k); ++n) {
		ret = pthread_key_create(&k[n], NULL);
		if (ret != 0) {
			break;
		}
	}
	zassert_true(n < ARRAY_SIZE(k), "key pool did not exhaust");
	zassert_equal(ret, EAGAIN, "expected EAGAIN, got %d", ret);

	for (size_t i = 0; i < n; ++i) {
		zassert_ok(pthread_key_delete(k[i]));
	}
}

ZTEST_THREADS_BASE(test_pthread_key_create);

/* the entry runs in another thread, which cannot reach this one's stack under userspace */
static ZTEST_BMEM pthread_key_t getspecific_key;

static void *getspecific_fn(void *arg)
{
	pthread_key_t *key = arg;

	zassert_ok(pthread_setspecific(*key, (void *)0x42));
	zassert_equal(pthread_getspecific(*key), (void *)0x42);

	return NULL;
}

static void test_pthread_getspecific(void)
{
	pthread_t th;

	posix_test_skip_if_native_libc();

	zassert_ok(pthread_key_create(&getspecific_key, NULL));
	zassert_ok(pthread_create(&th, NULL, getspecific_fn, &getspecific_key));
	zassert_ok(pthread_join(th, NULL));
	zassert_ok(pthread_key_delete(getspecific_key));

	/* lookups against a deleted key fail closed */
	zassert_is_null(pthread_getspecific(getspecific_key));
	zassert_equal(pthread_setspecific(getspecific_key, (void *)0x42), EINVAL);
}

ZTEST_THREADS_BASE(test_pthread_getspecific);

static ZTEST_BMEM atomic_t key_delete_worker_ready;
static ZTEST_BMEM atomic_t key_delete_done;
static ZTEST_BMEM bool dtor_executed;

static void dtor_active_thread(void *arg)
{
	ARG_UNUSED(arg);
	dtor_executed = true;
}

static void *key_delete_worker(void *arg)
{
	pthread_key_t *key = arg;
	int val = 0x1234;

	zassert_ok(pthread_setspecific(*key, &val), "failed to set thread-specific data");

	/* Signal that data has been bound to the key */
	atomic_set(&key_delete_worker_ready, 1);

	/* Wait until key deletion completes before exiting */
	while (atomic_get(&key_delete_done) == 0) {
		sched_yield();
	}

	return NULL;
}

/**
 * @brief Verify pthread_key_delete() on key bound to active thread.
 *
 * Verifies that deleting a key while a thread holds thread-specific data
 * unlinks the key from the thread's internal list, suppresses destructor
 * invocation at thread exit per IEEE 1003.1, and does not cause double-free
 * or memory corruption.
 */
static void test_key_delete_active_thread(void)
{
	pthread_t thread;
	pthread_key_t key;

	dtor_executed = false;
	atomic_clear(&key_delete_worker_ready);
	atomic_clear(&key_delete_done);

	zassert_ok(pthread_key_create(&key, dtor_active_thread), "failed to create key");

	zassert_ok(pthread_create(&thread, NULL, key_delete_worker, &key),
		   "failed to create worker thread");

	/* Wait deterministically for worker thread to bind data */
	while (atomic_get(&key_delete_worker_ready) == 0) {
		sched_yield();
	}

	/* Delete key while worker thread is still alive and blocked */
	zassert_ok(pthread_key_delete(key), "failed to delete key");

	/* Release worker thread to exit and finalize */
	atomic_set(&key_delete_done, 1);

	/* Wait for worker thread to exit and finalize */
	zassert_ok(pthread_join(thread, NULL), "failed to join worker thread");

	/* Per IEEE 1003.1, destructor must not be called for deleted keys */
	zassert_false(dtor_executed, "destructor was executed for deleted key");
}

ZTEST_THREADS_BASE(test_key_delete_active_thread);

#define N_DTOR_KEY MIN(PTHREAD_DESTRUCTOR_ITERATIONS + 2, CONFIG_POSIX_THREAD_KEYS_MAX)

static ZTEST_BMEM pthread_key_t dtor_keys[N_DTOR_KEY];
static ZTEST_BMEM atomic_t dtor_calls;

static void dtor_count(void *arg)
{
	ARG_UNUSED(arg);
	atomic_inc(&dtor_calls);
}

static void *set_all_dtor_keys(void *arg)
{
	ARG_UNUSED(arg);

	for (size_t i = 0; i < N_DTOR_KEY; i++) {
		zassert_ok(pthread_setspecific(dtor_keys[i], &dtor_keys[i]));
	}

	return NULL;
}

/**
 * @brief Verify every key's destructor runs when a thread holds more keys than
 * PTHREAD_DESTRUCTOR_ITERATIONS.
 */
static void test_destructor_called_for_every_key(void)
{
	pthread_t thread;

	atomic_set(&dtor_calls, 0);
	for (size_t i = 0; i < N_DTOR_KEY; i++) {
		zassert_ok(pthread_key_create(&dtor_keys[i], dtor_count));
	}

	zassert_ok(pthread_create(&thread, NULL, set_all_dtor_keys, NULL));
	zassert_ok(pthread_join(thread, NULL));

	zassert_equal(atomic_get(&dtor_calls), N_DTOR_KEY);

	for (size_t i = 0; i < N_DTOR_KEY; i++) {
		zassert_ok(pthread_key_delete(dtor_keys[i]));
	}
}

ZTEST_THREADS_BASE(test_destructor_called_for_every_key);

static ZTEST_BMEM pthread_key_t resetting_key;

static void dtor_resetting(void *arg)
{
	atomic_inc(&dtor_calls);
	(void)pthread_setspecific(resetting_key, arg);
}

static void *set_resetting_key(void *arg)
{
	ARG_UNUSED(arg);

	zassert_ok(pthread_setspecific(resetting_key, &resetting_key));

	return NULL;
}

/**
 * @brief Verify a destructor that keeps setting a value stops after
 * PTHREAD_DESTRUCTOR_ITERATIONS passes.
 */
static void test_destructor_iterations_bounded(void)
{
	pthread_t thread;

	atomic_set(&dtor_calls, 0);
	zassert_ok(pthread_key_create(&resetting_key, dtor_resetting));

	zassert_ok(pthread_create(&thread, NULL, set_resetting_key, NULL));
	zassert_ok(pthread_join(thread, NULL));

	zassert_equal(atomic_get(&dtor_calls), PTHREAD_DESTRUCTOR_ITERATIONS);

	zassert_ok(pthread_key_delete(resetting_key));
}

ZTEST_THREADS_BASE(test_destructor_iterations_bounded);
```

## src/mutex.c
```c
/*
 * Copyright (c) 2018 Intel Corporation
 *
 * SPDX-License-Identifier: Apache-2.0
 */

#include "../../common/linux_compat_test.h"

#include <errno.h>
#include <pthread.h>
#include <time.h>

#include <zephyr/sys/util.h>
#include <zephyr/sys/timeutil.h>
#include <zephyr/ztest.h>

#include "_main.h"

#define SLEEP_MS 100

static ZTEST_BMEM pthread_mutex_t mutex;

static void *normal_mutex_entry(void *p1)
{
	int i, rc;

	/* Sleep for maximum 300 ms as main thread is sleeping for 100 ms */

	for (i = 0; i < 3; i++) {
		rc = pthread_mutex_trylock(&mutex);
		if (rc == 0) {
			break;
		}
		k_msleep(SLEEP_MS);
	}

	zassert_false(rc, "try lock failed");
	TC_PRINT("mutex lock is taken\n");
	zassert_false(pthread_mutex_unlock(&mutex), "mutex unlock is failed");
	return NULL;
}

/**
 * @brief Test default mutex trylock and lock behaviour
 *
 * @details Uses the default mutex attributes. pthread_mutex_trylock
 *	    and pthread_mutex_lock are exercised without
 *	    pthread_mutexattr_settype().
 */
static void test_mutex_normal(void)
{
	pthread_t th;

	posix_test_skip_if_native_libc();

	zassert_ok(pthread_mutex_init(&mutex, NULL));

	zassert_ok(pthread_mutex_lock(&mutex));

	zassert_ok(pthread_create(&th, NULL, normal_mutex_entry, NULL));

	k_msleep(SLEEP_MS);
	zassert_ok(pthread_mutex_unlock(&mutex));

	zassert_ok(pthread_join(th, NULL));

	zassert_ok(pthread_mutex_destroy(&mutex));
}

ZTEST_THREADS_BASE(test_mutex_normal);

/**
 * @brief Test to that there are no mutex resource leaks
 *
 * @details Demonstrate that mutexes may be used over and over again.
 */
ZTEST(posix_threads_base, test_mutex_resource_leak)
{
	posix_test_skip_if_native_libc();
	pthread_mutex_t m;

	for (size_t i = 0; i < 8; ++i) {
		zassert_ok(pthread_mutex_init(&m, NULL), "failed to init mutex %zu", i);
		zassert_ok(pthread_mutex_destroy(&m), "failed to destroy mutex %zu", i);
	}
}

#define TIMEDLOCK_TIMEOUT_MS       200
#define TIMEDLOCK_TIMEOUT_DELAY_MS 100

BUILD_ASSERT(TIMEDLOCK_TIMEOUT_DELAY_MS >= 100, "TIMEDLOCK_TIMEOUT_DELAY_MS too small");
BUILD_ASSERT(TIMEDLOCK_TIMEOUT_MS >= 2 * TIMEDLOCK_TIMEOUT_DELAY_MS,
	     "TIMEDLOCK_TIMEOUT_MS too small");

static inline void timespec_add_ms(struct timespec *ts, uint32_t ms)
{
	struct timespec addend;

	timespec_from_timeout(K_MSEC(ms), &addend);
	timespec_add(ts, &addend);
}

static void *test_mutex_timedlock_fn(void *arg)
{
	int ret;
	struct timespec time_point;
	pthread_mutex_t *mtx = (pthread_mutex_t *)arg;

	zassume_ok(clock_gettime(CLOCK_REALTIME, &time_point));
	timespec_add_ms(&time_point, TIMEDLOCK_TIMEOUT_MS);

	ret = pthread_mutex_timedlock(mtx, &time_point);
	if (ret != 0) {
		return INT_TO_POINTER(ret);
	}

	zassert_ok(pthread_mutex_unlock(mtx));

	return NULL;
}

static void *test_mutex_timedlock_past_fn(void *arg)
{
	int ret;
	int64_t start;
	struct timespec past = {0};
	pthread_mutex_t *mtx = (pthread_mutex_t *)arg;

	/* an already-past absolute deadline times out without blocking */
	start = k_uptime_get();
	ret = pthread_mutex_timedlock(mtx, &past);
	zassert_true(k_uptime_get() - start < TIMEDLOCK_TIMEOUT_DELAY_MS,
		     "past deadline blocked");

	return INT_TO_POINTER(ret);
}

static void test_mutex_timedlock(void)
{
	void *ret;
	pthread_t th;

	posix_test_skip_if_native_libc();

	zassert_ok(pthread_mutex_init(&mutex, NULL));

	printk("Expecting timedlock with timeout of %d ms to fail\n", TIMEDLOCK_TIMEOUT_MS);
	zassert_ok(pthread_mutex_lock(&mutex));
	zassert_ok(pthread_create(&th, NULL, test_mutex_timedlock_fn, &mutex));
	zassert_ok(pthread_join(th, &ret));
	/* ensure timeout occurs */
	zassert_equal(ETIMEDOUT, POINTER_TO_INT(ret));

	printk("Expecting timedlock with timeout of %d ms to succeed after 100ms\n",
	       TIMEDLOCK_TIMEOUT_MS);
	zassert_ok(pthread_create(&th, NULL, test_mutex_timedlock_fn, &mutex));
	/* unlock before timeout expires */
	k_msleep(TIMEDLOCK_TIMEOUT_DELAY_MS);
	zassert_ok(pthread_mutex_unlock(&mutex));
	zassert_ok(pthread_join(th, &ret));
	/* ensure lock is successful, in spite of delay  */
	zassert_ok(POINTER_TO_INT(ret));

	/* an already-past absolute deadline times out without blocking */
	zassert_ok(pthread_mutex_lock(&mutex));
	zassert_ok(pthread_create(&th, NULL, test_mutex_timedlock_past_fn, &mutex));
	zassert_ok(pthread_join(th, &ret));
	zassert_equal(POINTER_TO_INT(ret), ETIMEDOUT, "expected ETIMEDOUT, got %d",
		      (int)POINTER_TO_INT(ret));
	zassert_ok(pthread_mutex_unlock(&mutex));

	zassert_ok(pthread_mutex_destroy(&mutex));
}

ZTEST_THREADS_BASE(test_mutex_timedlock);

static void test_pthread_mutex_init(void)
{
	pthread_mutex_t m;
	pthread_mutexattr_t attr;

	/* explicitly-initialized default attributes */
	zassert_ok(pthread_mutexattr_init(&attr));
	zassert_ok(pthread_mutex_init(&m, &attr));
	zassert_ok(pthread_mutex_lock(&m));
	zassert_ok(pthread_mutex_unlock(&m));
	zassert_ok(pthread_mutex_destroy(&m));
	zassert_ok(pthread_mutexattr_destroy(&attr));

	IF_NOT_NATIVE_LIBC({
		/* an uninitialized mutexattr is rejected */
		pthread_mutexattr_t zeroed = {0};

		zassert_equal(pthread_mutex_init(&m, &zeroed), EINVAL);
	})
}

ZTEST_THREADS_BASE(test_pthread_mutex_init);

static void test_pthread_mutex_lock(void)
{
	pthread_mutex_t m = PTHREAD_MUTEX_INITIALIZER;

	/* the first lock of a statically-initialized mutex allocates it */
	zassert_ok(pthread_mutex_lock(&m));
	zassert_ok(pthread_mutex_unlock(&m));
	zassert_ok(pthread_mutex_destroy(&m));
}

ZTEST_THREADS_BASE(test_pthread_mutex_lock);

static ZTEST_BMEM pthread_mutex_t trylock_mutex;
static ZTEST_BMEM int trylock_status;

static void *trylock_fn(void *arg)
{
	ARG_UNUSED(arg);

	trylock_status = pthread_mutex_trylock(&trylock_mutex);

	return NULL;
}

static void test_pthread_mutex_trylock(void)
{
	pthread_t th;

	zassert_ok(pthread_mutex_init(&trylock_mutex, NULL));

	/* trylock on a held mutex fails with EBUSY, without blocking */
	trylock_status = -1;
	zassert_ok(pthread_mutex_lock(&trylock_mutex));
	zassert_ok(pthread_create(&th, NULL, trylock_fn, NULL));
	zassert_ok(pthread_join(th, NULL));
	zassert_equal(trylock_status, EBUSY, "expected EBUSY, got %d", trylock_status);
	zassert_ok(pthread_mutex_unlock(&trylock_mutex));

	/* trylock on an uncontended mutex succeeds */
	zassert_ok(pthread_mutex_trylock(&trylock_mutex));
	zassert_ok(pthread_mutex_unlock(&trylock_mutex));

	zassert_ok(pthread_mutex_destroy(&trylock_mutex));
}

ZTEST_THREADS_BASE(test_pthread_mutex_trylock);

void mutex_before(void *fixture)
{
	ARG_UNUSED(fixture);

	IF_NOT_NATIVE_LIBC({
		mutex = (pthread_mutex_t)PTHREAD_MUTEX_INITIALIZER;
	})
}
```

## src/mutex_attr.c
```c
/*
 * Copyright (c) 2024, Meta
 *
 * SPDX-License-Identifier: Apache-2.0
 */

#include "../../shared/linux_compat_test.h"
#include "_main.h"

#include <errno.h>
#include <pthread.h>

#include <zephyr/ztest.h>

static void test_pthread_mutexattr_init(void)
{
	pthread_mutexattr_t attr;

	/* degenerate cases */
	IF_NOT_NATIVE_LIBC({ zassert_equal(EINVAL, pthread_mutexattr_init(NULL)); })

	zassert_ok(pthread_mutexattr_init(&attr));
	zassert_ok(pthread_mutexattr_destroy(&attr));
}

ZTEST_THREADS_BASE(test_pthread_mutexattr_init);

static void test_pthread_mutexattr_destroy(void)
{
	pthread_mutexattr_t attr;

	/* degenerate cases */
	IF_NOT_NATIVE_LIBC({
		if (false) {
			/* undefined behaviour */
			zassert_equal(EINVAL, pthread_mutexattr_destroy(&attr));
		}
		zassert_equal(EINVAL, pthread_mutexattr_destroy(NULL));
	})

	zassert_ok(pthread_mutexattr_init(&attr));
	zassert_ok(pthread_mutexattr_destroy(&attr));
	if (false) {
		/* undefined behaviour */
		zassert_equal(EINVAL, pthread_mutexattr_destroy(&attr));
	}
}

ZTEST_THREADS_BASE(test_pthread_mutexattr_destroy);
```

## src/pthread.c
```c
/*
 * Copyright (c) 2018-2023 Intel Corporation
 *
 * SPDX-License-Identifier: Apache-2.0
 */

#include <pthread.h>
#include <threads.h>
#include <sched.h>
#include <signal.h>
#include <unistd.h>

#include <zephyr/kernel.h>
#include <zephyr/kernel/signal.h>
#include <zephyr/sys/util.h>
#include <zephyr/ztest.h>

#include "../../shared/linux_compat_test.h"
#include "_main.h"

#define DETACH_THR_ID 2

#define N_THR_E    3
#define N_THR_T    3
#define BOUNCES    64

#define PTHREAD_CANCEL_INVALID -1
#define PTHREAD_INVALID        ((pthread_t)(-1))

static void *thread_top_exec(void *p1);
static void *thread_top_term(void *p1);

static ZTEST_BMEM pthread_mutex_t lock;
static ZTEST_BMEM pthread_cond_t cvar0;
static ZTEST_BMEM pthread_cond_t cvar1;
static ZTEST_BMEM pthread_cond_t cvar_done;
static ZTEST_BMEM pthread_cond_t cvar_first_iter;

#define N_FIRST_ITER_PEERS (N_THR_E - 1)
static ZTEST_BMEM int first_iter_peer_count;

static ZTEST_BMEM int bounce_failed;
static ZTEST_BMEM int bounce_done[N_THR_E];

static ZTEST_BMEM int curr_bounce_thread;

/* Bounces execution between threads using a condition variable, continuously
 * testing that no other thread is mucking with the protected state.
 * Test success is signaled to main() using a condition variable.
 */

static void *thread_top_exec(void *p1)
{
	int i, j, id = (int)POINTER_TO_INT(p1);

#if defined(_POSIX_THREAD_PRIORITY_SCHEDULING)
	int policy;
	struct sched_param schedparam;

	pthread_getschedparam(pthread_self(), &policy, &schedparam);
	printk("Thread %d starting with scheduling policy %d & priority %d\n", id, policy,
	       schedparam.sched_priority);
#endif

	/* Try a double-lock here to exercise the failing case of
	 * trylock.  We don't support RECURSIVE locks, so this is
	 * guaranteed to fail.
	 */
	pthread_mutex_lock(&lock);

	if (!pthread_mutex_trylock(&lock)) {
		printk("pthread_mutex_trylock inexplicably succeeded\n");
		bounce_failed = 1;
	}

	pthread_mutex_unlock(&lock);

	for (i = 0; i < BOUNCES; i++) {

		pthread_mutex_lock(&lock);

		if (i == 0) {
			if (id == 0) {
				while (first_iter_peer_count < N_FIRST_ITER_PEERS) {
					zassert_equal(0, pthread_cond_wait(&cvar_first_iter, &lock),
						      "");
				}
			} else {
				first_iter_peer_count++;
				zassert_equal(0, pthread_cond_signal(&cvar_first_iter), "");
				zassert_equal(0, pthread_cond_wait(&cvar0, &lock), "");
			}
		} else {
			zassert_equal(0, pthread_cond_wait(&cvar0, &lock), "");
		}

		/* Claim ownership, then try really hard to give someone
		 * else a shot at hitting this if they are racing.
		 */
		curr_bounce_thread = id;
		for (j = 0; j < 1000; j++) {
			if (curr_bounce_thread != id) {
				printk("Racing bounce threads\n");
				bounce_failed = 1;
				pthread_cond_signal(&cvar_done);
				pthread_mutex_unlock(&lock);
				return NULL;
			}
			sched_yield();
		}

		/* Next one's turn, go back to the top and wait.  */
		pthread_cond_signal(&cvar0);
		pthread_mutex_unlock(&lock);
	}

	/* Signal we are complete to main(), then let it wake us up.  Note
	 * that we are using the same mutex with both cvar0 and cvar1,
	 * which is non-standard but kosher per POSIX (and it works fine
	 * in our implementation
	 */
	pthread_mutex_lock(&lock);
	bounce_done[id] = 1;
	pthread_cond_signal(&cvar_done);
	pthread_cond_wait(&cvar1, &lock);
	pthread_mutex_unlock(&lock);

	printk("Thread %d done\n", id);

	pthread_exit(p1);

	return NULL;
}

static int bounce_test_done(void)
{
	int i;

	if (bounce_failed) {
		return 1;
	}

	for (i = 0; i < N_THR_E; i++) {
		if (!bounce_done[i]) {
			return 0;
		}
	}

	return 1;
}

static void *thread_top_term(void *p1)
{
	int ret;
	int id = POINTER_TO_INT(p1);
	pthread_t self = pthread_self();

#if defined(_POSIX_THREAD_PRIORITY_SCHEDULING)
	int policy;
	struct sched_param param = {
		.sched_priority = N_THR_T - id,
	};
	struct sched_param getschedparam;

	if (!IS_ENABLED(CONFIG_NATIVE_LIBC)) {
		/* Change priority of thread */
		ret = pthread_setschedparam(self, SCHED_RR, &param);
		zassert_ok(ret, "Unable to set thread priority! %d", ret);

		ret = pthread_getschedparam(self, &policy, &getschedparam);
		zassert_ok(ret, "Unable to get thread priority! %d", ret);

		printk("Thread %d starting with a priority of %d\n", id,
		       getschedparam.sched_priority);
	}
#endif

	if (!k_is_user_context()) {
		/* kernel threads start with cancellation disabled and must enable it explicitly */
		k_thread_cancel_setstate(true);
	}

	if (id % 2) {
		ret = pthread_setcancelstate(PTHREAD_CANCEL_DISABLE, NULL);
		zassert_false(ret, "Unable to set cancel state!");
	}

	if ((id % 2) == 0) {
		printk("Cancelling thread %d\n", id);
		zassert_ok(pthread_cancel(self), "Thread %d could not be cancelled\n", id);
	}
	/*
	 * ISO C, so no POSIX Option Group is required and it is safe on host
	 * libc threads. Unlike sleep(), thrd_sleep() is not a cancellation
	 * point, so cancelled threads sleep the full duration; keep it short.
	 */
	thrd_sleep(&(struct timespec){.tv_nsec = 100 * NSEC_PER_MSEC}, NULL);
	printk("Exiting thread %d\n", id);
	pthread_exit(p1);
	return NULL;
}

static void pthread_sync_init(void)
{
	zassert_ok(pthread_mutex_init(&lock, NULL));
	zassert_ok(pthread_cond_init(&cvar0, NULL));
	zassert_ok(pthread_cond_init(&cvar1, NULL));
	zassert_ok(pthread_cond_init(&cvar_first_iter, NULL));
	zassert_ok(pthread_cond_init(&cvar_done, NULL));
}

static void pthread_sync_fini(void)
{
	pthread_mutex_destroy(&lock);
	pthread_cond_destroy(&cvar0);
	pthread_cond_destroy(&cvar1);
	pthread_cond_destroy(&cvar_done);
	pthread_cond_destroy(&cvar_first_iter);
}

static void test_pthread_execution(void)
{
	if (IS_ENABLED(CONFIG_COVERAGE)) {
		/* Coverage data increases binary size, reducing heap for dynamic stacks */
		ztest_test_skip();
	}
	int i, ret;
	pthread_t newthread[N_THR_E];
	void *retval;

	pthread_sync_init();

	first_iter_peer_count = 0;
	bounce_failed = 0;
	curr_bounce_thread = 0;
	for (i = 0; i < N_THR_E; i++) {
		bounce_done[i] = 0;
	}

	for (i = 0; i < N_THR_E; i++) {
		ret = pthread_create(&newthread[i], NULL, thread_top_exec, INT_TO_POINTER(i));
		zassert_ok(ret, "pthread_create failed for thread %d: %d", i, ret);
	}

	while (!bounce_test_done()) {
		pthread_mutex_lock(&lock);
		while (!bounce_test_done()) {
			zassert_ok(pthread_cond_wait(&cvar_done, &lock));
		}
		pthread_mutex_unlock(&lock);
	}

	/* TESTPOINT: Check if bounce test passes */
	zassert_false(bounce_failed, "Bounce test failed");

	printk("Bounce test OK\n");

	/* Wake up the worker threads so they can exit */
	pthread_mutex_lock(&lock);
	pthread_cond_broadcast(&cvar1);
	pthread_mutex_unlock(&lock);

	for (i = 0; i < N_THR_E; i++) {
		zassert_ok(pthread_join(newthread[i], &retval));
	}

	pthread_sync_fini();
}

ZTEST_THREADS_BASE(test_pthread_execution);

static void test_pthread_termination(void)
{
	if (IS_ENABLED(CONFIG_COVERAGE)) {
		/* Coverage data increases binary size, reducing heap for dynamic stacks */
		ztest_test_skip();
	}
	int32_t i, ret;
	pthread_t newthread[N_THR_T] = {0};
	void *retval;

	/* Creating 4 threads */
	for (i = 0; i < N_THR_T; i++) {
		zassert_ok(pthread_create(&newthread[i], NULL, thread_top_term, INT_TO_POINTER(i)));
	}

	/* TESTPOINT: Try setting invalid cancel state to current thread */
	ret = pthread_setcancelstate(PTHREAD_CANCEL_INVALID, NULL);
	zassert_equal(ret, EINVAL, "invalid cancel state set!");

	for (i = 0; i < N_THR_T; i++) {
		zassert_ok(pthread_join(newthread[i], &retval));
	}

	/* TESTPOINT: Test for deadlock */
	ret = pthread_join(pthread_self(), &retval);
	zassert_equal(ret, EDEADLK, "thread joined with self inexplicably!");

	/*
	 * Cannot guarantee that an implementation will return ESRCH for attempting to
	 * cancel a terminated thread.
	 *
	 * Please see Rationale here:
	 * https://pubs.opengroup.org/onlinepubs/9799919799/functions/pthread_cancel.html
	 */
}

ZTEST_THREADS_BASE(test_pthread_termination);

static void *create_thread1(void *p1)
{
	ARG_UNUSED(p1);
	return NULL;
}

ZTEST(posix_threads_base, test_pthread_descriptor_leak)
{
	pthread_t pthread1;

	/* If we are leaking descriptors, then this loop will never complete */
	for (size_t i = 0; i < CONFIG_POSIX_THREAD_THREADS_MAX * 2; ++i) {
		zassert_ok(pthread_create(&pthread1, NULL, create_thread1, NULL),
			   "unable to create thread %zu", i);
		zassert_ok(pthread_join(pthread1, NULL), "unable to join thread %zu", i);
	}
}

static void test_pthread_equal(void)
{
	zassert_true(pthread_equal(pthread_self(), pthread_self()));
	zassert_false(pthread_equal(pthread_self(), (pthread_t)4242));
	IF_NOT_NATIVE_LIBC({
		/* not true when running the testsuite against Linux's pthread implementation */
		zassert_true(pthread_equal(pthread_self(), (pthread_t)(uintptr_t)k_current_get()));
	})
}

ZTEST_THREADS_BASE(test_pthread_equal);

static void cleanup_handler(void *arg)
{
	bool *boolp = (bool *)arg;

	*boolp = true;
}

static void *test_pthread_cleanup_entry(void *arg)
{
	bool executed[2] = {0};

	pthread_cleanup_push(cleanup_handler, &executed[0]);
	pthread_cleanup_push(cleanup_handler, &executed[1]);
	pthread_cleanup_pop(false);
	pthread_cleanup_pop(true);

	zassert_true(executed[0]);
	zassert_false(executed[1]);

	return NULL;
}

static void test_pthread_cleanup(void)
{
	pthread_t th;

	zassert_ok(pthread_create(&th, NULL, test_pthread_cleanup_entry, NULL));
	zassert_ok(pthread_join(th, NULL));
}

ZTEST_THREADS_BASE(test_pthread_cleanup);

static ZTEST_BMEM bool testcancel_ignored;
static ZTEST_BMEM bool testcancel_failed;

static void *test_pthread_cancel_fn(void *arg)
{
	if (!k_is_user_context()) {
		/* kernel threads start with cancellation disabled and must enable it explicitly */
		k_thread_cancel_setstate(true);
	}

	zassert_ok(pthread_setcancelstate(PTHREAD_CANCEL_DISABLE, NULL));

	testcancel_ignored = false;

	/* queue cancellation while disabled */
	zassert_ok(pthread_cancel(pthread_self()));

	/* cancellation point with no pending delivery while disabled */
	pthread_testcancel();

	testcancel_ignored = true;

	testcancel_failed = false;

	/* enable the thread to be cancelled, the thread should not return */
	zassert_ok(pthread_setcancelstate(PTHREAD_CANCEL_ENABLE, NULL));

	/* intentionally sleep to encounter cancellation point */
	msleep(20);

	testcancel_failed = true;

	return NULL;
}

static void *testcancel_acts_fn(void *arg)
{
	ARG_UNUSED(arg);

	zassert_ok(pthread_setcancelstate(PTHREAD_CANCEL_ENABLE, NULL));
	testcancel_failed = false;
	zassert_ok(pthread_cancel(pthread_self()));
	/* enabled and pending: the cancellation point must not return */
	pthread_testcancel();
	testcancel_failed = true;

	return NULL;
}

static void test_pthread_testcancel(void)
{
	pthread_t th;
	void *retval;

	zassert_ok(pthread_create(&th, NULL, test_pthread_cancel_fn, NULL));
	zassert_ok(pthread_join(th, NULL));
	zassert_true(testcancel_ignored);
	zassert_false(testcancel_failed);

	zassert_ok(pthread_create(&th, NULL, testcancel_acts_fn, NULL));
	zassert_ok(pthread_join(th, &retval));
	zassert_equal(retval, PTHREAD_CANCELED);
	zassert_false(testcancel_failed);
}

ZTEST_THREADS_BASE(test_pthread_testcancel);

static void test_pthread_atfork(void)
{
	/*
	 * fork() does not exist, so registered handlers can never run;
	 * registration itself succeeds (and NULL handlers are permitted)
	 */
	zassert_ok(pthread_atfork(NULL, NULL, NULL));
}

ZTEST_THREADS_BASE(test_pthread_atfork);

static void test_sched_yield(void)
{
	zassert_ok(sched_yield());
}

ZTEST_THREADS_BASE(test_sched_yield);

static void *setcancelstate_fn(void *arg)
{
	int oldstate = -1;

	ARG_UNUSED(arg);

	zassert_equal(pthread_setcancelstate(PTHREAD_CANCEL_INVALID, NULL), EINVAL);

	/*
	 * No initial-state expectation: kernel-mode threads start with cancel masked
	 * (see thread_top_term()). Read the state back while toggling instead.
	 */
	zassert_ok(pthread_setcancelstate(PTHREAD_CANCEL_DISABLE, NULL));
	zassert_ok(pthread_setcancelstate(PTHREAD_CANCEL_ENABLE, &oldstate));
	zassert_equal(oldstate, PTHREAD_CANCEL_DISABLE);
	zassert_ok(pthread_setcancelstate(PTHREAD_CANCEL_DISABLE, &oldstate));
	zassert_equal(oldstate, PTHREAD_CANCEL_ENABLE);
	zassert_ok(pthread_setcancelstate(PTHREAD_CANCEL_ENABLE, NULL));

	return NULL;
}

static void test_pthread_setcancelstate(void)
{
	pthread_t th;

	zassert_ok(pthread_create(&th, NULL, setcancelstate_fn, NULL));
	zassert_ok(pthread_join(th, NULL));
}

ZTEST_THREADS_BASE(test_pthread_setcancelstate);

static void *setcanceltype_fn(void *arg)
{
	int oldtype = -1;

	ARG_UNUSED(arg);

	zassert_equal(pthread_setcanceltype(PTHREAD_CANCEL_INVALID, NULL), EINVAL);

	/* a new thread's cancelability type is deferred; read it back while toggling */
	zassert_ok(pthread_setcanceltype(PTHREAD_CANCEL_ASYNCHRONOUS, &oldtype));
	zassert_equal(oldtype, PTHREAD_CANCEL_DEFERRED);
	zassert_ok(pthread_setcanceltype(PTHREAD_CANCEL_DEFERRED, &oldtype));
	zassert_equal(oldtype, PTHREAD_CANCEL_ASYNCHRONOUS);

	return NULL;
}

static void test_pthread_setcanceltype(void)
{
	pthread_t th;

	zassert_ok(pthread_create(&th, NULL, setcanceltype_fn, NULL));
	zassert_ok(pthread_join(th, NULL));
}

ZTEST_THREADS_BASE(test_pthread_setcanceltype);

static ZTEST_BMEM pthread_once_t once_control;
static ZTEST_BMEM int once_count;

static void once_func(void)
{
	++once_count;
}

static void *once_fn(void *arg)
{
	ARG_UNUSED(arg);

	zassert_ok(pthread_once(&once_control, once_func));

	return NULL;
}

static void test_pthread_once(void)
{
	pthread_t th;

	once_control = (pthread_once_t)PTHREAD_ONCE_INIT;
	once_count = 0;

	zassert_ok(pthread_once(&once_control, once_func));
	zassert_ok(pthread_once(&once_control, once_func));

	zassert_ok(pthread_create(&th, NULL, once_fn, NULL));
	zassert_ok(pthread_join(th, NULL));

	zassert_equal(once_count, 1, "init routine ran %d times", once_count);
}

ZTEST_THREADS_BASE(test_pthread_once);

static void *pthread_exit_fn(void *arg)
{
	pthread_exit(arg);

	zassert_unreachable();
	return NULL;
}

static void test_pthread_exit(void)
{
	pthread_t th;
	void *retval = NULL;

	zassert_ok(pthread_create(&th, NULL, pthread_exit_fn, INT_TO_POINTER(42)));
	zassert_ok(pthread_join(th, &retval));
	zassert_equal(POINTER_TO_INT(retval), 42);
}

ZTEST_THREADS_BASE(test_pthread_exit);

static ZTEST_BMEM bool detached_fn_done;

static void *detached_fn(void *arg)
{
	ARG_UNUSED(arg);

	msleep(20);
	detached_fn_done = true;

	return NULL;
}

static void test_pthread_detach(void)
{
	pthread_t th;

	detached_fn_done = false;
	zassert_ok(pthread_create(&th, NULL, detached_fn, NULL));
	zassert_ok(pthread_detach(th));

	for (size_t i = 0; i < 100 && !detached_fn_done; ++i) {
		msleep(20);
	}
	zassert_true(detached_fn_done, "detached thread did not finish");
}

ZTEST_THREADS_BASE(test_pthread_detach);

static void test_pthread_join(void)
{
	void *retval;

	/* joining with self is a deadlock */
	zassert_equal(pthread_join(pthread_self(), &retval), EDEADLK);
}

ZTEST_THREADS_BASE(test_pthread_join);

static void *pthread_create_fn(void *arg)
{
	ARG_UNUSED(arg);

	return NULL;
}

static void test_pthread_create(void)
{
#if defined(_POSIX_THREAD_PRIORITY_SCHEDULING)
	pthread_t th;
	pthread_attr_t eattr;
	struct sched_param param;

	posix_test_skip_if_native_libc();

	/* create with explicitly-scheduled attributes rather than inherited */
	zassert_ok(pthread_attr_init(&eattr));
	zassert_ok(pthread_attr_getschedparam(&eattr, &param));
	zassert_ok(pthread_attr_setinheritsched(&eattr, PTHREAD_EXPLICIT_SCHED));
	zassert_ok(pthread_attr_setschedparam(&eattr, &param));
	zassert_ok(pthread_create(&th, &eattr, pthread_create_fn, NULL));
	zassert_ok(pthread_join(th, NULL));
	zassert_ok(pthread_attr_destroy(&eattr));
#else
	ztest_test_skip();
#endif
}

ZTEST_THREADS_BASE(test_pthread_create);

static ZTEST_BMEM int cleanup_order[2];
static ZTEST_BMEM int cleanup_calls;

static void cleanup_record(void *arg)
{
	cleanup_order[cleanup_calls++] = POINTER_TO_INT(arg);
}

static void *cleanup_on_exit_fn(void *arg)
{
	ARG_UNUSED(arg);

	pthread_cleanup_push(cleanup_record, INT_TO_POINTER(1));
	pthread_cleanup_push(cleanup_record, INT_TO_POINTER(2));
	pthread_exit(NULL);
	pthread_cleanup_pop(0);
	pthread_cleanup_pop(0);

	return NULL;
}

static void test_pthread_cleanup_on_exit(void)
{
	pthread_t th;

	cleanup_calls = 0;
	zassert_ok(pthread_create(&th, NULL, cleanup_on_exit_fn, NULL));
	zassert_ok(pthread_join(th, NULL));

	/* handlers still pushed at pthread_exit() run in reverse push order */
	zassert_equal(cleanup_calls, 2);
	zassert_equal(cleanup_order[0], 2);
	zassert_equal(cleanup_order[1], 1);
}

ZTEST_THREADS_BASE(test_pthread_cleanup_on_exit);
```

## src/pthread_atfork.c
```c
/*
 * SPDX-FileCopyrightText: Copyright The Zephyr Project Contributors
 * SPDX-License-Identifier: Apache-2.0
 */

#include <pthread.h>

#include <zephyr/ztest.h>

#include "_main.h"

static void test_pthread_atfork(void)
{
	/*
	 * fork() does not exist, so registered handlers can never run;
	 * registration itself succeeds (and NULL handlers are permitted)
	 */
	zassert_ok(pthread_atfork(NULL, NULL, NULL));
}

ZTEST_THREADS_BASE(test_pthread_atfork);
```

## src/pthread_attr_destroy.c
```c
/*
 * SPDX-FileCopyrightText: Copyright The Zephyr Project Contributors
 * SPDX-License-Identifier: Apache-2.0
 */

#include <errno.h>
#include <pthread.h>

#include <zephyr/kernel.h>
#include <zephyr/ztest.h>

#include "../../shared/linux_compat_test.h"
#include "_main.h"

static void test_pthread_attr_destroy(void)
{
	IF_NOT_NATIVE_LIBC({
		if (false) {
			/* undefined behaviour */
			zassert_equal(pthread_attr_destroy((pthread_attr_t *)&uninit_attr), EINVAL);
		}
	})

	/* can destroy an initialized attr */
	zassert_ok(pthread_attr_destroy(&test_attr), "failed to destroy an initialized attr");
	test_attr_valid = false;

	if (!IS_ENABLED(CONFIG_NATIVE_LIBC)) {
		/* glibc does not return EINVAL passing an invalid attribute to pthread_create()
		 * (POSIX non-conformance)
		 */
		cannot_create_thread(&test_attr);
	}

	if (false) {
		/* undefined behaviour */
		zassert_ok(pthread_attr_destroy(&test_attr));
	}

	/* re-initialize so that after() has a valid attr to clean up */
	zassert_ok(pthread_attr_init(&test_attr));
	test_attr_valid = true;
}

ZTEST_THREADS_BASE(test_pthread_attr_destroy);
```

## src/pthread_attr_getdetachstate.c
```c
/*
 * SPDX-FileCopyrightText: Copyright The Zephyr Project Contributors
 * SPDX-License-Identifier: Apache-2.0
 */

#include <errno.h>
#include <pthread.h>

#include <zephyr/ztest.h>

#include "../../shared/linux_compat_test.h"
#include "_main.h"

static void test_pthread_attr_getdetachstate(void)
{
	int detachstate;

	/* degenerate cases */
	IF_NOT_NATIVE_LIBC({
		if (false) {
			/* undefined behaviour */
			zassert_equal(pthread_attr_getdetachstate(NULL, NULL), EINVAL);
			zassert_equal(pthread_attr_getdetachstate(NULL, &detachstate), EINVAL);
			zassert_equal(pthread_attr_getdetachstate(&uninit_attr, &detachstate),
				      EINVAL);
		}
		/* avoid glibc non-null compiler warning promoted to error */
		zassert_equal(pthread_attr_getdetachstate(&test_attr, NULL), EINVAL);
	})

	/* default detachstate is joinable */
	zassert_ok(pthread_attr_getdetachstate(&test_attr, &detachstate));
	zassert_equal(detachstate, PTHREAD_CREATE_JOINABLE);
	can_create_thread(&test_attr);
}

ZTEST_THREADS_BASE(test_pthread_attr_getdetachstate);
```
