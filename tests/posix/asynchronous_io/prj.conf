## CMakeLists.txt
```
# SPDX-License-Identifier: Apache-2.0

cmake_minimum_required(VERSION 3.20.0)
find_package(Zephyr REQUIRED HINTS $ENV{ZEPHYR_BASE})
project(posix_asynchronous_io)

FILE(GLOB app_sources src/*.c)
target_sources(app PRIVATE ${app_sources})

target_compile_options(app PRIVATE -U_POSIX_C_SOURCE -D_POSIX_C_SOURCE=200809L)
```

## prj.conf
```kconfig
CONFIG_ZTEST=y

CONFIG_POSIX_AEP_CHOICE_BASE=y
CONFIG_POSIX_ASYNCHRONOUS_IO=y

# exercise SIGEV_THREAD notification attribute translation
CONFIG_POSIX_THREAD_ATTR_STACKSIZE=y
CONFIG_POSIX_THREAD_PRIORITY_SCHEDULING=y
CONFIG_POSIX_DEVICE_IO=y
CONFIG_POSIX_SIGNALS=y
CONFIG_POSIX_REALTIME_SIGNALS=y
CONFIG_EVENTFD=y

CONFIG_FILE_SYSTEM=y
CONFIG_FAT_FILESYSTEM_ELM=y

# 4 guaranteed (statically allocated) asynchronous I/O requests
CONFIG_SYS_AIO_MIN_ADD_TEST=4

# stdio (3) + file fds (2) + eventfd (1)
CONFIG_ZVFS_OPEN_IGNORE_MIN=y
CONFIG_ZVFS_OPEN_MAX=8

CONFIG_HEAP_MEM_POOL_SIZE=32768
CONFIG_COMMON_LIBC_MALLOC_ARENA_SIZE=16384
CONFIG_MAIN_STACK_SIZE=4096
CONFIG_ZTEST_STACK_SIZE=4096
CONFIG_TEST_EXTRA_STACK_SIZE=4096
```

## app.overlay
```dts
/*
 * SPDX-FileCopyrightText: Copyright The Zephyr Project Contributors
 *
 * SPDX-License-Identifier: Apache-2.0
 */

/ {
	ramdisk0 {
		compatible = "zephyr,ram-disk";
		disk-name = "RAM";
		sector-size = <512>;
		sector-count = <160>;
	};
};
```

## src/main.c
```c
/*
 * SPDX-FileCopyrightText: Copyright The Zephyr Project Contributors
 *
 * SPDX-License-Identifier: Apache-2.0
 */

#include "asynchronous_io_tests.h"

#include <ff.h>
#include <zephyr/fs/fs.h>
#ifdef CONFIG_USERSPACE
#include <zephyr/sys/fdtable.h>
#include <zephyr/sys/internal/fdtable_priv.h>
#endif

#ifdef CONFIG_NATIVE_LIBC
#define AIO_TEST_FILE "/tmp/posix_aio_testfile.txt"
#else
/* an 8.3 name: FAT long file name support is not assumed */
#define AIO_TEST_FILE "/RAM:/aiotest.txt"
#endif

ZTEST_BMEM int aio_file_fd = -1;
ZTEST_BMEM int aio_filero_fd = -1;
ZTEST_BMEM int aio_efd = -1;

static FATFS fat_fs;
static struct fs_mount_t fs_mnt = {
	.type = FS_FATFS,
	.mnt_point = "/RAM:",
	.fs_data = &fat_fs,
};

#ifdef CONFIG_NATIVE_LIBC
/*
 * Under the host libc the notification signal is a real process-directed
 * signal: leaving it blocked and waiting for it with sigtimedwait() would
 * stall native_sim, and leaving it unhandled would kill the process. Capture
 * deliveries in a handler instead and consume them from a counter.
 *
 * aio_arm_sig() resets the counter so a completion that races ahead of
 * aio_accept_sig() (common when reap runs first) is still observed.
 */
static volatile int lc_count;
static siginfo_t lc_info;

static void lc_capture(int signo, siginfo_t *info, void *ctx)
{
	ARG_UNUSED(ctx);

	lc_info = *info;
	lc_info.si_signo = signo;
	lc_count++;
}

void aio_arm_sig(int signo)
{
	struct sigaction act = {
		.sa_flags = SA_SIGINFO,
		.sa_sigaction = lc_capture,
	};

	lc_count = 0;
	zassert_ok(sigemptyset(&act.sa_mask));
	zassert_ok(sigaction(signo, &act, NULL));
}

int aio_accept_sig(int signo, siginfo_t *info, int timeout_ms)
{
	ARG_UNUSED(signo);

	for (int elapsed = 0; elapsed <= timeout_ms; elapsed += 5) {
		if (lc_count > 0) {
			lc_count--;
			if (info != NULL) {
				*info = lc_info;
			}
			return lc_info.si_signo;
		}
		const struct timespec delay = {.tv_nsec = 5000000L};

		(void)nanosleep(&delay, NULL);
	}

	errno = EAGAIN;
	return -1;
}
#else
void aio_arm_sig(int signo)
{
	sigset_t set;

	zassert_ok(sigemptyset(&set));
	zassert_ok(sigaddset(&set, signo));
	zassert_ok(sigprocmask(SIG_BLOCK, &set, NULL));
}

int aio_accept_sig(int signo, siginfo_t *info, int timeout_ms)
{
	sigset_t set;
	struct timespec timeout = {
		.tv_sec = timeout_ms / MSEC_PER_SEC,
		.tv_nsec = (timeout_ms % MSEC_PER_SEC) * NSEC_PER_MSEC,
	};

	zassert_ok(sigemptyset(&set));
	zassert_ok(sigaddset(&set, signo));

	return sigtimedwait(&set, info, &timeout);
}
#endif /* CONFIG_NATIVE_LIBC */

static void grant_fd(int fd)
{
#ifdef CONFIG_USERSPACE
	k_object_access_all_grant(zvfs_fd_entry_get(fd));
#else
	ARG_UNUSED(fd);
#endif
}

static void *aio_test_setup(void)
{
	memset(&fat_fs, 0, sizeof(fat_fs));
	zassert_ok(fs_mount(&fs_mnt));

	return NULL;
}

static void aio_test_before(void *arg)
{
	ARG_UNUSED(arg);

	/* start from a fresh file each test */
#ifdef CONFIG_NATIVE_LIBC
	(void)unlink(AIO_TEST_FILE);
#else
	(void)fs_unlink(AIO_TEST_FILE);
#endif

	aio_file_fd = open(AIO_TEST_FILE, O_RDWR | O_CREAT, 0644);
	zassert_true(aio_file_fd >= 0, "open failed: %d", errno);
	zassert_equal(write(aio_file_fd, AIO_TEST_CONTENT, AIO_TEST_CONTENT_LEN),
		      AIO_TEST_CONTENT_LEN);

	aio_filero_fd = open(AIO_TEST_FILE, O_RDONLY);
	zassert_true(aio_filero_fd >= 0);

	aio_efd = eventfd(0, 0);
	zassert_true(aio_efd >= 0);

	grant_fd(aio_file_fd);
	grant_fd(aio_filero_fd);
	grant_fd(aio_efd);
}

static void aio_test_after(void *arg)
{
	ARG_UNUSED(arg);

	if (aio_efd >= 0) {
		(void)aio_cancel(aio_efd, NULL);
		(void)close(aio_efd);
		aio_efd = -1;
	}
	if (aio_filero_fd >= 0) {
		(void)close(aio_filero_fd);
		aio_filero_fd = -1;
	}
	if (aio_file_fd >= 0) {
		(void)close(aio_file_fd);
		aio_file_fd = -1;
	}
}

static void aio_test_teardown(void *arg)
{
	ARG_UNUSED(arg);

	(void)fs_unmount(&fs_mnt);
}

ZTEST_SUITE(posix_asynchronous_io, NULL, aio_test_setup, aio_test_before, aio_test_after,
	    aio_test_teardown);
```

## src/aio_cancel.c
```c
/*
 * SPDX-FileCopyrightText: Copyright The Zephyr Project Contributors
 *
 * SPDX-License-Identifier: Apache-2.0
 */

#include "asynchronous_io_tests.h"

static void aio_cancel_completed(void)
{
	char buf[4];
	struct aiocb cb = {
		.aio_fildes = aio_file_fd,
		.aio_buf = buf,
		.aio_nbytes = sizeof(buf),
		.aio_offset = 0,
	};

	zassert_ok(aio_read(&cb));
	zassert_ok(aio_test_await(&cb));

	zassert_equal(aio_cancel(aio_file_fd, &cb), AIO_ALLDONE);
	zassert_equal(aio_return(&cb), sizeof(buf));
}

static void aio_cancel_outstanding(void)
{
	eventfd_t value;
	int ret;
	struct aiocb cb = {
		.aio_fildes = aio_efd,
		.aio_buf = &value,
		.aio_nbytes = sizeof(value),
	};

	zassert_ok(aio_read(&cb));

	/* an implementation may already be executing the request */
	ret = aio_cancel(aio_efd, &cb);
	zassert_true((ret == AIO_CANCELED) || (ret == AIO_NOTCANCELED), "unexpected %d", ret);

	if (ret == AIO_CANCELED) {
		zassert_equal(aio_test_await(&cb), ECANCELED);
		zassert_equal(aio_return(&cb), -1);
	} else {
		aio_test_efd_add(aio_efd, 1);
		zassert_equal(aio_test_reap_ok(&cb), sizeof(value));
	}
}

static void aio_cancel_all_idle(void)
{
	/* nothing outstanding on the descriptor */
	zassert_equal(aio_cancel(aio_file_fd, NULL), AIO_ALLDONE);
}

static void aio_cancel_errors(void)
{
	zassert_equal(aio_cancel(-1, NULL), -1);
	zassert_equal(errno, EBADF);
}

ZTEST_USER(posix_asynchronous_io, test_aio_cancel)
{
	aio_cancel_completed();
	aio_cancel_outstanding();
	aio_cancel_all_idle();
	aio_cancel_errors();
}
```

## src/aio_error.c
```c
/*
 * SPDX-FileCopyrightText: Copyright The Zephyr Project Contributors
 *
 * SPDX-License-Identifier: Apache-2.0
 */

#include "asynchronous_io_tests.h"

static void aio_error_tracks_completion(void)
{
	eventfd_t value = 0;
	struct aiocb cb = {
		.aio_fildes = aio_efd,
		.aio_buf = &value,
		.aio_nbytes = sizeof(value),
	};

	zassert_ok(aio_read(&cb));

	/* nothing to read yet: the operation is outstanding */
	zassert_equal(aio_error(&cb), EINPROGRESS);

	aio_test_efd_add(aio_efd, 7);
	zassert_ok(aio_test_await(&cb));

	/* status polling is idempotent until retrieved */
	zassert_ok(aio_error(&cb));
	zassert_equal(aio_return(&cb), sizeof(value));
	zassert_equal(value, 7);
}

static void aio_error_reports_failure(void)
{
	int err;
	struct aiocb cb = {
		.aio_fildes = aio_filero_fd,
		.aio_buf = "nope",
		.aio_nbytes = 4,
	};

	zassert_ok(aio_write(&cb));
	err = aio_test_await(&cb);
	zassert_true((err == EBADF) || (err == EACCES), "unexpected status %d", err);
	zassert_equal(aio_return(&cb), -1);

#ifndef CONFIG_NATIVE_LIBC
	zassert_equal(aio_error(NULL), -1);
	zassert_equal(errno, EINVAL);
#endif /* CONFIG_NATIVE_LIBC */
}

ZTEST_USER(posix_asynchronous_io, test_aio_error)
{
	aio_error_tracks_completion();
	aio_error_reports_failure();
}
```

## src/aio_fsync.c
```c
/*
 * SPDX-FileCopyrightText: Copyright The Zephyr Project Contributors
 *
 * SPDX-License-Identifier: Apache-2.0
 */

#include <pthread.h>

#include "asynchronous_io_tests.h"

static void aio_fsync_sync(int op)
{
	struct aiocb wcb = {
		.aio_fildes = aio_file_fd,
		.aio_buf = "sync",
		.aio_nbytes = 4,
		.aio_offset = 0,
	};
	struct aiocb cb = {
		.aio_fildes = aio_file_fd,
	};

	zassert_ok(aio_write(&wcb));
	zassert_equal(aio_test_reap_ok(&wcb), 4);

	zassert_ok(aio_fsync(op, &cb));
	zassert_equal(aio_test_reap_ok(&cb), 0);
}

static void aio_fsync_errors(void)
{
	struct aiocb cb = {
		.aio_fildes = aio_file_fd,
	};

	zassert_equal(aio_fsync(0x5a5a, &cb), -1);
	zassert_equal(errno, EINVAL);

#ifndef CONFIG_NATIVE_LIBC
	zassert_equal(aio_fsync(O_SYNC, NULL), -1);
	zassert_equal(errno, EINVAL);
#endif /* CONFIG_NATIVE_LIBC */
}

#ifndef CONFIG_NATIVE_LIBC
/* SIGEV_THREAD_ID needs a pthread handle; the host libc wants a kernel tid */
static void aio_fsync_notify_thread_id(void)
{
	siginfo_t info = {0};
	struct aiocb cb = {
		.aio_fildes = aio_file_fd,
		.aio_sigevent = {
			.sigev_notify = SIGEV_THREAD_ID,
			.sigev_signo = SIGUSR2,
			.sigev_value.sival_int = 17,
			.sigev_notify_thread_id = (pid_t)pthread_self(),
		},
	};

	aio_arm_sig(SIGUSR2);

	/* completion signals the designated thread */
	zassert_ok(aio_fsync(O_SYNC, &cb));
	zassert_equal(aio_test_reap_ok(&cb), 0);
	zassert_equal(aio_accept_sig(SIGUSR2, &info, AIO_TEST_TIMEOUT_MS), SIGUSR2);
	zassert_equal(info.si_value.sival_int, 17);

	/* an out-of-range signal is rejected at submission */
	cb.aio_sigevent.sigev_signo = 4096;
	zassert_equal(aio_fsync(O_SYNC, &cb), -1);
	zassert_equal(errno, EINVAL);
}
#endif /* CONFIG_NATIVE_LIBC */

ZTEST_USER(posix_asynchronous_io, test_aio_fsync)
{
	aio_fsync_sync(O_SYNC);
	aio_fsync_sync(O_DSYNC);
	aio_fsync_errors();
#ifndef CONFIG_NATIVE_LIBC
	aio_fsync_notify_thread_id();
#endif
}
```

## src/aio_read.c
```c
/*
 * SPDX-FileCopyrightText: Copyright The Zephyr Project Contributors
 *
 * SPDX-License-Identifier: Apache-2.0
 */

#include "asynchronous_io_tests.h"

static void aio_read_at_offset(void)
{
	char buf[8] = {0};
	struct aiocb cb = {
		.aio_fildes = aio_file_fd,
		.aio_buf = buf,
		.aio_nbytes = sizeof(buf),
		.aio_offset = 4,
	};

	zassert_ok(aio_read(&cb));
	zassert_equal(aio_test_reap_ok(&cb), sizeof(buf));
	zassert_mem_equal(buf, &AIO_TEST_CONTENT[4], sizeof(buf));
}

static void aio_read_at_eof(void)
{
	char buf[8];
	struct aiocb cb = {
		.aio_fildes = aio_file_fd,
		.aio_buf = buf,
		.aio_nbytes = sizeof(buf),
		.aio_offset = AIO_TEST_CONTENT_LEN,
	};

	zassert_ok(aio_read(&cb));
	zassert_equal(aio_test_reap_ok(&cb), 0);
}

static void aio_read_errors(void)
{
	char buf[8];
	int ret;
	struct aiocb cb = {
		.aio_fildes = -1,
		.aio_buf = buf,
		.aio_nbytes = sizeof(buf),
	};

	/* POSIX permits reporting a bad descriptor at submission or completion */
	ret = aio_read(&cb);
	if (ret == 0) {
		zassert_equal(aio_test_await(&cb), EBADF);
		zassert_equal(aio_return(&cb), -1);
	} else {
		zassert_equal(ret, -1);
		zassert_equal(errno, EBADF);
	}

	/* likewise for an invalid offset */
	cb.aio_fildes = aio_file_fd;
	cb.aio_offset = -1;
	ret = aio_read(&cb);
	if (ret == 0) {
		zassert_equal(aio_test_await(&cb), EINVAL);
		zassert_equal(aio_return(&cb), -1);
	} else {
		zassert_equal(ret, -1);
		zassert_equal(errno, EINVAL);
	}

#ifndef CONFIG_NATIVE_LIBC
	zassert_equal(aio_read(NULL), -1);
	zassert_equal(errno, EINVAL);

	/* a priority reduction deeper than AIO_PRIO_DELTA_MAX is rejected */
	cb.aio_offset = 0;
	cb.aio_reqprio = AIO_PRIO_DELTA_MAX + 1;
	zassert_equal(aio_read(&cb), -1);
	zassert_equal(errno, EINVAL);

	/* the deepest expressible reduction is accepted */
	if (AIO_PRIO_DELTA_MAX > 0) {
		cb.aio_reqprio = AIO_PRIO_DELTA_MAX;
		zassert_ok(aio_read(&cb));
		zassert_ok(aio_test_await(&cb));
		zassert_equal(aio_return(&cb), sizeof(buf));
	}
	cb.aio_reqprio = 0;

	/* an unknown notification type is rejected at submission */
	cb.aio_sigevent.sigev_notify = 99;
	zassert_equal(aio_read(&cb), -1);
	zassert_equal(errno, EINVAL);

	/* as is a SIGEV_SIGNAL number outside the supported range */
	cb.aio_sigevent.sigev_notify = SIGEV_SIGNAL;
	cb.aio_sigevent.sigev_signo = 4096;
	zassert_equal(aio_read(&cb), -1);
	zassert_equal(errno, EINVAL);
#endif /* CONFIG_NATIVE_LIBC */
}

static void aio_read_notify_signal(void)
{
	char buf[8] = {0};
	siginfo_t info = {0};
	struct aiocb cb = {
		.aio_fildes = aio_file_fd,
		.aio_buf = buf,
		.aio_nbytes = sizeof(buf),
		.aio_offset = 0,
		.aio_sigevent = {
			.sigev_notify = SIGEV_SIGNAL,
			.sigev_signo = SIGUSR1,
			.sigev_value.sival_int = 42,
		},
	};

	aio_arm_sig(SIGUSR1);

	zassert_ok(aio_read(&cb));
	/* accept before reap: host AIO may deliver SIGUSR1 as soon as it completes */
	zassert_equal(aio_accept_sig(SIGUSR1, &info, AIO_TEST_TIMEOUT_MS), SIGUSR1);
	zassert_equal(info.si_value.sival_int, 42);
	zassert_equal(aio_test_reap_ok(&cb), sizeof(buf));

#ifndef CONFIG_NATIVE_LIBC
	/* SIGEV_SIGNAL with signal number 0 completes without notifying */
	cb.aio_sigevent.sigev_signo = 0;
	zassert_ok(aio_read(&cb));
	zassert_equal(aio_test_reap_ok(&cb), sizeof(buf));
	zassert_equal(aio_accept_sig(SIGUSR1, NULL, 100), -1);
#endif /* CONFIG_NATIVE_LIBC */
}

ZTEST_USER(posix_asynchronous_io, test_aio_read)
{
	aio_read_at_offset();
	aio_read_at_eof();
	aio_read_errors();
	aio_read_notify_signal();
}
```

## src/aio_return.c
```c
/*
 * SPDX-FileCopyrightText: Copyright The Zephyr Project Contributors
 *
 * SPDX-License-Identifier: Apache-2.0
 */

#include "asynchronous_io_tests.h"

static void aio_return_reports_count(void)
{
	char buf[16];
	struct aiocb cb = {
		.aio_fildes = aio_file_fd,
		.aio_buf = buf,
		.aio_nbytes = sizeof(buf),
		.aio_offset = 0,
	};

	zassert_ok(aio_read(&cb));
	zassert_ok(aio_test_await(&cb));
	zassert_equal(aio_return(&cb), sizeof(buf));
}

static void aio_return_reports_failure(void)
{
	int err;
	struct aiocb cb = {
		.aio_fildes = aio_filero_fd,
		.aio_buf = "nope",
		.aio_nbytes = 4,
	};

	zassert_ok(aio_write(&cb));
	err = aio_test_await(&cb);
	zassert_true(err > 0);

	errno = 0;
	zassert_equal(aio_return(&cb), -1);
	if (!IS_ENABLED(CONFIG_POSIX_TEST_LINUX_COMPAT)) {
		/* POSIX does not require aio_return() to set errno; this implementation does */
		zassert_equal(errno, err);
	}
}

static void aio_return_retrieves_once(void)
{
	char buf[4];
	struct aiocb cb = {
		.aio_fildes = aio_file_fd,
		.aio_buf = buf,
		.aio_nbytes = sizeof(buf),
		.aio_offset = 0,
	};

	zassert_ok(aio_read(&cb));
	zassert_ok(aio_test_await(&cb));
	zassert_equal(aio_return(&cb), sizeof(buf));

	/* POSIX leaves a second retrieval undefined; this implementation reports EINVAL */
	zassert_equal(aio_return(&cb), -1);
	zassert_equal(errno, EINVAL);
	zassert_equal(aio_error(&cb), -1);
	zassert_equal(errno, EINVAL);

#ifndef CONFIG_NATIVE_LIBC
	zassert_equal(aio_return(NULL), -1);
	zassert_equal(errno, EINVAL);
#endif /* CONFIG_NATIVE_LIBC */
}

ZTEST_USER(posix_asynchronous_io, test_aio_return)
{
	aio_return_reports_count();
	aio_return_reports_failure();
	if (!IS_ENABLED(CONFIG_POSIX_TEST_LINUX_COMPAT)) {
		/* undefined behaviour territory: only asserted against this implementation */
		aio_return_retrieves_once();
	}
}
```

## src/aio_suspend.c
```c
/*
 * SPDX-FileCopyrightText: Copyright The Zephyr Project Contributors
 *
 * SPDX-License-Identifier: Apache-2.0
 */

#include "asynchronous_io_tests.h"

static void aio_suspend_completed_returns_immediately(void)
{
	char buf[4];
	struct aiocb cb = {
		.aio_fildes = aio_file_fd,
		.aio_buf = buf,
		.aio_nbytes = sizeof(buf),
		.aio_offset = 0,
	};
	const struct aiocb *const list[] = {&cb};
	const struct timespec zero = {0};

	zassert_ok(aio_read(&cb));
	zassert_ok(aio_test_await(&cb));

	/* an already-completed operation never waits, even with a zero timeout */
	zassert_ok(aio_suspend(list, 1, &zero));
	zassert_equal(aio_return(&cb), sizeof(buf));
}

static void aio_suspend_times_out(void)
{
	eventfd_t value;
	struct aiocb cb = {
		.aio_fildes = aio_efd,
		.aio_buf = &value,
		.aio_nbytes = sizeof(value),
	};
	const struct aiocb *const list[] = {&cb};
	const struct timespec short_to = {
		.tv_nsec = 50000000L,
	};

	zassert_ok(aio_read(&cb));

	zassert_equal(aio_suspend(list, 1, &short_to), -1);
	zassert_equal(errno, EAGAIN);

	/* completing the operation satisfies the wait */
	aio_test_efd_add(aio_efd, 1);
	zassert_ok(aio_suspend(list, 1, NULL));
	zassert_equal(aio_test_reap_ok(&cb), sizeof(value));
}

static void aio_suspend_any_of_list(void)
{
	char buf[4];
	eventfd_t value;
	struct aiocb pending = {
		.aio_fildes = aio_efd,
		.aio_buf = &value,
		.aio_nbytes = sizeof(value),
	};
	struct aiocb quick = {
		.aio_fildes = aio_file_fd,
		.aio_buf = buf,
		.aio_nbytes = sizeof(buf),
		.aio_offset = 0,
	};
	const struct aiocb *const list[] = {&pending, NULL, &quick};

	zassert_ok(aio_read(&pending));
	zassert_ok(aio_read(&quick));

	/* the file read completes; the eventfd read stays outstanding */
	zassert_ok(aio_suspend(list, ARRAY_SIZE(list), NULL));
	zassert_equal(aio_test_reap_ok(&quick), sizeof(buf));

	aio_test_efd_add(aio_efd, 1);
	zassert_equal(aio_test_reap_ok(&pending), sizeof(value));
}

#ifndef CONFIG_NATIVE_LIBC
static void aio_suspend_nothing_outstanding(void)
{
	char buf[4];
	struct aiocb stale = {
		.aio_fildes = aio_file_fd,
		.aio_buf = buf,
		.aio_nbytes = sizeof(buf),
		.aio_offset = 0,
	};
	const struct aiocb *const list[] = {NULL, &stale};

	zassert_ok(aio_read(&stale));
	zassert_equal(aio_test_reap_ok(&stale), sizeof(buf));

	/* only null and already-retrieved entries: nothing to wait for */
	zassert_ok(aio_suspend(list, ARRAY_SIZE(list), NULL));
}

static void aio_suspend_errors(void)
{
	eventfd_t value;
	struct aiocb cb = {
		.aio_fildes = aio_efd,
		.aio_buf = &value,
		.aio_nbytes = sizeof(value),
	};
	const struct aiocb *const list[] = {&cb};
	const struct timespec bad = {
		.tv_nsec = -1,
	};

	zassert_equal(aio_suspend(NULL, 1, NULL), -1);
	zassert_equal(errno, EINVAL);
	zassert_equal(aio_suspend(list, -1, NULL), -1);
	zassert_equal(errno, EINVAL);
	zassert_equal(aio_suspend(list, CONFIG_SYS_AIO_WAIT_MAX + 1, NULL), -1);
	zassert_equal(errno, EINVAL);

	/* an invalid timeout only matters with something outstanding */
	zassert_ok(aio_read(&cb));
	zassert_equal(aio_suspend(list, 1, &bad), -1);
	zassert_equal(errno, EINVAL);

	aio_test_efd_add(aio_efd, 1);
	zassert_equal(aio_test_reap_ok(&cb), sizeof(value));
}
#endif /* CONFIG_NATIVE_LIBC */

ZTEST_USER(posix_asynchronous_io, test_aio_suspend)
{
	aio_suspend_completed_returns_immediately();
	aio_suspend_times_out();
	aio_suspend_any_of_list();
#ifndef CONFIG_NATIVE_LIBC
	aio_suspend_nothing_outstanding();
	aio_suspend_errors();
#endif
}
```

## src/aio_write.c
```c
/*
 * SPDX-FileCopyrightText: Copyright The Zephyr Project Contributors
 *
 * SPDX-License-Identifier: Apache-2.0
 */

#include <pthread.h>

#include "asynchronous_io_tests.h"

static void aio_write_at_offset(void)
{
	char check[AIO_TEST_CONTENT_LEN] = {0};
	struct aiocb wcb = {
		.aio_fildes = aio_file_fd,
		.aio_buf = "XXXX",
		.aio_nbytes = 4,
		.aio_offset = 4,
	};
	struct aiocb rcb = {
		.aio_fildes = aio_file_fd,
		.aio_buf = check,
		.aio_nbytes = sizeof(check),
		.aio_offset = 0,
	};

	zassert_ok(aio_write(&wcb));
	zassert_equal(aio_test_reap_ok(&wcb), 4);

	zassert_ok(aio_read(&rcb));
	zassert_equal(aio_test_reap_ok(&rcb), sizeof(check));
	zassert_mem_equal(check, AIO_TEST_CONTENT, 4);
	zassert_mem_equal(&check[4], "XXXX", 4);
	zassert_mem_equal(&check[8], &AIO_TEST_CONTENT[8], AIO_TEST_CONTENT_LEN - 8);
}

static void aio_write_extends_file(void)
{
	char check[4] = {0};
	struct aiocb wcb = {
		.aio_fildes = aio_file_fd,
		.aio_buf = "tail",
		.aio_nbytes = 4,
		.aio_offset = AIO_TEST_CONTENT_LEN,
	};
	struct aiocb rcb = {
		.aio_fildes = aio_file_fd,
		.aio_buf = check,
		.aio_nbytes = sizeof(check),
		.aio_offset = AIO_TEST_CONTENT_LEN,
	};

	zassert_ok(aio_write(&wcb));
	zassert_equal(aio_test_reap_ok(&wcb), 4);

	zassert_ok(aio_read(&rcb));
	zassert_equal(aio_test_reap_ok(&rcb), sizeof(check));
	zassert_mem_equal(check, "tail", 4);
}

static void aio_write_errors(void)
{
	int err;
	struct aiocb cb = {
		.aio_fildes = aio_filero_fd,
		.aio_buf = "nope",
		.aio_nbytes = 4,
	};

	/* writing through a read-only descriptor fails at execution time */
	zassert_ok(aio_write(&cb));
	err = aio_test_await(&cb);
	zassert_true((err == EBADF) || (err == EACCES), "unexpected status %d", err);
	zassert_equal(aio_return(&cb), -1);

#ifndef CONFIG_NATIVE_LIBC
	zassert_equal(aio_write(NULL), -1);
	zassert_equal(errno, EINVAL);

	/* SIGEV_THREAD without a notification function is rejected */
	cb.aio_fildes = aio_file_fd;
	cb.aio_sigevent.sigev_notify = SIGEV_THREAD;
	cb.aio_sigevent.sigev_notify_function = NULL;
	zassert_equal(aio_write(&cb), -1);
	zassert_equal(errno, EINVAL);
#endif /* CONFIG_NATIVE_LIBC */
}

static ZTEST_BMEM volatile int notify_thread_hits;

static void aio_write_notify_fn(union sigval value)
{
	zassert_equal(value.sival_int, 7);
	notify_thread_hits++;
}

static void aio_write_notify_await(int hits)
{
	const struct timespec delay = {
		.tv_nsec = 10000000L,
	};

	for (int i = 0; (i < (AIO_TEST_TIMEOUT_MS / 10)) && (notify_thread_hits < hits); i++) {
		(void)nanosleep(&delay, NULL);
	}
	zassert_equal(notify_thread_hits, hits, "notification function did not run");
}

static void aio_write_notify_thread(void)
{
	pthread_attr_t attr;
	struct aiocb cb = {
		.aio_fildes = aio_file_fd,
		.aio_buf = "note",
		.aio_nbytes = 4,
		.aio_offset = 0,
		.aio_sigevent = {
			.sigev_notify = SIGEV_THREAD,
			.sigev_notify_function = aio_write_notify_fn,
			.sigev_value.sival_int = 7,
		},
	};

	notify_thread_hits = 0;

	/* completion runs the notification function in a fresh thread */
	zassert_ok(aio_write(&cb));
	zassert_equal(aio_test_reap_ok(&cb), 4);
	aio_write_notify_await(1);

	/* thread attributes are honored at submission time */
	zassert_ok(pthread_attr_init(&attr));
	zassert_ok(pthread_attr_setstacksize(&attr, PTHREAD_STACK_MIN));
	cb.aio_sigevent.sigev_notify_attributes = &attr;
	zassert_ok(aio_write(&cb));
	zassert_equal(aio_test_reap_ok(&cb), 4);
	aio_write_notify_await(2);
	zassert_ok(pthread_attr_destroy(&attr));
}

#if defined(CONFIG_POSIX_PRIORITIZED_IO) && !defined(CONFIG_NATIVE_LIBC)
static void aio_write_prioritized(void)
{
	char check[4] = {0};
	struct aiocb low = {
		.aio_fildes = aio_file_fd,
		.aio_buf = "loww",
		.aio_nbytes = 4,
		.aio_offset = 0,
		.aio_reqprio = AIO_PRIO_DELTA_MAX,
	};
	struct aiocb high = {
		.aio_fildes = aio_file_fd,
		.aio_buf = "high",
		.aio_nbytes = 4,
		.aio_offset = 0,
	};
	struct aiocb rcb = {
		.aio_fildes = aio_file_fd,
		.aio_buf = check,
		.aio_nbytes = sizeof(check),
		.aio_offset = 0,
	};

	/*
	 * With the scheduler locked both writes are queued before the service
	 * thread may run: the higher-priority write to the same offset
	 * executes first, so the lower-priority write's bytes land last.
	 */
	k_sched_lock();
	zassert_ok(aio_write(&low));
	zassert_ok(aio_write(&high));
	k_sched_unlock();

	zassert_equal(aio_test_reap_ok(&low), 4);
	zassert_equal(aio_test_reap_ok(&high), 4);

	zassert_ok(aio_read(&rcb));
	zassert_equal(aio_test_reap_ok(&rcb), sizeof(check));
	zassert_mem_equal(check, "loww", 4);
}
#endif /* CONFIG_POSIX_PRIORITIZED_IO && !CONFIG_NATIVE_LIBC */

ZTEST_USER(posix_asynchronous_io, test_aio_write)
{
	aio_write_at_offset();
	aio_write_extends_file();
	aio_write_errors();
	aio_write_notify_thread();
#if defined(CONFIG_POSIX_PRIORITIZED_IO) && !defined(CONFIG_NATIVE_LIBC)
	if (!IS_ENABLED(CONFIG_SMP) && !k_is_user_context()) {
		aio_write_prioritized();
	}
#endif
}
```

## src/asynchronous_io_tests.h
```c
/*
 * SPDX-FileCopyrightText: Copyright The Zephyr Project Contributors
 *
 * SPDX-License-Identifier: Apache-2.0
 */

#ifndef POSIX_ASYNCHRONOUS_IO_TESTS_H_
#define POSIX_ASYNCHRONOUS_IO_TESTS_H_

#include <aio.h>
#include <errno.h>
#include <fcntl.h>
#include <limits.h>
#include <signal.h>
#include <string.h>
#include <sys/eventfd.h>
#include <time.h>
#include <unistd.h>

#include <zephyr/sys/util.h>
#include <zephyr/ztest.h>

/* fixture descriptors, reopened before every test */
extern int aio_file_fd;   /* AIO_TEST_FILE, read-write, filled with AIO_TEST_CONTENT */
extern int aio_filero_fd; /* AIO_TEST_FILE, read-only */
extern int aio_efd;       /* eventfd, initially unreadable */

#define AIO_TEST_CONTENT "The quick brown fox jumps over the lazy dog!"
#define AIO_TEST_CONTENT_LEN (sizeof(AIO_TEST_CONTENT) - 1)

#define AIO_TEST_TIMEOUT_MS 5000

/**
 * @brief Accept one instance of @p signo, waiting up to @p timeout_ms.
 *
 * On @kconfig{CONFIG_NATIVE_LIBC} the signal is a real host signal: a blocking
 * host sigtimedwait() would stall native_sim, so deliveries are captured by a
 * handler and consumed from a counter instead. The counter is cleared by
 * aio_arm_sig(), so a delivery that races ahead of this wait is still seen.
 *
 * @return the signal number, or -1 if none arrived in time.
 */
int aio_accept_sig(int signo, siginfo_t *info, int timeout_ms);

/**
 * @brief Arrange for @p signo to be accepted by aio_accept_sig().
 *
 * Under @kconfig{CONFIG_NATIVE_LIBC}, also clears the capture counter so later
 * accepts only see deliveries after this arm.
 */
void aio_arm_sig(int signo);

/**
 * @brief Wait until the operation on @p acb completes.
 *
 * Waits with a bounded aio_suspend() polling loop so it is portable to truly
 * asynchronous implementations (the host libc under linux_compat).
 *
 * @return the completion status, as aio_error().
 */
static inline int aio_test_await(const struct aiocb *acb)
{
	const struct timespec delay = {
		.tv_nsec = 10000000L,
	};

	for (int i = 0; i < (AIO_TEST_TIMEOUT_MS / 10); i++) {
		const int err = aio_error(acb);

		if (err != EINPROGRESS) {
			return err;
		}
		(void)aio_suspend((const struct aiocb *const[]){acb}, 1, &delay);
	}

	return aio_error(acb);
}

/** @brief Await successful completion of @p acb and reap its byte count. */
static inline ssize_t aio_test_reap_ok(struct aiocb *acb)
{
	zassert_ok(aio_test_await(acb), "operation failed");

	return aio_return(acb);
}

/**
 * @brief Make @p fd (an eventfd) readable by adding @p value to its counter.
 *
 * Written with write() rather than eventfd_write(): plain descriptor I/O is
 * usable from user mode and against the host libc alike.
 */
static inline void aio_test_efd_add(int fd, eventfd_t value)
{
	zassert_equal(write(fd, &value, sizeof(value)), (ssize_t)sizeof(value));
}

#endif /* POSIX_ASYNCHRONOUS_IO_TESTS_H_ */
```

## src/lio_listio.c
```c
/*
 * SPDX-FileCopyrightText: Copyright The Zephyr Project Contributors
 *
 * SPDX-License-Identifier: Apache-2.0
 */

#include "asynchronous_io_tests.h"

static void lio_listio_wait(void)
{
	char buf[8] = {0};
	struct aiocb rcb = {
		.aio_fildes = aio_file_fd,
		.aio_buf = buf,
		.aio_nbytes = sizeof(buf),
		.aio_offset = 0,
		.aio_lio_opcode = LIO_READ,
	};
	struct aiocb wcb = {
		.aio_fildes = aio_file_fd,
		.aio_buf = "YYYY",
		.aio_nbytes = 4,
		.aio_offset = 8,
		.aio_lio_opcode = LIO_WRITE,
	};
	struct aiocb nop = {
		.aio_lio_opcode = LIO_NOP,
	};
	struct aiocb *const list[] = {&rcb, NULL, &nop, &wcb};

	zassert_ok(lio_listio(LIO_WAIT, list, ARRAY_SIZE(list), NULL));

	/* every operation has completed on return */
	zassert_ok(aio_error(&rcb));
	zassert_ok(aio_error(&wcb));
	zassert_equal(aio_return(&rcb), sizeof(buf));
	zassert_equal(aio_return(&wcb), 4);
	zassert_mem_equal(buf, AIO_TEST_CONTENT, sizeof(buf));
}

static void lio_listio_nowait(void)
{
	char buf[8] = {0};
	struct aiocb rcb = {
		.aio_fildes = aio_file_fd,
		.aio_buf = buf,
		.aio_nbytes = sizeof(buf),
		.aio_offset = 0,
		.aio_lio_opcode = LIO_READ,
	};
	struct aiocb *const list[] = {&rcb};

	zassert_ok(lio_listio(LIO_NOWAIT, list, ARRAY_SIZE(list), NULL));
	zassert_equal(aio_test_reap_ok(&rcb), sizeof(buf));
	zassert_mem_equal(buf, AIO_TEST_CONTENT, sizeof(buf));
}

static void lio_listio_nowait_signal(void)
{
	char b1[4];
	char b2[4];
	siginfo_t info;
	struct aiocb cb1 = {
		.aio_fildes = aio_file_fd,
		.aio_buf = b1,
		.aio_nbytes = sizeof(b1),
		.aio_offset = 0,
		.aio_lio_opcode = LIO_READ,
	};
	struct aiocb cb2 = {
		.aio_fildes = aio_file_fd,
		.aio_buf = b2,
		.aio_nbytes = sizeof(b2),
		.aio_offset = 4,
		.aio_lio_opcode = LIO_READ,
	};
	struct aiocb *const list[] = {&cb1, &cb2};
	struct sigevent sig = {
		.sigev_notify = SIGEV_SIGNAL,
		.sigev_signo = SIGUSR1,
		.sigev_value.sival_int = 99,
	};

	aio_arm_sig(SIGUSR1);

	zassert_ok(lio_listio(LIO_NOWAIT, list, ARRAY_SIZE(list), &sig));

	/* one notification once the whole list has completed */
	zassert_equal(aio_accept_sig(SIGUSR1, &info, AIO_TEST_TIMEOUT_MS), SIGUSR1);
	zassert_equal(info.si_code, SI_ASYNCIO);
	zassert_equal(info.si_value.sival_int, 99);

	zassert_equal(aio_test_reap_ok(&cb1), sizeof(b1));
	zassert_equal(aio_test_reap_ok(&cb2), sizeof(b2));
}

static void lio_listio_wait_failure(void)
{
	struct aiocb bad = {
		.aio_fildes = aio_filero_fd,
		.aio_buf = "nope",
		.aio_nbytes = 4,
		.aio_lio_opcode = LIO_WRITE,
	};
	struct aiocb *const list[] = {&bad};

	/* one of the operations fails: EIO, with per-operation status retrievable */
	zassert_equal(lio_listio(LIO_WAIT, list, ARRAY_SIZE(list), NULL), -1);
	zassert_equal(errno, EIO);
	zassert_equal(aio_return(&bad), -1);

	/* an unknown opcode fails that entry, and the awaited list with it */
	bad.aio_fildes = aio_file_fd;
	bad.aio_lio_opcode = 0x5a5a;
	zassert_equal(lio_listio(LIO_WAIT, list, ARRAY_SIZE(list), NULL), -1);
	zassert_equal(errno, EIO);

	/* under LIO_NOWAIT it fails only that entry, reported through its status */
	zassert_ok(lio_listio(LIO_NOWAIT, list, ARRAY_SIZE(list), NULL));
	zassert_equal(aio_test_await(&bad), EINVAL);
	zassert_equal(aio_cancel(aio_file_fd, &bad), AIO_ALLDONE);
	zassert_equal(aio_return(&bad), -1);

#ifndef CONFIG_NATIVE_LIBC
	/* a submission this implementation rejects up front fails the list call */
	bad.aio_lio_opcode = LIO_READ;
	bad.aio_offset = -1;
	zassert_equal(lio_listio(LIO_NOWAIT, list, ARRAY_SIZE(list), NULL), -1);
	zassert_equal(errno, EIO);
#endif /* CONFIG_NATIVE_LIBC */
}

static void lio_listio_errors(void)
{
	struct aiocb *const list[] = {NULL};

	zassert_equal(lio_listio(0x5a5a, list, 1, NULL), -1);
	zassert_equal(errno, EINVAL);

#ifndef CONFIG_NATIVE_LIBC
	/* an invalid list notification is rejected before anything submits */
	struct sigevent sig = {
		.sigev_notify = SIGEV_THREAD,
		.sigev_notify_function = NULL,
	};

	zassert_equal(lio_listio(LIO_NOWAIT, list, 1, &sig), -1);
	zassert_equal(errno, EINVAL);
#endif /* CONFIG_NATIVE_LIBC */
}

#ifndef CONFIG_NATIVE_LIBC
#define GROUP_EXHAUSTED_N 4

/* wait until at least @p n of @p cbs have left EINPROGRESS */
static void await_completed(const struct aiocb *cbs, size_t n)
{
	const struct timespec delay = {
		.tv_nsec = 10000000L,
	};

	for (int t = 0; t < AIO_TEST_TIMEOUT_MS / 10; t++) {
		const struct aiocb *pending[GROUP_EXHAUSTED_N];
		size_t npending = 0;

		for (size_t i = 0; i < GROUP_EXHAUSTED_N; i++) {
			if (aio_error(&cbs[i]) == EINPROGRESS) {
				pending[npending++] = &cbs[i];
			}
		}

		if (GROUP_EXHAUSTED_N - npending >= n) {
			return;
		}

		(void)aio_suspend(pending, npending, &delay);
	}

	zassert_true(false, "fewer than %zu of %d reads completed", n, GROUP_EXHAUSTED_N);
}

/* only meaningful when the request pool cannot grow (the static_only variant) */
static void lio_listio_group_exhausted(void)
{
	eventfd_t values[GROUP_EXHAUSTED_N];
	struct aiocb cbs[GROUP_EXHAUSTED_N];
	struct aiocb nop = {
		.aio_lio_opcode = LIO_NOP,
	};
	struct aiocb *const list[] = {&nop};
	struct sigevent sig = {
		.sigev_notify = SIGEV_SIGNAL,
		.sigev_signo = SIGUSR1,
	};

	for (size_t i = 0; i < ARRAY_SIZE(cbs); i++) {
		cbs[i] = (struct aiocb){
			.aio_fildes = aio_efd,
			.aio_buf = &values[i],
			.aio_nbytes = sizeof(values[i]),
		};
		zassert_ok(aio_read(&cbs[i]));
	}

	/* the completion group needs a pool slot too */
	zassert_equal(lio_listio(LIO_NOWAIT, list, ARRAY_SIZE(list), &sig), -1);
	zassert_equal(errno, EAGAIN);

	/* each value releases exactly one read, but which one is unspecified */
	for (size_t i = 0; i < ARRAY_SIZE(cbs); i++) {
		aio_test_efd_add(aio_efd, 1);
		await_completed(cbs, i + 1);
	}

	for (size_t i = 0; i < ARRAY_SIZE(cbs); i++) {
		zassert_equal(aio_test_reap_ok(&cbs[i]), sizeof(values[i]));
	}
}
#endif /* CONFIG_NATIVE_LIBC */

ZTEST_USER(posix_asynchronous_io, test_lio_listio)
{
	lio_listio_wait();
	lio_listio_nowait();
	lio_listio_nowait_signal();
	lio_listio_wait_failure();
	lio_listio_errors();
#ifndef CONFIG_NATIVE_LIBC
	if (CONFIG_SYS_AIO_MAX == 4) {
		lio_listio_group_exhausted();
	}
#endif
}
```
