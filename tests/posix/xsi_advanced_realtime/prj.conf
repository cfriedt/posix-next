## CMakeLists.txt
```
# SPDX-License-Identifier: Apache-2.0

cmake_minimum_required(VERSION 3.20.0)
find_package(Zephyr REQUIRED HINTS $ENV{ZEPHYR_BASE})
project(xsi_advanced_realtime)

FILE(GLOB app_sources src/*.c)

target_sources(app PRIVATE ${app_sources})

target_compile_options(app PRIVATE -U_POSIX_C_SOURCE -D_POSIX_C_SOURCE=200809L)
target_compile_options(app PRIVATE -U_XOPEN_SOURCE -D_XOPEN_SOURCE=700)
```

## prj.conf
```kconfig
CONFIG_ZTEST=y

CONFIG_POSIX_AEP_CHOICE_PSE51=y
CONFIG_XSI=y
CONFIG_XSI_ADVANCED_REALTIME=y
CONFIG_POSIX_TIMERS=y
```

## src/clock.c
```c
/*
 * SPDX-FileCopyrightText: Copyright The Zephyr Project Contributors
 * SPDX-License-Identifier: Apache-2.0
 */

#include <errno.h>
#include <time.h>

#include <zephyr/ztest.h>

#include "../../shared/linux_compat_test.h"

#define CLOCK_INVALID ((clockid_t)-1)

ZTEST_USER(xsi_advanced_realtime, test_clock_getcpuclockid)
{
#if defined(_POSIX_CPUTIME)
	clockid_t clock_id = CLOCK_INVALID;

	/* the calling process' CPU-time clock is always accessible */
	zassert_ok(clock_getcpuclockid((pid_t)0, &clock_id));
	zassert_ok(clock_getres(clock_id, NULL));

	if (!IS_ENABLED(CONFIG_NATIVE_LIBC)) {
		/* Zephyr is single-process, so it is always CLOCK_PROCESS_CPUTIME_ID */
		zassert_equal(clock_id, CLOCK_PROCESS_CPUTIME_ID);

		/* other processes do not exist, so their clocks are not accessible */
		zassert_equal(clock_getcpuclockid((pid_t)2482, &clock_id), EPERM);
	}
#else
	ztest_test_skip();
#endif
}

ZTEST_SUITE(xsi_advanced_realtime, NULL, NULL, NULL, NULL, NULL);
```
