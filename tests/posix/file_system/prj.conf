## CMakeLists.txt
```
# SPDX-License-Identifier: Apache-2.0

cmake_minimum_required(VERSION 3.20.0)
find_package(Zephyr REQUIRED HINTS $ENV{ZEPHYR_BASE})
project(posix_file_system)

FILE(GLOB app_sources src/*.c)
target_sources(app PRIVATE ${app_sources})

target_compile_options(app PRIVATE -U_POSIX_C_SOURCE -D_POSIX_C_SOURCE=200809L)
target_compile_options(app PRIVATE -U_XOPEN_SOURCE -D_XOPEN_SOURCE=700)
```

## prj.conf
```kconfig
CONFIG_ZTEST=y

CONFIG_POSIX_AEP_CHOICE_PSE52=y
CONFIG_POSIX_FILE_SYSTEM=y
CONFIG_POSIX_FILE_SYSTEM_R=y
# XSI provides the S_IF* constants and the XSI struct stat members
CONFIG_XSI=y

CONFIG_FILE_SYSTEM=y
CONFIG_FAT_FILESYSTEM_ELM=y

CONFIG_EVENTFD=n

# stdio (3) + fixture rw/ro (2) + directory streams + scratch
CONFIG_ZVFS_OPEN_IGNORE_MIN=y
CONFIG_ZVFS_OPEN_MAX=12
CONFIG_ZVFS_DIR_MAX=4

CONFIG_MAIN_STACK_SIZE=4096
CONFIG_ZTEST_STACK_SIZE=4096
CONFIG_TEST_EXTRA_STACK_SIZE=4096

CONFIG_HEAP_MEM_POOL_SIZE=16384
CONFIG_COMMON_LIBC_MALLOC_ARENA_SIZE=16384
```

## src/main.c
```c
/*
 * SPDX-FileCopyrightText: Copyright The Zephyr Project Contributors
 * SPDX-License-Identifier: Apache-2.0
 */

#include "file_system_tests.h"

#include <fcntl.h>
#include <stdio.h>
#include <string.h>
#include <sys/stat.h>
#include <unistd.h>

#include <zephyr/kernel.h>
#ifndef CONFIG_NATIVE_LIBC
#include <ff.h>
#include <zephyr/fs/fs.h>
#endif
#ifdef CONFIG_USERSPACE
#include <zephyr/sys/fdtable.h>
#include <zephyr/sys/internal/fdtable_priv.h>
extern struct k_mem_partition zvfs_dir_partition;
#endif

ZTEST_BMEM int fs_test_fd = -1;
ZTEST_BMEM int fs_test_rofd = -1;

#ifndef CONFIG_NATIVE_LIBC
static FATFS fat_fs;
static struct fs_mount_t fs_mnt = {
	.type = FS_FATFS,
	.mnt_point = "/",
	.fs_data = &fat_fs,
};
#endif

static void grant_fd(int fd)
{
#ifdef CONFIG_USERSPACE
	if (fd >= 0) {
		k_object_access_all_grant(zvfs_fd_entry_get(fd));
	}
#else
	ARG_UNUSED(fd);
#endif
}

/*
 * Remove a whole subtree. The Zephyr path uses the fs_* API directly: POSIX
 * <dirent.h> and the FATFS ff.h both define a DIR type, so they cannot share
 * a translation unit. Under the host libc, plain POSIX calls are used.
 */
#ifdef CONFIG_NATIVE_LIBC
#include <dirent.h>
static void rmtree(const char *path)
{
	DIR *d = opendir(path);
	struct dirent *e;
	char child[300];

	if (d != NULL) {
		while ((e = readdir(d)) != NULL) {
			if (strcmp(e->d_name, ".") == 0 || strcmp(e->d_name, "..") == 0) {
				continue;
			}
			if (snprintf(child, sizeof(child), "%s/%s", path, e->d_name) >= (int)sizeof(child)) {
				continue;
			}
			rmtree(child);
		}
		closedir(d);
		rmdir(path);
		return;
	}

	(void)unlink(path);
}
#else
static void rmtree(const char *path)
{
	struct fs_dir_t dir;
	struct fs_dirent ent;
	char child[300];

	fs_dir_t_init(&dir);

	if (fs_opendir(&dir, path) == 0) {
		while (fs_readdir(&dir, &ent) == 0 && ent.name[0] != '\0') {
			if (snprintf(child, sizeof(child), "%s/%s", path, ent.name) >= (int)sizeof(child)) {
				continue;
			}
			rmtree(child);
		}
		fs_closedir(&dir);
	}

	(void)fs_unlink(path);
}
#endif

void fs_test_reset(void)
{
	int fd;

	rmtree(TEST_ROOT);

	zassert_ok(mkdir(TEST_ROOT, 0777));

	fd = open(TEST_FILE, O_WRONLY | O_CREAT | O_TRUNC, 0600);
	zassert_true(fd >= 0);
	zassert_equal(write(fd, TEST_CONTENT, strlen(TEST_CONTENT)), strlen(TEST_CONTENT));
	zassert_ok(close(fd));

	fd = open(TEST_EMPTY, O_WRONLY | O_CREAT | O_TRUNC, 0600);
	zassert_true(fd >= 0);
	zassert_ok(close(fd));

	zassert_ok(mkdir(TEST_DIR, 0777));
	fd = open(TEST_SUB, O_WRONLY | O_CREAT, 0600);
	zassert_true(fd >= 0);
	zassert_ok(close(fd));

	(void)unlink(TEST_NOENT);
}

static void before(void *arg)
{
	ARG_UNUSED(arg);

	fs_test_reset();

	fs_test_fd = open(TEST_FILE, O_RDWR);
	zassert_true(fs_test_fd >= 0);
	grant_fd(fs_test_fd);

	fs_test_rofd = open(TEST_FILE, O_RDONLY);
	zassert_true(fs_test_rofd >= 0);
	grant_fd(fs_test_rofd);

	{ int rc = chdir("/"); ARG_UNUSED(rc); }
}

static void after(void *arg)
{
	ARG_UNUSED(arg);

	if (fs_test_fd >= 0) {
		close(fs_test_fd);
		fs_test_fd = -1;
	}
	if (fs_test_rofd >= 0) {
		close(fs_test_rofd);
		fs_test_rofd = -1;
	}
	{ int rc = chdir("/"); ARG_UNUSED(rc); }
}

static void *setup(void)
{
#ifndef CONFIG_NATIVE_LIBC
	memset(&fat_fs, 0, sizeof(fat_fs));
	zassert_ok(fs_mount(&fs_mnt));
#endif
	(void)mkdir(FS_TMPDIR, 0777);
#ifdef CONFIG_USERSPACE
	zassert_ok(k_mem_domain_add_partition(&k_mem_domain_default, &zvfs_dir_partition));
#endif
	return NULL;
}

static void teardown(void *arg)
{
	ARG_UNUSED(arg);
#ifndef CONFIG_NATIVE_LIBC
	rmtree(TEST_ROOT);
	(void)fs_unmount(&fs_mnt);
#endif
}

ZTEST_SUITE(posix_file_system, NULL, setup, before, after, teardown);
```

## src/access.c
```c
/*
 * SPDX-FileCopyrightText: Copyright The Zephyr Project Contributors
 * SPDX-License-Identifier: Apache-2.0
 */

#include "file_system_tests.h"

#include <errno.h>
#include <unistd.h>

ZTEST_USER(posix_file_system, test_access)
{
	zassert_ok(access(TEST_FILE, F_OK));
	zassert_ok(access(TEST_FILE, R_OK | W_OK));
	zassert_ok(access(TEST_DIR, X_OK));

	errno = 0;
	zassert_equal(access(TEST_NOENT, F_OK), -1);
	zassert_equal(errno, ENOENT);

	errno = 0;
	zassert_equal(access(TEST_FILE, 0x1000), -1);
	zassert_equal(errno, EINVAL);
}
```

## src/chdir.c
```c
/*
 * SPDX-FileCopyrightText: Copyright The Zephyr Project Contributors
 * SPDX-License-Identifier: Apache-2.0
 */

#include "file_system_tests.h"

#include <errno.h>
#include <sys/stat.h>
#include <unistd.h>

ZTEST_USER(posix_file_system, test_chdir)
{
	zassert_ok(chdir(TEST_DIR));

	/* relative resolution against the new working directory (Zephyr CWD) */
	IF_NOT_NATIVE_LIBC({
		struct stat st;

		zassert_ok(stat("sub.txt", &st));
	});

	errno = 0;
	zassert_equal(chdir(TEST_FILE), -1);
	zassert_equal(errno, ENOTDIR);

	errno = 0;
	zassert_equal(chdir(TEST_NOENT), -1);
	zassert_equal(errno, ENOENT);

	zassert_ok(chdir("/"));
}
```

## src/closedir.c
```c
/*
 * SPDX-FileCopyrightText: Copyright The Zephyr Project Contributors
 * SPDX-License-Identifier: Apache-2.0
 */

#include "file_system_tests.h"

#include <dirent.h>
#include <errno.h>

ZTEST_USER(posix_file_system, test_closedir)
{
	DIR *d = opendir(TEST_DIR);

	zassert_not_null(d);
	zassert_ok(closedir(d));

	IF_NOT_NATIVE_LIBC({
		errno = 0;
		zassert_equal(closedir(NULL), -1);
		zassert_equal(errno, EBADF);
	});
}
```

## src/creat.c
```c
/*
 * SPDX-FileCopyrightText: Copyright The Zephyr Project Contributors
 * SPDX-License-Identifier: Apache-2.0
 */

#include "file_system_tests.h"

#include <fcntl.h>
#include <sys/stat.h>
#include <unistd.h>

ZTEST_USER(posix_file_system, test_creat)
{
	struct stat st;
	int fd = creat(TEST_ROOT "/c.txt", 0600);

	zassert_true(fd >= 0);
	zassert_ok(close(fd));
	zassert_ok(stat(TEST_ROOT "/c.txt", &st));
	zassert_equal(st.st_size, 0);
	zassert_ok(unlink(TEST_ROOT "/c.txt"));
}
```

## src/fchdir.c
```c
/*
 * SPDX-FileCopyrightText: Copyright The Zephyr Project Contributors
 * SPDX-License-Identifier: Apache-2.0
 */

#include "file_system_tests.h"

#include <errno.h>
#include <fcntl.h>
#include <unistd.h>

ZTEST_USER(posix_file_system, test_fchdir)
{
	int fd = open(TEST_DIR, O_RDONLY | O_DIRECTORY);

	zassert_true(fd >= 0);
	zassert_ok(fchdir(fd));

	IF_NOT_NATIVE_LIBC({
		char buf[64];

		/*
		 * The Zephyr working directory is lexical; the host may
		 * canonicalize symlinks, so only compare it there.
		 */
		zassert_not_null(getcwd(buf, sizeof(buf)));
		zassert_str_equal(buf, TEST_DIR);
	});

	zassert_ok(close(fd));

	/* fchdir() on a non-directory descriptor fails with ENOTDIR */
	fd = open(TEST_FILE, O_RDONLY);
	zassert_true(fd >= 0);
	errno = 0;
	zassert_equal(fchdir(fd), -1);
	zassert_equal(errno, ENOTDIR, "expected ENOTDIR got %d", errno);
	zassert_ok(close(fd));

	zassert_ok(chdir("/"));
}
```

## src/file_system_tests.h
```c
/*
 * SPDX-FileCopyrightText: Copyright The Zephyr Project Contributors
 * SPDX-License-Identifier: Apache-2.0
 */

#ifndef POSIX_TESTS_FILE_SYSTEM_TESTS_H_
#define POSIX_TESTS_FILE_SYSTEM_TESTS_H_

#include <zephyr/ztest.h>

#include "../../shared/linux_compat_test.h"

/*
 * The file system is mounted at "/", and /tmp exists in both worlds (the FAT
 * RAM disk under Zephyr, the host filesystem under CONFIG_NATIVE_LIBC), so
 * every path constant is identical for the linux_compat variant.
 */
#define FS_TMPDIR   "/tmp"
#define TEST_ROOT   FS_TMPDIR "/pfs"
#define TEST_FILE   TEST_ROOT "/file.txt"
#define TEST_EMPTY  TEST_ROOT "/empty.txt"
#define TEST_DIR    TEST_ROOT "/dir"
#define TEST_SUB    TEST_DIR "/sub.txt"
#define TEST_NOENT  TEST_ROOT "/nope.txt"
#define TEST_CONTENT "The quick brown fox jumps over the lazy dog!"

/* fixture descriptors, opened and granted per test */
extern int fs_test_fd;   /* TEST_FILE, O_RDWR */
extern int fs_test_rofd; /* TEST_FILE, O_RDONLY */

/* rebuild the baseline tree; kernel-mode machinery, used from before() */
void fs_test_reset(void);

#endif /* POSIX_TESTS_FILE_SYSTEM_TESTS_H_ */
```

## src/fpathconf.c
```c
/*
 * SPDX-FileCopyrightText: Copyright The Zephyr Project Contributors
 * SPDX-License-Identifier: Apache-2.0
 */

#include "file_system_tests.h"

#include <errno.h>
#include <unistd.h>

ZTEST_USER(posix_file_system, test_fpathconf)
{
	zassert_true(fpathconf(fs_test_fd, _PC_PATH_MAX) > 0);
	IF_NOT_NATIVE_LIBC({
		zassert_equal(fpathconf(fs_test_fd, _PC_LINK_MAX), 1);
	});

	/* special characters belong to terminals: the console has them, a file has no
	 * association (the host reports the value for any file)
	 */
	IF_NOT_NATIVE_LIBC({
		errno = 0;
		zassert_equal(fpathconf(fs_test_fd, _PC_VDISABLE), -1);
		zassert_equal(errno, 0);
		zassert_equal(fpathconf(STDIN_FILENO, _PC_VDISABLE), _POSIX_VDISABLE);
	});
}
```

## src/fstat.c
```c
/*
 * SPDX-FileCopyrightText: Copyright The Zephyr Project Contributors
 * SPDX-License-Identifier: Apache-2.0
 */

#include "file_system_tests.h"

#include <string.h>
#include <sys/stat.h>

ZTEST_USER(posix_file_system, test_fstat)
{
	struct stat st;

	zassert_ok(fstat(fs_test_fd, &st));
	zassert_equal(st.st_size, strlen(TEST_CONTENT));
	zassert_true(S_ISREG(st.st_mode));

	/* identity: the descriptor names the same file as its path */
	{
		struct stat by_path;

		zassert_ok(stat(TEST_FILE, &by_path));
		zassert_equal(st.st_dev, by_path.st_dev);
		zassert_equal(st.st_ino, by_path.st_ino);
	}
	zassert_equal(fstat(fs_test_rofd, &st), 0);
}
```

## src/fstatvfs.c
```c
/*
 * SPDX-FileCopyrightText: Copyright The Zephyr Project Contributors
 * SPDX-License-Identifier: Apache-2.0
 */

#include "file_system_tests.h"

#include <sys/statvfs.h>

ZTEST_USER(posix_file_system, test_fstatvfs)
{
	struct statvfs a, b;

	zassert_ok(fstatvfs(fs_test_fd, &a));
	zassert_ok(statvfs(TEST_FILE, &b));
	zassert_equal(a.f_bsize, b.f_bsize);
}
```

## src/futimens.c
```c
/*
 * SPDX-FileCopyrightText: Copyright The Zephyr Project Contributors
 * SPDX-License-Identifier: Apache-2.0
 */

#include "file_system_tests.h"

#include <errno.h>
#include <sys/stat.h>
#include <time.h>

ZTEST_USER(posix_file_system, test_futimens)
{
	struct timespec times[2] = {
		{.tv_sec = 1700000000, .tv_nsec = 0},
		{.tv_sec = 1700000100, .tv_nsec = 0},
	};
	struct timespec now;
	struct stat st;
	int rc;

	errno = 0;
	zassert_equal(futimens(-1, times), -1);
	zassert_equal(errno, EBADF);

	/* an out-of-range tv_nsec is rejected before the file system is asked */
	times[1].tv_nsec = NSEC_PER_SEC;
	errno = 0;
	zassert_equal(futimens(fs_test_fd, times), -1);
	zassert_equal(errno, EINVAL);
	times[1].tv_nsec = 0;

	/* times are stored as given, kept for UTIME_OMIT and resolved for UTIME_NOW */
	rc = futimens(fs_test_fd, times);
	if (rc < 0) {
		/* backends without timestamp support report ENOTSUP */
		zassert_equal(errno, ENOTSUP, "errno %d", errno);
		return;
	}
	zassert_ok(fstat(fs_test_fd, &st));
	zassert_equal(st.st_mtim.tv_sec, times[1].tv_sec);

	times[0].tv_nsec = UTIME_OMIT;
	times[1].tv_sec = 1700000200;
	zassert_ok(futimens(fs_test_fd, times));
	zassert_ok(fstat(fs_test_fd, &st));
	zassert_equal(st.st_mtim.tv_sec, 1700000200);

	zassert_ok(clock_gettime(CLOCK_REALTIME, &now));
	times[0].tv_nsec = UTIME_NOW;
	times[1].tv_nsec = UTIME_OMIT;
	zassert_ok(futimens(fs_test_fd, times));
	zassert_ok(fstat(fs_test_fd, &st));
	zassert_equal(st.st_mtim.tv_sec, 1700000200);

	zassert_ok(futimens(fs_test_fd, NULL));
	zassert_ok(fstat(fs_test_fd, &st));
	zassert_true(st.st_mtim.tv_sec >= now.tv_sec - 2, "mtime %lld", (long long)st.st_mtim.tv_sec);
}
```

## src/getcwd.c
```c
/*
 * SPDX-FileCopyrightText: Copyright The Zephyr Project Contributors
 * SPDX-License-Identifier: Apache-2.0
 */

#include "file_system_tests.h"

#include <errno.h>
#include <unistd.h>

ZTEST_USER(posix_file_system, test_getcwd)
{
	char buf[64];

	zassert_ok(chdir("/"));
	zassert_equal_ptr(getcwd(buf, sizeof(buf)), buf);
	zassert_str_equal(buf, "/");

	IF_NOT_NATIVE_LIBC({
		zassert_ok(chdir(TEST_DIR));
		zassert_not_null(getcwd(buf, sizeof(buf)));
		zassert_str_equal(buf, TEST_DIR);

		errno = 0;
		zassert_is_null(getcwd(buf, 2));
		zassert_equal(errno, ERANGE);
	});

	zassert_ok(chdir("/"));
}
```

## src/link.c
```c
/*
 * SPDX-FileCopyrightText: Copyright The Zephyr Project Contributors
 * SPDX-License-Identifier: Apache-2.0
 */

#include "file_system_tests.h"

#include <errno.h>
#include <unistd.h>

ZTEST_USER(posix_file_system, test_link)
{
	if (IS_ENABLED(CONFIG_NATIVE_LIBC)) {
		/* the host filesystem supports hard links */
		zassert_ok(link(TEST_FILE, TEST_NOENT));
		zassert_ok(unlink(TEST_NOENT));
	} else {
		errno = 0;
		zassert_equal(link(TEST_FILE, TEST_NOENT), -1);
		zassert_equal(errno, EPERM);
	}
}
```
