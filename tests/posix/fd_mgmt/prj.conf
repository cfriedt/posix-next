## CMakeLists.txt
```
# SPDX-License-Identifier: Apache-2.0

cmake_minimum_required(VERSION 3.20.0)
find_package(Zephyr REQUIRED HINTS $ENV{ZEPHYR_BASE})
project(posix_fd_mgmt)

target_sources(app PRIVATE src/main.c src/test_mount.c)

target_compile_options(app PRIVATE -U_POSIX_C_SOURCE -D_POSIX_C_SOURCE=200809L)
target_compile_options(app PRIVATE -U_XOPEN_SOURCE -D_XOPEN_SOURCE=700)
```

## Kconfig
```
# SPDX-FileCopyrightText: Copyright The Zephyr Project Contributors
# SPDX-License-Identifier: Apache-2.0

source "Kconfig.zephyr"
rsource "../Kconfig.test_common"
```

## prj.conf
```kconfig
CONFIG_ZTEST=y
CONFIG_MAIN_STACK_SIZE=4096
CONFIG_ZTEST_STACK_SIZE=2048

CONFIG_EVENTFD=y
CONFIG_POSIX_AEP_CHOICE_PSE52=y
CONFIG_POSIX_DEVICE_IO=y
CONFIG_POSIX_FD_MGMT=y

CONFIG_FILE_SYSTEM=y
CONFIG_FAT_FILESYSTEM_ELM=y
CONFIG_POSIX_FILE_SYSTEM=y
CONFIG_XSI=y
CONFIG_ZVFS_OPEN_MAX=15
```

## src/main.c
```c
/*
 * Copyright (c) 2018 Intel Corporation
 * Copyright (c) 2024 Friedt Professional Engineering Services, Inc.
 *
 * SPDX-License-Identifier: Apache-2.0
 */

#include <errno.h>
#include <fcntl.h>
#include <stdio.h>
#include <string.h>
#include <sys/eventfd.h>
#include <unistd.h>

#include <zephyr/ztest.h>

#include "../../shared/linux_compat_test.h"
#include "test_fs.h"

#define EFD_INTERNAL_FLAG 0x1 /* ZVFS_EFD_IN_USE; not settable via F_SETFL */

static void cleanup_test_file(void)
{
	(void)unlink(TEST_FILE);
}

static int open_test_file(void)
{
	int fd;

	cleanup_test_file();

	fd = open(TEST_FILE, O_CREAT | O_RDWR | O_TRUNC, 0660);
	zassert_true(fd >= 0, "open() failed, errno=%d", errno);

	return fd;
}

ZTEST_USER(posix_fd_mgmt, test_dup)
{
	static const char payload[] = "dup-file";
	const size_t len = strlen(payload);
	char buf_a[sizeof(payload)];
	char buf_b[sizeof(payload)];
	int fd0;
	int dupfd;

	errno = 0;
	zassert_equal(dup(-1), -1);
	zassert_equal(errno, EBADF);

	fd0 = open_test_file();
	dupfd = dup(fd0);
	zassert_true(dupfd >= 0, "dup() failed: %d", errno);
	zassert_not_equal(dupfd, fd0, "dup() returned the same fd");

	zassert_equal(write(fd0, payload, len), (ssize_t)len);
	zassert_equal(lseek(fd0, 0, SEEK_SET), 0);

	/* dup'd fds share one file offset (POSIX open file description). */
	{
		const size_t split = 3;

		zassert_equal(read(fd0, buf_a, split), (ssize_t)split);
		zassert_equal(read(dupfd, buf_b, len - split), (ssize_t)(len - split));
		buf_a[split] = '\0';
		buf_b[len - split] = '\0';
		zassert_mem_equal(buf_a, payload, split);
		zassert_mem_equal(buf_b, payload + split, len - split);
	}

	zassert_ok(close(dupfd));
	zassert_ok(close(fd0));
	cleanup_test_file();
}

ZTEST_USER(posix_fd_mgmt, test_dup2)
{
	eventfd_t val = 19;
	eventfd_t read_val = 0;
	const int target_fd = 10;
	int efd;
	int fd0;

	fd0 = open_test_file();

	errno = 0;
	zassert_equal(dup2(-1, -1), -1);
	zassert_equal(errno, EBADF);

	errno = 0;
	zassert_equal(dup2(fd0, -1), -1);
	zassert_equal(errno, EBADF);

	errno = 0;
	zassert_equal(dup2(-1, fd0), -1);
	zassert_equal(errno, EBADF);

	zassert_equal(dup2(fd0, target_fd), target_fd, "dup2() returned %d", errno);

	zassert_ok(close(target_fd));
	zassert_ok(close(fd0));
	cleanup_test_file();

	efd = eventfd(0, 0);
	zassert_true(efd >= 0, "eventfd() failed, errno=%d", errno);

	zassert_equal(dup2(efd, target_fd), target_fd, "dup2() returned %d", errno);

	zassert_ok(eventfd_write(target_fd, val));
	zassert_ok(eventfd_read(efd, &read_val));
	zassert_equal(read_val, val, "read_val == %lld", read_val);

	zassert_ok(close(target_fd));
	zassert_ok(close(efd));
}

#if !defined(CONFIG_NATIVE_LIBC) && defined(F_SETLK)
/* outside every user partition: a user-mode caller may not access it */
static struct flock kernel_only_lock;

/* a lock description the caller may not access fails with EFAULT, not a fault */
static void fcntl_lock_efault(int fd)
{
	if (!k_is_user_context()) {
		return;
	}

	errno = 0;
	zassert_equal(fcntl(fd, F_SETLK, &kernel_only_lock), -1);
	zassert_equal(errno, EFAULT, "errno %d", errno);

	errno = 0;
	zassert_equal(fcntl(fd, F_GETLK, &kernel_only_lock), -1);
	zassert_equal(errno, EFAULT, "errno %d", errno);
}
#endif /* !CONFIG_NATIVE_LIBC && F_SETLK */

ZTEST_USER(posix_fd_mgmt, test_fcntl)
{
	eventfd_t val = 42;
	eventfd_t read_val = 0;
	const int minfd = 10;
	int efd;
	int dupfd;
	int file_fd;
	int flags;

	errno = 0;
	zassert_equal(fcntl(-1, F_GETFL), -1);
	zassert_equal(errno, EBADF);

	errno = 0;
	zassert_equal(fcntl(-1, F_DUPFD, 0), -1);
	zassert_equal(errno, EBADF);

	efd = eventfd(0, 0);
	zassert_true(efd >= 0, "eventfd() failed, errno=%d", errno);

	dupfd = fcntl(efd, F_DUPFD, 0);
	zassert_true(dupfd >= 0, "fcntl(F_DUPFD) failed, errno=%d", errno);
	zassert_not_equal(dupfd, efd, "fcntl(F_DUPFD) returned the same fd");

	zassert_ok(eventfd_write(dupfd, val));
	zassert_ok(eventfd_read(efd, &read_val));
	zassert_equal(read_val, val, "read_val == %lld", read_val);
	zassert_ok(close(dupfd));

	dupfd = fcntl(efd, F_DUPFD, minfd);
	zassert_true(dupfd >= minfd, "fcntl(F_DUPFD, %d) returned %d", minfd, dupfd);
	zassert_ok(close(dupfd));

	IF_NOT_NATIVE_LIBC({
		flags = fcntl(efd, F_GETFL);
		zassert_equal(flags, 0, "fcntl(F_GETFL) == %d", flags);

		zassert_ok(fcntl(efd, F_SETFL, O_NONBLOCK),
			   "fcntl(F_SETFL, O_NONBLOCK) failed, errno=%d", errno);

		flags = fcntl(efd, F_GETFL);
		zassert_equal(flags, O_NONBLOCK, "fcntl(F_GETFL) == %d", flags);

		zassert_ok(fcntl(efd, F_SETFL, 0), "fcntl(F_SETFL, 0) failed, errno=%d", errno);

		flags = fcntl(efd, F_GETFL);
		zassert_equal(flags, 0, "fcntl(F_GETFL) == %d", flags);

		errno = 0;
		zassert_equal(fcntl(efd, F_SETFL, EFD_INTERNAL_FLAG), -1);
		zassert_equal(errno, EINVAL);

#ifdef F_GETFD
		flags = fcntl(efd, F_GETFD);
		zassert_equal(flags, 0, "fcntl(F_GETFD) == %d", flags);
#endif
	});

	file_fd = open_test_file();

#ifdef F_GETFD
	flags = fcntl(file_fd, F_GETFD);
	zassert_equal(flags, 0, "fcntl(F_GETFD) == %d", flags);
	zassert_ok(fcntl(file_fd, F_SETFD, FD_CLOEXEC), "fcntl(F_SETFD) failed, errno=%d", errno);
	flags = fcntl(file_fd, F_GETFD);
	zassert_equal(flags, FD_CLOEXEC, "fcntl(F_GETFD) == %d", flags);
#endif

	flags = fcntl(file_fd, F_GETFL);
	zassert_true(flags >= 0, "fcntl(F_GETFL) on file failed, errno=%d", errno);
	zassert_equal(flags & O_ACCMODE, O_RDWR, "fcntl(F_GETFL) == %#x", flags);

#if !defined(CONFIG_NATIVE_LIBC) && defined(F_SETLK)
	{
		struct flock fl = {
			.l_type = F_WRLCK,
			.l_whence = SEEK_SET,
			.l_start = 0,
			.l_len = 10,
		};

		zassert_ok(fcntl(file_fd, F_SETLK, &fl), "fcntl(F_SETLK) failed, errno=%d", errno);

		dupfd = dup(file_fd);
		zassert_true(dupfd >= 0, "dup() failed, errno=%d", errno);

		fl = (struct flock){
			.l_type = F_UNLCK,
			.l_whence = SEEK_SET,
			.l_start = 0,
			.l_len = 10,
		};
		zassert_ok(fcntl(dupfd, F_SETLK, &fl),
			   "fcntl(F_SETLK, F_UNLCK) on dup failed, errno=%d", errno);

		fl = (struct flock){
			.l_type = F_WRLCK,
			.l_whence = SEEK_SET,
			.l_start = 0,
			.l_len = 10,
		};
		zassert_ok(fcntl(file_fd, F_GETLK, &fl), "fcntl(F_GETLK) failed, errno=%d", errno);
		zassert_equal(fl.l_type, F_UNLCK);

		zassert_ok(close(dupfd));
		fcntl_lock_efault(file_fd);
	}
#endif /* !CONFIG_NATIVE_LIBC && F_SETLK */

	zassert_ok(close(file_fd));
	cleanup_test_file();
	zassert_ok(close(efd));
}

ZTEST_USER(posix_fd_mgmt, test_dup_eventfd)
{
	eventfd_t val = 77;
	eventfd_t read_val = 0;
	int efd;
	int dupfd;

	efd = eventfd(0, 0);
	zassert_true(efd >= 0, "eventfd() failed, errno=%d", errno);

	dupfd = dup(efd);
	zassert_true(dupfd >= 0, "dup() failed, errno=%d", errno);
	zassert_not_equal(dupfd, efd, "dup() returned the same fd");

	zassert_ok(eventfd_write(efd, val));
	zassert_ok(eventfd_read(dupfd, &read_val));
	zassert_equal(read_val, val, "read_val == %lld", read_val);

	zassert_ok(close(dupfd));
	zassert_ok(close(efd));
}

ZTEST_USER(posix_fd_mgmt, test_ftruncate)
{
	static const char payload[] = "ftruncate-test";
	const size_t len = strlen(payload);
	const off_t truncated = 4;
	int fd;

	zassert_equal(ftruncate(-1, 0), -1);

	fd = open_test_file();

	zassert_equal(write(fd, payload, len), (ssize_t)len);
	zassert_ok(ftruncate(fd, truncated));
	zassert_equal(lseek(fd, 0, SEEK_END), truncated);

	zassert_ok(close(fd));
	cleanup_test_file();
}

ZTEST_USER(posix_fd_mgmt, test_lseek)
{
	static const char payload[] = "lseek-test";
	const size_t len = strlen(payload);
	char buf[4];
	int fd;

	zassert_equal(lseek(-1, 0, SEEK_SET), (off_t)-1);

	fd = open_test_file();

	zassert_equal(write(fd, payload, len), (ssize_t)len);
	zassert_equal(lseek(fd, 0, SEEK_SET), 0);
	zassert_equal(lseek(fd, (off_t)len, SEEK_SET), (off_t)len);
	zassert_equal(lseek(fd, 0, SEEK_END), (off_t)len);
	zassert_equal(lseek(fd, -2, SEEK_END), (off_t)(len - 2));

	/* SEEK_CUR is relative to the fd offset advanced by read()/write() */
	zassert_equal(lseek(fd, 0, SEEK_SET), 0);
	zassert_equal(read(fd, buf, sizeof(buf)), (ssize_t)sizeof(buf));
	zassert_equal(lseek(fd, 0, SEEK_CUR), (off_t)sizeof(buf));
	zassert_equal(lseek(fd, 2, SEEK_CUR), (off_t)(sizeof(buf) + 2));
	zassert_equal(lseek(fd, -2, SEEK_CUR), (off_t)sizeof(buf));

	zassert_ok(close(fd));
	cleanup_test_file();
}

ZTEST(posix_fd_mgmt, test_fseeko_ftello)
{
	static const char payload[] = "fseeko-ftello";
	char buf[sizeof(payload)] = {0};
	FILE *fp;
	off_t pos;
	size_t len = strlen(payload);

	cleanup_test_file();

	fp = fopen(TEST_FILE, "w");
	zassert_not_null(fp, "fopen(w) failed, errno=%d", errno);
	zassert_equal(fwrite(payload, 1, len, fp), len);
	zassert_ok(fclose(fp));

	fp = fopen(TEST_FILE, "r+");
	zassert_not_null(fp, "fopen(r+) failed, errno=%d", errno);

	zassert_ok(fseeko(fp, 0, SEEK_SET));
	pos = ftello(fp);
	zassert_equal(pos, 0, "ftello(SEEK_SET) == %lld", (long long)pos);

	zassert_ok(fseeko(fp, 0, SEEK_END));
	pos = ftello(fp);
	zassert_equal(pos, (off_t)len, "ftello(SEEK_END) == %lld", (long long)pos);

	zassert_ok(fseeko(fp, 0, SEEK_SET));
	zassert_equal(fread(buf, 1, len, fp), len);
	zassert_mem_equal(buf, payload, len, "fread() data mismatch");

	zassert_ok(fclose(fp));
	cleanup_test_file();
}

ZTEST(posix_fd_mgmt, test_fseek_ftell_rewind)
{
	static const char payload[] = "fseek-ftell";
	char buf[sizeof(payload)] = {0};
	FILE *fp;
	long pos;
	fpos_t fpos;
	size_t len = strlen(payload);

	cleanup_test_file();

	fp = fopen(TEST_FILE, "w");
	zassert_not_null(fp, "fopen(w) failed, errno=%d", errno);
	zassert_equal(fwrite(payload, 1, len, fp), len);
	zassert_ok(fclose(fp));

	fp = fopen(TEST_FILE, "r+");
	zassert_not_null(fp, "fopen(r+) failed, errno=%d", errno);

	zassert_ok(fseek(fp, 0, SEEK_SET));
	pos = ftell(fp);
	zassert_equal(pos, 0, "ftell(SEEK_SET) == %ld", pos);

	zassert_ok(fseek(fp, 0, SEEK_END));
	pos = ftell(fp);
	zassert_equal(pos, (long)len, "ftell(SEEK_END) == %ld", pos);

	rewind(fp);
	pos = ftell(fp);
	zassert_equal(pos, 0, "ftell after rewind == %ld", pos);

	zassert_ok(fgetpos(fp, &fpos));
	zassert_equal(ftell(fp), 0);

	zassert_ok(fsetpos(fp, &fpos));
	zassert_equal(fread(buf, 1, len, fp), len);
	zassert_mem_equal(buf, payload, len, "fread() data mismatch");

	zassert_ok(fclose(fp));
	cleanup_test_file();
}

ZTEST(posix_fd_mgmt, test_fgetpos)
{
	FILE *fp;
	fpos_t pos;

	cleanup_test_file();
	fp = fopen(TEST_FILE, "w+");
	if (fp == NULL) {
		TC_PRINT("fopen() not supported in this configuration (errno=%d)\n", errno);
		ztest_test_skip();
	}

	zassert_true(fputs("0123", fp) >= 0);
	zassert_ok(fflush(fp));
	zassert_ok(fseek(fp, 2, SEEK_SET));

	zassert_ok(fgetpos(fp, &pos), "fgetpos() failed, errno=%d", errno);

	zassert_ok(fclose(fp));
	cleanup_test_file();
}

ZTEST(posix_fd_mgmt, test_fsetpos)
{
	FILE *fp;
	fpos_t pos;

	cleanup_test_file();
	fp = fopen(TEST_FILE, "w+");
	if (fp == NULL) {
		TC_PRINT("fopen() not supported in this configuration (errno=%d)\n", errno);
		ztest_test_skip();
	}

	zassert_true(fputs("0123", fp) >= 0);
	zassert_ok(fflush(fp));
	zassert_ok(fseek(fp, 2, SEEK_SET));
	zassert_ok(fgetpos(fp, &pos));
	zassert_equal(fgetc(fp), '2');

	zassert_ok(fsetpos(fp, &pos), "fsetpos() failed, errno=%d", errno);
	zassert_equal(fgetc(fp), '2');

	zassert_ok(fclose(fp));
	cleanup_test_file();
}

ZTEST_SUITE(posix_fd_mgmt, NULL, test_mount, NULL, NULL, test_unmount);
```

## src/test_fs.h
```c
/*
 * SPDX-FileCopyrightText: Copyright The Zephyr Project Contributors
 * SPDX-License-Identifier: Apache-2.0
 */

#include <zephyr/ztest.h>

#if defined(CONFIG_NATIVE_LIBC)
#define TEST_FILE "/tmp/posix_fd_mgmt_testfile.txt"
#else
#define FATFS_MNTP "/RAM:"
#define TEST_FILE  FATFS_MNTP "/testfile.txt"
#endif

void *test_mount(void);
void test_unmount(void *unused);
```
