## CMakeLists.txt
```
# SPDX-License-Identifier: Apache-2.0

cmake_minimum_required(VERSION 3.20.0)
find_package(Zephyr REQUIRED HINTS $ENV{ZEPHYR_BASE})
project(posix_user_groups)

FILE(GLOB app_sources src/*.c)
target_sources(app PRIVATE ${app_sources})

target_compile_options(app PRIVATE -U_POSIX_C_SOURCE -D_POSIX_C_SOURCE=200809L)
target_compile_options(app PRIVATE -U_XOPEN_SOURCE -D_XOPEN_SOURCE=700)
```

## prj.conf
```kconfig
CONFIG_ZTEST=y

CONFIG_POSIX_AEP_CHOICE_BASE=y
CONFIG_POSIX_USER_GROUPS=y
```

## src/main.c
```c
/*
 * SPDX-FileCopyrightText: Copyright The Zephyr Project Contributors
 * SPDX-License-Identifier: Apache-2.0
 */

#include "user_groups_tests.h"

ZTEST_SUITE(posix_user_groups, NULL, NULL, NULL, NULL, NULL);
```

## src/getegid.c
```c
/*
 * SPDX-FileCopyrightText: Copyright The Zephyr Project Contributors
 * SPDX-License-Identifier: Apache-2.0
 */

#include "user_groups_tests.h"

#include <unistd.h>

ZTEST_USER(posix_user_groups, test_getegid)
{
	/* the effective identity of a process that never changed it is its real one */
	zassert_equal(getegid(), getgid());
	IF_NOT_NATIVE_LIBC(zassert_equal(getegid(), 0));
}
```

## src/geteuid.c
```c
/*
 * SPDX-FileCopyrightText: Copyright The Zephyr Project Contributors
 * SPDX-License-Identifier: Apache-2.0
 */

#include "user_groups_tests.h"

#include <unistd.h>

ZTEST_USER(posix_user_groups, test_geteuid)
{
	/* the effective identity of a process that never changed it is its real one */
	zassert_equal(geteuid(), getuid());
	IF_NOT_NATIVE_LIBC(zassert_equal(geteuid(), 0));
}
```

## src/getgid.c
```c
/*
 * SPDX-FileCopyrightText: Copyright The Zephyr Project Contributors
 * SPDX-License-Identifier: Apache-2.0
 */

#include "user_groups_tests.h"

#include <unistd.h>

ZTEST_USER(posix_user_groups, test_getgid)
{
	/* the effective identity of a process that never changed it is its real one */
	zassert_equal(getgid(), getegid());
	IF_NOT_NATIVE_LIBC(zassert_equal(getgid(), 0));
}
```

## src/getgroups.c
```c
/*
 * SPDX-FileCopyrightText: Copyright The Zephyr Project Contributors
 * SPDX-License-Identifier: Apache-2.0
 */

#include "user_groups_tests.h"

#include <errno.h>
#include <unistd.h>

ZTEST_USER(posix_user_groups, test_getgroups)
{
	gid_t list[64];
	int count;

	/* a zero size asks for the count */
	count = getgroups(0, NULL);
	zassert_true(count >= 0, "getgroups: %d (errno %d)", count, errno);
	zassert_true(count <= (int)ARRAY_SIZE(list), "%d supplementary groups", count);
	IF_NOT_NATIVE_LIBC(zassert_equal(count, 0));

	zassert_equal(getgroups(ARRAY_SIZE(list), list), count);
	zassert_equal(getgroups(count, list), count);

	if (count > 0) {
		errno = 0;
		zassert_equal(getgroups(count - 1, list), -1);
		zassert_equal(errno, EINVAL);
	}

	/* a negative size, kept from the fortified wrappers that would reject the call */
	volatile int negative = -1;
	gid_t *volatile unsized = list;

	errno = 0;
	zassert_equal(getgroups(negative, unsized), -1);
	zassert_equal(errno, EINVAL);
}
```

## src/getlogin.c
```c
/*
 * SPDX-FileCopyrightText: Copyright The Zephyr Project Contributors
 * SPDX-License-Identifier: Apache-2.0
 */

#include "user_groups_tests.h"

#include <string.h>
#include <unistd.h>

ZTEST_USER(posix_user_groups, test_getlogin)
{
	char *login = getlogin();

	if (IS_ENABLED(CONFIG_NATIVE_LIBC) && login == NULL) {
		/* the host has no login session (e.g. a container) */
		ztest_test_skip();
	}

	zassert_not_null(login);
	zassert_true(strlen(login) > 0);
	/* the same name every time */
	zassert_str_equal(getlogin(), login);
	IF_NOT_NATIVE_LIBC(zassert_str_equal(login, "root"));
}
```

## src/getuid.c
```c
/*
 * SPDX-FileCopyrightText: Copyright The Zephyr Project Contributors
 * SPDX-License-Identifier: Apache-2.0
 */

#include "user_groups_tests.h"

#include <unistd.h>

ZTEST_USER(posix_user_groups, test_getuid)
{
	/* the effective identity of a process that never changed it is its real one */
	zassert_equal(getuid(), geteuid());
	IF_NOT_NATIVE_LIBC(zassert_equal(getuid(), 0));
}
```

## src/setegid.c
```c
/*
 * SPDX-FileCopyrightText: Copyright The Zephyr Project Contributors
 * SPDX-License-Identifier: Apache-2.0
 */

#include "user_groups_tests.h"

#include <errno.h>
#include <unistd.h>

ZTEST_USER(posix_user_groups, test_setegid)
{
	gid_t id = getegid();

	/* the identity a process already has is always available to it */
	zassert_ok(setegid(id));
	zassert_equal(getegid(), id);

	IF_NOT_NATIVE_LIBC({
		errno = 0;
		zassert_equal(setegid(TEST_OTHER_ID), -1);
		zassert_equal(errno, EPERM);
		zassert_equal(getegid(), id);
	});
}
```

## src/seteuid.c
```c
/*
 * SPDX-FileCopyrightText: Copyright The Zephyr Project Contributors
 * SPDX-License-Identifier: Apache-2.0
 */

#include "user_groups_tests.h"

#include <errno.h>
#include <unistd.h>

ZTEST_USER(posix_user_groups, test_seteuid)
{
	uid_t id = geteuid();

	/* the identity a process already has is always available to it */
	zassert_ok(seteuid(id));
	zassert_equal(geteuid(), id);

	IF_NOT_NATIVE_LIBC({
		errno = 0;
		zassert_equal(seteuid(TEST_OTHER_ID), -1);
		zassert_equal(errno, EPERM);
		zassert_equal(geteuid(), id);
	});
}
```

## src/setgid.c
```c
/*
 * SPDX-FileCopyrightText: Copyright The Zephyr Project Contributors
 * SPDX-License-Identifier: Apache-2.0
 */

#include "user_groups_tests.h"

#include <errno.h>
#include <unistd.h>

ZTEST_USER(posix_user_groups, test_setgid)
{
	gid_t id = getgid();

	/* the identity a process already has is always available to it */
	zassert_ok(setgid(id));
	zassert_equal(getgid(), id);

	IF_NOT_NATIVE_LIBC({
		errno = 0;
		zassert_equal(setgid(TEST_OTHER_ID), -1);
		zassert_equal(errno, EPERM);
		zassert_equal(getgid(), id);
	});
}
```

## src/setuid.c
```c
/*
 * SPDX-FileCopyrightText: Copyright The Zephyr Project Contributors
 * SPDX-License-Identifier: Apache-2.0
 */

#include "user_groups_tests.h"

#include <errno.h>
#include <unistd.h>

ZTEST_USER(posix_user_groups, test_setuid)
{
	uid_t id = getuid();

	/* the identity a process already has is always available to it */
	zassert_ok(setuid(id));
	zassert_equal(getuid(), id);

	IF_NOT_NATIVE_LIBC({
		errno = 0;
		zassert_equal(setuid(TEST_OTHER_ID), -1);
		zassert_equal(errno, EPERM);
		zassert_equal(getuid(), id);
	});
}
```

## src/user_groups_tests.h
```c
/*
 * SPDX-FileCopyrightText: Copyright The Zephyr Project Contributors
 * SPDX-License-Identifier: Apache-2.0
 */

#ifndef POSIX_TESTS_USER_GROUPS_TESTS_H_
#define POSIX_TESTS_USER_GROUPS_TESTS_H_

#include <zephyr/ztest.h>

#include "../../shared/linux_compat_test.h"

/* an identity Zephyr does not have (a host root user may become it, so Zephyr-only) */
#define TEST_OTHER_ID 1000

#endif /* POSIX_TESTS_USER_GROUPS_TESTS_H_ */
```
