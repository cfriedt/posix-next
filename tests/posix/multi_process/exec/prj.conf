## CMakeLists.txt
```
# SPDX-License-Identifier: Apache-2.0

cmake_minimum_required(VERSION 3.20.0)
find_package(Zephyr REQUIRED HINTS $ENV{ZEPHYR_BASE})
project(posix_exec)

FILE(GLOB app_sources src/main.c)
target_sources(app PRIVATE ${app_sources})

target_compile_options(app PRIVATE -U_POSIX_C_SOURCE -D_POSIX_C_SOURCE=200809L)

# the executable image under test: a real ELF extension
add_llext_target(hello_ext
  OUTPUT  ${PROJECT_BINARY_DIR}/llext/hello.llext
  SOURCES ${PROJECT_SOURCE_DIR}/src/hello_ext.c
)
generate_inc_file_for_target(app ${PROJECT_BINARY_DIR}/llext/hello.llext
  ${ZEPHYR_BINARY_DIR}/include/generated/hello_ext.inc
)

# a loadable object that exports no main(): execve() must refuse it
add_llext_target(noexec_ext
  OUTPUT  ${PROJECT_BINARY_DIR}/llext/noexec.llext
  SOURCES ${PROJECT_SOURCE_DIR}/src/noexec_ext.c
)
generate_inc_file_for_target(app ${PROJECT_BINARY_DIR}/llext/noexec.llext
  ${ZEPHYR_BINARY_DIR}/include/generated/noexec_ext.inc
)
```

## prj.conf
```kconfig
CONFIG_ZTEST=y

CONFIG_POSIX_AEP_CHOICE_BASE=y
CONFIG_POSIX_MULTI_PROCESS=y
# the image reads and writes its environment
CONFIG_POSIX_SINGLE_PROCESS=y
CONFIG_POSIX_DEVICE_IO=y
# the image's standard output is read back through a pipe it is given with dup2()
CONFIG_POSIX_FD_MGMT=y
CONFIG_POSIX_PIPE=y
# the PATH search sections change the working directory
CONFIG_POSIX_FILE_SYSTEM=y
CONFIG_POSIX_EXEC_LLEXT=y
# small enough for the table-full and stale-slot-sweep sections to fill

CONFIG_LLEXT=y
CONFIG_LLEXT_HEAP_SIZE=16

CONFIG_FILE_SYSTEM=y
CONFIG_FAT_FILESYSTEM_ELM=y
CONFIG_FS_FATFS_LFN=y

CONFIG_SYS_PROCESS_MAX=4
CONFIG_HEAP_MEM_POOL_SIZE=32768
CONFIG_MAIN_STACK_SIZE=4096
CONFIG_ZTEST_STACK_SIZE=4096
CONFIG_COMMON_LIBC_MALLOC_ARENA_SIZE=16384

# base scenarios execute-from-RAM without an MPU; the .mpu scenario turns it
# back on together with CONFIG_USERSPACE (unknown-symbol =n is a no-op)
CONFIG_ARM_MPU=n
```

## src/main.c
```c
/*
 * SPDX-FileCopyrightText: Copyright The Zephyr Project Contributors
 *
 * SPDX-License-Identifier: Apache-2.0
 */

#include <errno.h>
#include <fcntl.h>
#include <signal.h>
#include <stdlib.h>
#include <string.h>
#include <sys/wait.h>
#include <unistd.h>

#include <ff.h>
#include <zephyr/fs/fs.h>
#include <zephyr/kernel.h>
#include <zephyr/llext/llext.h>
#include <zephyr/llext/symbol.h>
#include <zephyr/sys/process.h>
#include <zephyr/ztest.h>

/* resolve the image's references at llext link time */
EXPORT_SYMBOL(_exit);
EXPORT_SYMBOL(close);
EXPORT_SYMBOL(execve);
EXPORT_SYMBOL(fflush);
EXPORT_SYMBOL(fwrite);
EXPORT_SYMBOL(getenv);
EXPORT_SYMBOL(setenv);
EXPORT_SYMBOL(setvbuf);
EXPORT_SYMBOL(stdout);
EXPORT_SYMBOL(write);

#define EXEC_IMAGE "/RAM:/hello.llext"
#define EXEC_CHAIN_IMAGE "/RAM:/hello2.llext"
#define EXEC_NOEXEC_IMAGE "/RAM:/noexec.llext"
/* a directory beside the image, and a search path reaching the image behind it; PATH is
 * colon-separated, so the FAT mount's name is reached through the working directory
 */
#define EXEC_DIR "/RAM:/wd"
#define EXEC_PATH "wd:."

static const uint8_t hello_llext[] = {
#include "hello_ext.inc"
};

static const uint8_t noexec_llext[] = {
#include "noexec_ext.inc"
};

static FATFS fat_fs;
static struct fs_mount_t fs_mnt = {
	.type = FS_FATFS,
	.mnt_point = "/RAM:",
	.fs_data = &fat_fs,
};

/* images the llext heap holds at once; the next load is ENOMEM */
#define EXEC_IMAGE_SLOTS 2

/* execve() loads the extension on the caller's stack; 64-bit frames need room */
#define EXEC_CHILD_STACK_SIZE (IS_ENABLED(CONFIG_64BIT) ? 4096 : 3072)

/* image processes have state of their own: an environment store, buffered streams */
#if defined(CONFIG_TEST_USERSPACE) && defined(CONFIG_SYS_PROCESS_STATE_AREA) && \
	(CONFIG_SYS_PROCESS_STATE_AREA > 0)
#define EXEC_IMAGE_PROCESS_STATE 1
#else
#define EXEC_IMAGE_PROCESS_STATE 0
#endif

static K_THREAD_STACK_DEFINE(exec_child_stack, EXEC_CHILD_STACK_SIZE);
static struct k_thread exec_child_thread;

/* enough children to occupy every image slot at once */
static K_THREAD_STACK_ARRAY_DEFINE(exec_extra_stacks, EXEC_IMAGE_SLOTS,
				   EXEC_CHILD_STACK_SIZE);
static struct k_thread exec_extra_threads[EXEC_IMAGE_SLOTS];

static char *const exec_argv[] = {"hello", "x", NULL};
/* the image checks its own environment store only where image processes have one */
#if EXEC_IMAGE_PROCESS_STATE
static char *const exec_env_argv[] = {"hello", "n", "u", NULL};
#else
static char *const exec_env_argv[] = {"hello", "n", NULL};
#endif
static char *const exec_envp[] = {"HELLO=world", NULL};
#if EXEC_IMAGE_PROCESS_STATE
static char *const exec_stdio_argv[] = {"hello", "b", NULL};
#endif
static char *const exec_exit_argv[] = {"hello", "e", NULL};
static char *const exec_chain_argv[] = {"hello", "c", NULL};

static void exec_child_entry(void *p1, void *p2, void *p3)
{
	ARG_UNUSED(p2);
	ARG_UNUSED(p3);

	(void)execve(EXEC_IMAGE, p1, NULL);
	/* a failed exec reports its errno: 128 + errno */
	_exit(128 + (errno & 0x7f));
}

static void exec_env_child_entry(void *p1, void *p2, void *p3)
{
	ARG_UNUSED(p2);
	ARG_UNUSED(p3);

	(void)execve(EXEC_IMAGE, p1, exec_envp);
	_exit(128 + (errno & 0x7f));
}

#if EXEC_IMAGE_PROCESS_STATE
/* the pipe the image writes its standard output into: the child reads it in user mode */
ZTEST_DMEM static int exec_stdio_pipe[2];

static void exec_stdio_child_entry(void *p1, void *p2, void *p3)
{
	ARG_UNUSED(p1);
	ARG_UNUSED(p2);
	ARG_UNUSED(p3);

	if ((dup2(exec_stdio_pipe[1], 1) != 1) || (close(exec_stdio_pipe[0]) != 0) ||
	    (close(exec_stdio_pipe[1]) != 0)) {
		_exit(127);
	}
	(void)execve(EXEC_IMAGE, exec_stdio_argv, NULL);
	_exit(128 + (errno & 0x7f));
}
#endif

/* the same name found along PATH, through each exec entry point */
static void execvp_child_entry(void *p1, void *p2, void *p3)
{
	ARG_UNUSED(p2);
	ARG_UNUSED(p3);

	/* a child's working directory and environment are its own */
	if ((chdir("/RAM:") != 0) || (setenv("PATH", EXEC_PATH, 1) != 0)) {
		_exit(127);
	}
	(void)execvp("hello.llext", p1);
	_exit(128 + (errno & 0x7f));
}

static void execlp_child_entry(void *p1, void *p2, void *p3)
{
	ARG_UNUSED(p1);
	ARG_UNUSED(p2);
	ARG_UNUSED(p3);

	/* a child's working directory and environment are its own */
	if ((chdir("/RAM:") != 0) || (setenv("PATH", EXEC_PATH, 1) != 0)) {
		_exit(127);
	}
	(void)execlp("hello.llext", "hello", "x", NULL);
	_exit(128 + (errno & 0x7f));
}

static pid_t exec_spawn_with(k_thread_entry_t entry, char *const argv[])
{
	k_pid_t child = NULL;
	struct sys_clone_args args = {
		.entry = entry,
		.p1 = (void *)argv,
		.thread = &exec_child_thread,
		.stack = exec_child_stack,
		.stack_size = EXEC_CHILD_STACK_SIZE,
		.prio = k_thread_priority_get(k_current_get()),
		/* under CONFIG_TEST_USERSPACE the children exec from user mode */
		.options = IS_ENABLED(CONFIG_TEST_USERSPACE) ? K_USER : 0,
	};

	zassert_ok(sys_clone(&args, &child));

	return (pid_t)sys_process_id(child);
}

static pid_t exec_spawn(char *const argv[])
{
	return exec_spawn_with(exec_child_entry, argv);
}

/* a bare name is searched along PATH for an executable regular file */
static void exec_path_search(k_thread_entry_t entry, int (*exec_name)(const char *name))
{
	int status = -1;
	pid_t pid;

	zassert_ok(chdir("/RAM:"));
	zassert_ok(setenv("PATH", EXEC_PATH, 1));
	pid = exec_spawn_with(entry, exec_argv);
	zassert_true(pid > 0);
	zassert_equal(waitpid(pid, &status, 0), pid);
	zassert_true(WIFEXITED(status));
	zassert_equal(WEXITSTATUS(status), 42, "image found along PATH did not run: %d",
		      WEXITSTATUS(status));
	zassert_is_null(llext_by_name("hello.llext"), "image not unloaded after a normal return");

	/* nothing of that name along the path */
	errno = 0;
	zassert_equal(exec_name("nope.llext"), -1);
	zassert_equal(errno, ENOENT);
	/* a directory of that name is not an executable file */
	errno = 0;
	zassert_equal(exec_name("wd"), -1);
	zassert_equal(errno, EACCES);
	/* with a slash the name is taken as given */
	errno = 0;
	zassert_equal(exec_name("/RAM:/nope.llext"), -1);
	zassert_equal(errno, ENOENT);
	/* without PATH the default search path applies, and the image is not there */
	zassert_ok(unsetenv("PATH"));
	errno = 0;
	zassert_equal(exec_name("hello.llext"), -1);
	zassert_equal(errno, ENOENT);
	zassert_ok(chdir("/"));
}

static int execvp_name(const char *name)
{
	char *const argv[] = {"nope", NULL};

	return execvp(name, argv);
}

static int execlp_name(const char *name)
{
	return execlp(name, "nope", NULL);
}

static void execve_return_status(void)
{
	int status = -1;
	pid_t pid = exec_spawn(exec_argv);

	/* a child execs a real ELF extension: same pid, freshly loaded image */
	zassert_true(pid > 0);
	zassert_equal(waitpid(pid, &status, 0), pid);
	zassert_true(WIFEXITED(status));
	zassert_equal(WEXITSTATUS(status), 42, "extension main() did not run: %d",
		      WEXITSTATUS(status));
	zassert_is_null(llext_by_name("hello.llext"), "image not unloaded after a normal return");
}

/* the image's environ names the environment it was entered with, and the C
 * library's environment functions work on that
 */
static void execve_environment(void)
{
	int status = -1;
	pid_t pid = exec_spawn_with(exec_env_child_entry, exec_env_argv);

	zassert_true(pid > 0);
	zassert_equal(waitpid(pid, &status, 0), pid);
	zassert_true(WIFEXITED(status));
	zassert_equal(WEXITSTATUS(status), 44, "image environment: %d", WEXITSTATUS(status));
}

#if EXEC_IMAGE_PROCESS_STATE
/* an image's standard output buffering is the process's own: its fflush(NULL) and
 * exit() flush it, and a write() to the descriptor overtakes what it holds
 */
static void execve_image_stdio(void)
{
	char out[8] = {0};
	int status = -1;
	size_t len = 0;
	pid_t pid;

	zassert_ok(pipe(exec_stdio_pipe));
	pid = exec_spawn_with(exec_stdio_child_entry, NULL);
	zassert_true(pid > 0);
	zassert_ok(close(exec_stdio_pipe[1]));
	zassert_equal(waitpid(pid, &status, 0), pid);
	zassert_true(WIFEXITED(status), "image stdio: status %#x", status);
	zassert_equal(WEXITSTATUS(status), 46, "image stdio: %d", WEXITSTATUS(status));
	while (len < sizeof(out) - 1) {
		ssize_t n = read(exec_stdio_pipe[0], out + len, sizeof(out) - 1 - len);

		if (n <= 0) {
			break;
		}
		len += (size_t)n;
	}
	zassert_ok(close(exec_stdio_pipe[0]));
	zassert_str_equal(out, "XabYcd");
}
#endif

static void execve_exit_reaps_image(void)
{
	int status = -1;
	pid_t pid = exec_spawn(exec_exit_argv);

	/* an image dying via _exit() cannot unload itself; the reaper must */
	zassert_true(pid > 0);
	zassert_equal(waitpid(pid, &status, 0), pid);
	zassert_true(WIFEXITED(status));
	zassert_equal(WEXITSTATUS(status), 43, "extension _exit status lost: %d",
		      WEXITSTATUS(status));
	zassert_is_null(llext_by_name("hello.llext"), "image leaked after _exit()");
}

/* a chain-exec'ing image is unloaded by its successor past the point of no return */
static void execve_chain_unloads_prior(void)
{
	int status = -1;
	pid_t pid = exec_spawn(exec_chain_argv);

	zassert_true(pid > 0);
	zassert_equal(waitpid(pid, &status, 0), pid);
	zassert_true(WIFEXITED(status));
	zassert_equal(WEXITSTATUS(status), 43, "chain-exec'd image did not run: %d",
		      WEXITSTATUS(status));
	zassert_is_null(llext_by_name("hello.llext"), "chain-exec leaked the prior image");
	zassert_is_null(llext_by_name("hello2.llext"), "successor image not unloaded by reap");
}

/* failed resolution and loading report errors without disturbing the caller */
static void execve_load_errors(void)
{
	char *const argv[] = {"nope", NULL};

	/* nothing prelinked or on the file system by that name */
	errno = 0;
	zassert_equal(execve("/RAM:/nope.llext", argv, NULL), -1);
	zassert_equal(errno, ENOENT);

	/* a loadable object that exports no main() is not an executable image */
	errno = 0;
	zassert_equal(execve(EXEC_NOEXEC_IMAGE, argv, NULL), -1);
	zassert_equal(errno, ENOEXEC);
	zassert_is_null(llext_by_name("noexec.llext"), "refused image left loaded");
}

/* combined argument strings past the exec budget fail after the load */
static void execve_args_too_big(void)
{
	static char big[CONFIG_SYS_PROCESS_ARG_BYTES + 1];
	char *const argv[] = {"hello", big, NULL};

	memset(big, 'a', sizeof(big) - 1);

	errno = 0;
	zassert_equal(execve(EXEC_IMAGE, argv, NULL), -1);
	zassert_equal(errno, E2BIG);
	zassert_is_null(llext_by_name("hello.llext"), "refused image left loaded");
}

/* zombies not yet waited for keep their images; reaping releases them for the next exec */
static void execve_zombie_images(void)
{
	int status = -1;
	siginfo_t info;
	pid_t pids[EXEC_IMAGE_SLOTS];

	for (size_t i = 0; i < ARRAY_SIZE(pids); i++) {
		k_pid_t child = NULL;
		struct sys_clone_args args = {
			.entry = exec_child_entry,
			.p1 = (void *)exec_exit_argv,
			.thread = &exec_extra_threads[i],
			.stack = exec_extra_stacks[i],
			.stack_size = EXEC_CHILD_STACK_SIZE,
			.prio = k_thread_priority_get(k_current_get()),
			/* under CONFIG_TEST_USERSPACE the children exec from user mode */
			.options = IS_ENABLED(CONFIG_TEST_USERSPACE) ? K_USER : 0,
		};

		int ret = sys_clone(&args, &child);

		zassert_equal(ret, 0, "clone %zu: %d", i, ret);
		pids[i] = (pid_t)sys_process_id(child);
		/* observe the death without reaping: the zombie keeps its image */
		zassert_ok(waitid(P_PID, (id_t)pids[i], &info, WEXITED | WNOWAIT));
	}

	/* reaping the zombies releases their images */
	for (size_t i = 0; i < ARRAY_SIZE(pids); i++) {
		zassert_equal(waitpid(pids[i], &status, 0), pids[i]);
		zassert_true(WIFEXITED(status));
		zassert_equal(WEXITSTATUS(status), 43);
	}
	zassert_is_null(llext_by_name("hello.llext"), "zombie images leaked after reap");

	/* and the memory is back: a fresh exec loads again */
	pid_t pid = exec_spawn(exec_argv);

	zassert_equal(waitpid(pid, &status, 0), pid);
	zassert_true(WIFEXITED(status));
	zassert_equal(WEXITSTATUS(status), 42);
}

struct exec_orphan_args {
	struct k_thread *thread;
	k_thread_stack_t *stack;
};

static void exec_orphan_mid_entry(void *p1, void *p2, void *p3)
{
	struct exec_orphan_args *oa = p1;
	siginfo_t info;
	k_pid_t grand = NULL;
	struct sys_clone_args args = {
		.entry = exec_child_entry,
		.p1 = (void *)exec_exit_argv,
		.thread = oa->thread,
		.stack = oa->stack,
		.stack_size = EXEC_CHILD_STACK_SIZE,
		.prio = k_thread_priority_get(k_current_get()),
		/* under CONFIG_TEST_USERSPACE the children exec from user mode */
		.options = IS_ENABLED(CONFIG_TEST_USERSPACE) ? K_USER : 0,
	};

	ARG_UNUSED(p2);
	ARG_UNUSED(p3);

	if (sys_clone(&args, &grand) != 0) {
		_exit(98);
	}
	/* observe the grandchild's death without reaping it */
	if (waitid(P_PID, (id_t)sys_process_id(grand), &info, WEXITED | WNOWAIT) != 0) {
		_exit(97);
	}
	/* dying with an unreaped child: init auto-reaps the orphaned zombie,
	 * retiring its pid while its image slot is still registered
	 */
	_exit(0);
}

/* a table full of slots whose pids retired without a waitpid() is swept */
static void execve_sweep_stale_slots(void)
{
	int status = -1;
	pid_t pid;

	for (size_t i = 0; i < EXEC_IMAGE_SLOTS; i++) {
		struct exec_orphan_args oa = {
			.thread = &exec_extra_threads[i],
			.stack = exec_extra_stacks[i],
		};
		k_pid_t mid = NULL;
		struct sys_clone_args args = {
			.entry = exec_orphan_mid_entry,
			.p1 = &oa,
			.thread = &exec_child_thread,
			.stack = exec_child_stack,
			.stack_size = EXEC_CHILD_STACK_SIZE,
			.prio = k_thread_priority_get(k_current_get()),
			/* the middle process reads oa off this stack: kernel mode */
			.options = 0,
		};

		zassert_ok(sys_clone(&args, &mid));
		pid = (pid_t)sys_process_id(mid);
		zassert_true(pid > 0);
		zassert_equal(waitpid(pid, &status, 0), pid);
		zassert_true(WIFEXITED(status));
		zassert_equal(WEXITSTATUS(status), 0, "orphan setup failed: %d",
			      WEXITSTATUS(status));
	}

	/* every slot is stale: the next exec sweeps them and still succeeds */
	pid = exec_spawn(exec_argv);
	zassert_true(pid > 0);
	zassert_equal(waitpid(pid, &status, 0), pid);
	zassert_true(WIFEXITED(status));
	zassert_equal(WEXITSTATUS(status), 42);
	zassert_is_null(llext_by_name("hello.llext"), "stale slots not swept");
}

ZTEST(posix_exec, test_execve)
{
	execve_return_status();
	execve_environment();
	/* the image buffers its output only where image processes have state of their own */
#if EXEC_IMAGE_PROCESS_STATE
	execve_image_stdio();
#endif
	execve_exit_reaps_image();
	execve_chain_unloads_prior();
	execve_load_errors();
	execve_args_too_big();
	execve_zombie_images();
	execve_sweep_stale_slots();
}

ZTEST(posix_exec, test_execvp)
{
	exec_path_search(execvp_child_entry, execvp_name);
}

ZTEST(posix_exec, test_execlp)
{
	exec_path_search(execlp_child_entry, execlp_name);
}

static void exec_setup_write(const char *path, const uint8_t *blob, size_t len)
{
	int fd;
	int ret;

	fd = open(path, O_RDWR | O_CREAT, 0644);
	zassert_true(fd >= 0, "open %s failed: %d", path, errno);
	ret = write(fd, blob, len);
	zassert_equal(ret, (int)len);
	zassert_ok(close(fd));
}

static void *exec_setup(void)
{
	zassert_ok(fs_mount(&fs_mnt));
	exec_setup_write(EXEC_IMAGE, hello_llext, sizeof(hello_llext));
	/* the same image under a second name, for the chain-exec round trip */
	exec_setup_write(EXEC_CHAIN_IMAGE, hello_llext, sizeof(hello_llext));
	exec_setup_write(EXEC_NOEXEC_IMAGE, noexec_llext, sizeof(noexec_llext));
	zassert_ok(fs_mkdir(EXEC_DIR));

	return NULL;
}

ZTEST_SUITE(posix_exec, NULL, exec_setup, NULL, NULL, NULL);
```

## src/hello_ext.c
```c
/*
 * SPDX-FileCopyrightText: Copyright The Zephyr Project Contributors
 *
 * SPDX-License-Identifier: Apache-2.0
 */

/* the image is built without the application's feature test macros */
#ifndef _POSIX_C_SOURCE
#define _POSIX_C_SOURCE 200809L
#endif

#include <errno.h>
#include <stdio.h>
#include <stdlib.h>
#include <string.h>
#include <unistd.h>

#include <zephyr/llext/symbol.h>

/*
 * The executable-image ABI: an exec'd extension exports main(), and its
 * return value becomes the process's exit status. An environ it exports is
 * bound to the environment it is entered with.
 */
char **environ;
LL_EXTENSION_SYMBOL(environ);

int main(int argc, char **argv, char **envp)
{
	if ((argc == 2) && (argv[1][0] == 'x')) {
		/* errno is the running thread's: the image reaches it through the base image */
		errno = 0;
		if ((close(-1) != -1) || (errno != EBADF)) {
			return 45;
		}
		return 42;
	}
	if ((argc == 2) && (argv[1][0] == 'b')) {
		/* the image's stdout buffering is its own: a write() overtakes what it holds */
		if (setvbuf(stdout, NULL, _IOFBF, 64) != 0) {
			return 60;
		}
		(void)fputs("ab", stdout);
		(void)write(1, "X", 1);
		if (fflush(NULL) != 0) {
			return 61;
		}
		(void)write(1, "Y", 1);
		/* exit() flushes what is left */
		(void)fputs("cd", stdout);
		return 46;
	}
	if ((argc >= 2) && (argv[1][0] == 'n')) {
		if ((environ != envp) || (envp[0] == NULL) || (envp[1] != NULL) ||
		    (strcmp(envp[0], "HELLO=world") != 0)) {
			return 50;
		}
		/* an image process with C library state of its own has an environment store */
		if (argc == 3) {
			const char *val = getenv("HELLO");

			if ((val == NULL) || (strcmp(val, "world") != 0)) {
				return 51;
			}
			if (setenv("ADDED", "1", 1) != 0) {
				return 52;
			}
			/* the store is what environ names */
			if ((environ[0] == NULL) || (environ[1] == NULL) ||
			    (strcmp(environ[1], "ADDED=1") != 0) || (environ[2] != NULL)) {
				return 53;
			}
		}
		return 44;
	}
	if ((argc == 2) && (argv[1][0] == 'e')) {
		/* die without returning: the reaper must unload the image */
		_exit(43);
	}
	if ((argc == 2) && (argv[1][0] == 'c')) {
		/* chain-exec a second image: the successor unloads this one */
		char *const chain_argv[] = {"hello2", "e", NULL};

		(void)execve("/RAM:/hello2.llext", chain_argv, NULL);
		return 4;
	}

	return 1;
}
LL_EXTENSION_SYMBOL(main);
```
