## CMakeLists.txt
```
# SPDX-License-Identifier: Apache-2.0

cmake_minimum_required(VERSION 3.20.0)
find_package(Zephyr REQUIRED HINTS $ENV{ZEPHYR_BASE})
project(posix_file_system_ext)

FILE(GLOB app_sources src/*.c)
target_sources(app PRIVATE ${app_sources})

target_compile_options(app PRIVATE -U_POSIX_C_SOURCE -D_POSIX_C_SOURCE=200809L)
target_compile_options(app PRIVATE -U_XOPEN_SOURCE -D_XOPEN_SOURCE=700)
```

## prj.conf
```kconfig
CONFIG_ZTEST=y

CONFIG_POSIX_AEP_CHOICE_PSE52=y
CONFIG_POSIX_FILE_SYSTEM_EXT=y
# XSI provides the S_IF* constants and the XSI struct stat members
CONFIG_XSI=y

CONFIG_FILE_SYSTEM=y
CONFIG_FAT_FILESYSTEM_ELM=y
# preserve filename case for the name-comparing tests
CONFIG_FS_FATFS_LFN=y

CONFIG_EVENTFD=n

# stdio (3) + stream under test + directory streams + scratch
CONFIG_ZVFS_OPEN_IGNORE_MIN=y
CONFIG_ZVFS_OPEN_MAX=12
CONFIG_ZVFS_DIR_MAX=4

CONFIG_MAIN_STACK_SIZE=4096
# the buffered-stream call paths run deeper than the fd-level suites
CONFIG_ZTEST_STACK_SIZE=8192
CONFIG_TEST_EXTRA_STACK_SIZE=4096

CONFIG_HEAP_MEM_POOL_SIZE=16384
CONFIG_COMMON_LIBC_MALLOC_ARENA_SIZE=16384
```

## src/main.c
```c
/*
 * SPDX-FileCopyrightText: Copyright The Zephyr Project Contributors
 * SPDX-License-Identifier: Apache-2.0
 */

#include "file_system_ext_tests.h"

#include <fcntl.h>
#include <stdio.h>
#include <string.h>
#include <sys/stat.h>
#include <unistd.h>

#include <zephyr/kernel.h>
#ifndef CONFIG_NATIVE_LIBC
#include <ff.h>
#include <zephyr/fs/fs.h>
#endif
#ifdef CONFIG_USERSPACE
#include <zephyr/sys/fdtable.h>
extern struct k_mem_partition zvfs_dir_partition;
#endif

#ifndef CONFIG_NATIVE_LIBC
static FATFS fat_fs;
static struct fs_mount_t fs_mnt = {
	.type = FS_FATFS,
	.mnt_point = "/",
	.fs_data = &fat_fs,
};
#endif

/*
 * Remove a whole subtree. The Zephyr path uses the fs_* API directly: POSIX
 * <dirent.h> and the FATFS ff.h both define a DIR type, so they cannot share
 * a translation unit. Under the host libc, plain POSIX calls are used.
 */
#ifdef CONFIG_NATIVE_LIBC
#include <dirent.h>
static void rmtree(const char *path)
{
	DIR *d = opendir(path);
	struct dirent *e;
	char child[300];

	if (d != NULL) {
		while ((e = readdir(d)) != NULL) {
			if (strcmp(e->d_name, ".") == 0 || strcmp(e->d_name, "..") == 0) {
				continue;
			}
			if (snprintf(child, sizeof(child), "%s/%s", path, e->d_name) >=
			    (int)sizeof(child)) {
				continue;
			}
			rmtree(child);
		}
		closedir(d);
		rmdir(path);
		return;
	}

	(void)unlink(path);
}
#else
static void rmtree(const char *path)
{
	struct fs_dir_t dir;
	struct fs_dirent ent;
	char child[300];

	fs_dir_t_init(&dir);

	if (fs_opendir(&dir, path) == 0) {
		while (fs_readdir(&dir, &ent) == 0 && ent.name[0] != '\0') {
			if (snprintf(child, sizeof(child), "%s/%s", path, ent.name) >=
			    (int)sizeof(child)) {
				continue;
			}
			rmtree(child);
		}
		fs_closedir(&dir);
	}

	(void)fs_unlink(path);
}
#endif

static void write_file(const char *path, const char *content)
{
	int fd = open(path, O_WRONLY | O_CREAT | O_TRUNC, 0600);

	zassert_true(fd >= 0);
	zassert_equal(write(fd, content, strlen(content)), strlen(content));
	zassert_ok(close(fd));
}

static void before(void *arg)
{
	ARG_UNUSED(arg);

	rmtree(TEST_ROOT);

	zassert_ok(mkdir(TEST_ROOT, 0777));

	write_file(TEST_LINES, TEST_LINE1 TEST_LINE2 TEST_LINE3 TEST_TAIL);
	write_file(TEST_FIELDS, TEST_FIELD_DATA);
	write_file(TEST_EMPTY, "");

	zassert_ok(mkdir(TEST_SCAN, 0777));
	write_file(TEST_SCAN "/f2.txt", "2");
	write_file(TEST_SCAN "/f1.txt", "1");
	write_file(TEST_SCAN "/f3.txt", "3");
	write_file(TEST_SCAN "/other.dat", "x");
}

static void *setup(void)
{
#ifndef CONFIG_NATIVE_LIBC
	memset(&fat_fs, 0, sizeof(fat_fs));
	zassert_ok(fs_mount(&fs_mnt));
#endif
	(void)mkdir(FS_TMPDIR, 0777);
#ifdef CONFIG_USERSPACE
	zassert_ok(k_mem_domain_add_partition(&k_mem_domain_default, &zvfs_dir_partition));
#endif
	return NULL;
}

static void teardown(void *arg)
{
	ARG_UNUSED(arg);
#ifndef CONFIG_NATIVE_LIBC
	rmtree(TEST_ROOT);
	(void)fs_unmount(&fs_mnt);
#endif
}

ZTEST_SUITE(posix_file_system_ext, NULL, setup, before, NULL, teardown);
```

## src/alphasort.c
```c
/*
 * SPDX-FileCopyrightText: Copyright The Zephyr Project Contributors
 * SPDX-License-Identifier: Apache-2.0
 */

#include "file_system_ext_tests.h"

#include <dirent.h>
#include <string.h>

ZTEST_USER(posix_file_system_ext, test_alphasort)
{
	static const struct dirent first = {.d_name = "abc"};
	static const struct dirent second = {.d_name = "abd"};
	static const struct dirent longer = {.d_name = "abcd"};
	const struct dirent *d1 = &first;
	const struct dirent *d2 = &second;

	zassert_true(alphasort(&d1, &d2) < 0);
	zassert_true(alphasort(&d2, &d1) > 0);

	d2 = &first;
	zassert_equal(alphasort(&d1, &d2), 0);

	d2 = &longer;
	zassert_true(alphasort(&d1, &d2) < 0);
}
```

## src/dirfd.c
```c
/*
 * SPDX-FileCopyrightText: Copyright The Zephyr Project Contributors
 * SPDX-License-Identifier: Apache-2.0
 */

#include "file_system_ext_tests.h"

#include <dirent.h>

ZTEST_USER(posix_file_system_ext, test_dirfd)
{
	DIR *dirp = opendir(TEST_ROOT);
	int fd;

	zassert_not_null(dirp);

	fd = dirfd(dirp);
	zassert_true(fd >= 0);

	/* the descriptor is the stream's own: stable across reads */
	zassert_not_null(readdir(dirp));
	zassert_equal(dirfd(dirp), fd);

	zassert_ok(closedir(dirp));
}
```

## src/file_system_ext_tests.h
```c
/*
 * SPDX-FileCopyrightText: Copyright The Zephyr Project Contributors
 * SPDX-License-Identifier: Apache-2.0
 */

#ifndef POSIX_TESTS_FILE_SYSTEM_EXT_TESTS_H_
#define POSIX_TESTS_FILE_SYSTEM_EXT_TESTS_H_

#include <zephyr/ztest.h>

#include "../../shared/linux_compat_test.h"

/*
 * The file system is mounted at "/", and /tmp exists in both worlds (the FAT
 * RAM disk under Zephyr, the host filesystem under CONFIG_NATIVE_LIBC), so
 * every path constant is identical for the linux_compat variant.
 */
#define FS_TMPDIR   "/tmp"
#define TEST_ROOT   FS_TMPDIR "/pfsext"
#define TEST_LINES  TEST_ROOT "/lines.txt"
#define TEST_FIELDS TEST_ROOT "/fields.txt"
#define TEST_EMPTY  TEST_ROOT "/empty.txt"
#define TEST_SCAN   TEST_ROOT "/scan"

/* three newline-terminated lines (the second exceeds any initial allocation)
 * and one unterminated tail
 */
#define TEST_LINE1 "alpha\n"
#define TEST_LINE2                                                                                 \
	"a second line that is long enough to force the line buffer through at least one growth\n"
#define TEST_LINE3 "charlie\n"
#define TEST_TAIL  "delta"

/* colon-delimited fields with an empty field and no trailing delimiter */
#define TEST_FIELD_DATA "one:two::three"

#endif /* POSIX_TESTS_FILE_SYSTEM_EXT_TESTS_H_ */
```

## src/getdelim.c
```c
/*
 * SPDX-FileCopyrightText: Copyright The Zephyr Project Contributors
 * SPDX-License-Identifier: Apache-2.0
 */

#include "file_system_ext_tests.h"

#include <errno.h>
#include <stdint.h>
#include <stdio.h>
#include <stdlib.h>
#include <string.h>

static void getdelim_invalid_args(void)
{
	FILE *fp = fopen(TEST_FIELDS, "r");
	char *line = NULL;
	size_t n = 0;

	zassert_not_null(fp);

	errno = 0;
	zassert_equal(getdelim(NULL, &n, ':', fp), -1);
	zassert_equal(errno, EINVAL);

	/* no errno check: glibc returns -1 for a null n without setting it */
	zassert_equal(getdelim(&line, NULL, ':', fp), -1);

	zassert_ok(fclose(fp));
}

/*
 * POSIX: a null *lineptr requests allocation and *n is only meaningful for a
 * caller-supplied buffer. A stale size with a null buffer must be ignored
 * (callers like toybox pass an uninitialized size with a null buffer).
 */
static void getdelim_null_buffer_stale_size(void)
{
	FILE *fp = fopen(TEST_LINES, "r");
	char *line = NULL;
	size_t n = SIZE_MAX;
	ssize_t len;

	zassert_not_null(fp);

	len = getdelim(&line, &n, '\n', fp);
	zassert_equal(len, strlen(TEST_LINE1));
	zassert_not_null(line);
	zassert_true(n > strlen(TEST_LINE1));
	zassert_mem_equal(line, TEST_LINE1, strlen(TEST_LINE1) + 1);

	free(line);
	zassert_ok(fclose(fp));
}

static void getdelim_grows_and_reuses(void)
{
	FILE *fp = fopen(TEST_LINES, "r");
	char *line = malloc(4);
	size_t n = 4;
	ssize_t len;

	zassert_not_null(fp);
	zassert_not_null(line);

	len = getdelim(&line, &n, '\n', fp);
	zassert_equal(len, strlen(TEST_LINE1));
	zassert_mem_equal(line, TEST_LINE1, strlen(TEST_LINE1) + 1);

	/* the second line is longer than any initial allocation */
	len = getdelim(&line, &n, '\n', fp);
	zassert_equal(len, strlen(TEST_LINE2));
	zassert_mem_equal(line, TEST_LINE2, strlen(TEST_LINE2) + 1);
	zassert_true(n > strlen(TEST_LINE2));

	len = getdelim(&line, &n, '\n', fp);
	zassert_equal(len, strlen(TEST_LINE3));

	/* the tail has no delimiter: its length is still returned */
	len = getdelim(&line, &n, '\n', fp);
	zassert_equal(len, strlen(TEST_TAIL));
	zassert_mem_equal(line, TEST_TAIL, strlen(TEST_TAIL) + 1);

	/* nothing left */
	zassert_equal(getdelim(&line, &n, '\n', fp), -1);

	free(line);
	zassert_ok(fclose(fp));
}

static void getdelim_custom_delimiter(void)
{
	static const char *const fields[] = {"one:", "two:", ":", "three"};
	FILE *fp = fopen(TEST_FIELDS, "r");
	char *line = NULL;
	size_t n = 0;

	zassert_not_null(fp);

	for (size_t i = 0; i < ARRAY_SIZE(fields); i++) {
		zassert_equal(getdelim(&line, &n, ':', fp), strlen(fields[i]));
		zassert_mem_equal(line, fields[i], strlen(fields[i]) + 1);
	}
	zassert_equal(getdelim(&line, &n, ':', fp), -1);

	free(line);
	zassert_ok(fclose(fp));
}

static void getdelim_empty_file(void)
{
	FILE *fp = fopen(TEST_EMPTY, "r");
	char *line = NULL;
	size_t n = 0;

	zassert_not_null(fp);

	zassert_equal(getdelim(&line, &n, '\n', fp), -1);

	free(line);
	zassert_ok(fclose(fp));
}

ZTEST_USER(posix_file_system_ext, test_getdelim)
{
	getdelim_invalid_args();
	getdelim_null_buffer_stale_size();
	getdelim_grows_and_reuses();
	getdelim_custom_delimiter();
	getdelim_empty_file();
}
```

## src/getline.c
```c
/*
 * SPDX-FileCopyrightText: Copyright The Zephyr Project Contributors
 * SPDX-License-Identifier: Apache-2.0
 */

#include "file_system_ext_tests.h"

#include <stdio.h>
#include <stdlib.h>
#include <string.h>

ZTEST_USER(posix_file_system_ext, test_getline)
{
	static const char *const lines[] = {TEST_LINE1, TEST_LINE2, TEST_LINE3, TEST_TAIL};
	FILE *fp = fopen(TEST_LINES, "r");
	char *line = NULL;
	size_t n = 0;

	zassert_not_null(fp);

	for (size_t i = 0; i < ARRAY_SIZE(lines); i++) {
		zassert_equal(getline(&line, &n, fp), strlen(lines[i]));
		zassert_mem_equal(line, lines[i], strlen(lines[i]) + 1);
	}
	zassert_equal(getline(&line, &n, fp), -1);

	free(line);
	zassert_ok(fclose(fp));
}
```

## src/mkdtemp.c
```c
/*
 * SPDX-FileCopyrightText: Copyright The Zephyr Project Contributors
 * SPDX-License-Identifier: Apache-2.0
 */

#include "file_system_ext_tests.h"

#include <errno.h>
#include <stdlib.h>
#include <string.h>
#include <sys/stat.h>
#include <unistd.h>

ZTEST_USER(posix_file_system_ext, test_mkdtemp)
{
	char bad[] = TEST_ROOT "/dNOTEMP";
	char tmpl[] = TEST_ROOT "/dXXXXXX";
	struct stat st;

	errno = 0;
	zassert_is_null(mkdtemp(bad));
	zassert_equal(errno, EINVAL);

	zassert_equal(mkdtemp(tmpl), tmpl);
	zassert_true(strncmp(tmpl, TEST_ROOT "/d", strlen(TEST_ROOT "/d")) == 0);
	zassert_true(strcmp(tmpl, TEST_ROOT "/dXXXXXX") != 0);

	zassert_ok(stat(tmpl, &st));
	zassert_true(S_ISDIR(st.st_mode));

	zassert_ok(rmdir(tmpl));
}
```

## src/scandir.c
```c
/*
 * SPDX-FileCopyrightText: Copyright The Zephyr Project Contributors
 * SPDX-License-Identifier: Apache-2.0
 */

#include "file_system_ext_tests.h"

#include <dirent.h>
#include <errno.h>
#include <stdlib.h>
#include <string.h>

static int select_f(const struct dirent *entry)
{
	return entry->d_name[0] == 'f';
}

ZTEST_USER(posix_file_system_ext, test_scandir)
{
	static const char *const expected[] = {"f1.txt", "f2.txt", "f3.txt"};
	struct dirent **namelist = NULL;
	int count;

	count = scandir(TEST_SCAN, &namelist, select_f, alphasort);
	zassert_equal(count, ARRAY_SIZE(expected));
	for (int i = 0; i < count; i++) {
		zassert_equal(strcmp(namelist[i]->d_name, expected[i]), 0, "entry %d is %s", i,
			      namelist[i]->d_name);
		free(namelist[i]);
	}
	free(namelist);

	/* unfiltered and unsorted: at least the four fixture entries */
	namelist = NULL;
	count = scandir(TEST_SCAN, &namelist, NULL, NULL);
	zassert_true(count >= 4);
	for (int i = 0; i < count; i++) {
		free(namelist[i]);
	}
	free(namelist);

	errno = 0;
	zassert_equal(scandir(TEST_ROOT "/nope", &namelist, NULL, NULL), -1);
	zassert_equal(errno, ENOENT);
}
```
