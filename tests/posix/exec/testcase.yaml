## tests/posix/exec/testcase.yaml
```yaml
common:
  tags:
    - posix
    - exec
    - llext
tests:
  portability.posix.exec.llext:
    platform_allow:
      - qemu_cortex_m3
      - mps2/an385
    integration_platforms:
      - mps2/an385
```

## tests/posix/file_system/testcase.yaml
```yaml
common:
  tags:
    - fatfs
    - posix_file_system
    - posix_file_system_r
  min_ram: 128
  modules:
    - fatfs
  # 1 tier0 platform per supported architecture
  platform_key:
    - arch
    - simulation
tests:
  portability.posix.file_system:
    filter: not CONFIG_NATIVE_LIBC
  portability.posix.file_system.userspace:
    filter: (not CONFIG_NATIVE_LIBC) and CONFIG_ARCH_HAS_USERSPACE
    tags: userspace
    min_ram: 160
    extra_configs:
      - CONFIG_TEST_USERSPACE=y
      - CONFIG_USERSPACE=y
      # 8-region MPU: stack guard + thread stack leave only 3 domain slots,
      # one short for zvfs_dir_partition on top of libc/malloc/ztest
      - platform:mps2/an385:CONFIG_TEST_USERSPACE_WITHOUT_HW_STACK_PROTECTION=y
  portability.posix.file_system.minimal:
    filter: not CONFIG_NATIVE_LIBC
    extra_configs:
      - CONFIG_MINIMAL_LIBC=y
  portability.posix.file_system.newlib:
    filter: (not CONFIG_NATIVE_LIBC) and (TOOLCHAIN_HAS_NEWLIB == 1)
    extra_configs:
      - CONFIG_NEWLIB_LIBC=y
  portability.posix.file_system.picolibc:
    tags: picolibc
    filter: (not CONFIG_NATIVE_LIBC) and CONFIG_PICOLIBC_SUPPORTED
    extra_configs:
      - CONFIG_PICOLIBC=y
  portability.posix.file_system.tls:
    filter: (not CONFIG_NATIVE_LIBC) and CONFIG_ARCH_HAS_THREAD_LOCAL_STORAGE and
      CONFIG_TOOLCHAIN_SUPPORTS_THREAD_LOCAL_STORAGE
    extra_configs:
      - CONFIG_NEWLIB_LIBC=n
      - CONFIG_THREAD_LOCAL_STORAGE=y
  portability.posix.file_system.tls.newlib:
    filter: (not CONFIG_NATIVE_LIBC) and (TOOLCHAIN_HAS_NEWLIB == 1) and
      CONFIG_ARCH_HAS_THREAD_LOCAL_STORAGE and CONFIG_TOOLCHAIN_SUPPORTS_THREAD_LOCAL_STORAGE
    extra_configs:
      - CONFIG_NEWLIB_LIBC=y
      - CONFIG_THREAD_LOCAL_STORAGE=y
  portability.posix.file_system.linux_compat:
    tags: native
    platform_allow:
      - native_sim
      - native_sim/native/64
    filter: CONFIG_NATIVE_LIBC
    extra_configs:
      - CONFIG_POSIX_TEST_LINUX_COMPAT=y
```

## tests/posix/file_system_fd/testcase.yaml
```yaml
common:
  tags:
    - fatfs
    - posix_file_system_fd
    - posix_file_system_r
  min_ram: 128
  modules:
    - fatfs
  # 1 tier0 platform per supported architecture
  platform_key:
    - arch
    - simulation
tests:
  portability.posix.file_system_fd:
    filter: not CONFIG_NATIVE_LIBC
  portability.posix.file_system_fd.userspace:
    filter: (not CONFIG_NATIVE_LIBC) and CONFIG_ARCH_HAS_USERSPACE
    tags: userspace
    min_ram: 160
    extra_configs:
      - CONFIG_TEST_USERSPACE=y
      - CONFIG_USERSPACE=y
      # 8-region MPU: stack guard + thread stack leave only 3 domain slots,
      # one short for zvfs_dir_partition on top of libc/malloc/ztest
      - platform:mps2/an385:CONFIG_TEST_USERSPACE_WITHOUT_HW_STACK_PROTECTION=y
  portability.posix.file_system_fd.minimal:
    filter: not CONFIG_NATIVE_LIBC
    extra_configs:
      - CONFIG_MINIMAL_LIBC=y
  portability.posix.file_system_fd.newlib:
    filter: (not CONFIG_NATIVE_LIBC) and (TOOLCHAIN_HAS_NEWLIB == 1)
    extra_configs:
      - CONFIG_NEWLIB_LIBC=y
  portability.posix.file_system_fd.picolibc:
    tags: picolibc
    filter: (not CONFIG_NATIVE_LIBC) and CONFIG_PICOLIBC_SUPPORTED
    extra_configs:
      - CONFIG_PICOLIBC=y
  portability.posix.file_system_fd.tls:
    filter: (not CONFIG_NATIVE_LIBC) and CONFIG_ARCH_HAS_THREAD_LOCAL_STORAGE and
      CONFIG_TOOLCHAIN_SUPPORTS_THREAD_LOCAL_STORAGE
    extra_configs:
      - CONFIG_NEWLIB_LIBC=n
      - CONFIG_THREAD_LOCAL_STORAGE=y
  portability.posix.file_system_fd.tls.newlib:
    filter: (not CONFIG_NATIVE_LIBC) and (TOOLCHAIN_HAS_NEWLIB == 1) and
      CONFIG_ARCH_HAS_THREAD_LOCAL_STORAGE and CONFIG_TOOLCHAIN_SUPPORTS_THREAD_LOCAL_STORAGE
    extra_configs:
      - CONFIG_NEWLIB_LIBC=y
      - CONFIG_THREAD_LOCAL_STORAGE=y
  portability.posix.file_system_fd.linux_compat:
    tags: native
    platform_allow:
      - native_sim
      - native_sim/native/64
    filter: CONFIG_NATIVE_LIBC
    extra_configs:
      - CONFIG_POSIX_TEST_LINUX_COMPAT=y
```

## tests/posix/fork/testcase.yaml
```yaml
common:
  tags:
    - posix
    - fork
tests:
  portability.posix.fork:
    platform_allow:
      - qemu_x86
      - qemu_x86_64
      - qemu_cortex_a53
      - qemu_riscv64
      - qemu_riscv64/qemu_virt_riscv64/sv48
    filter: CONFIG_ARCH_HAS_PROCESS_VM
```

## tests/posix/mapped_files/testcase.yaml
```yaml
common:
  ignore_faults: true
  tags:
    - fatfs
    - posix_mapped_files
  min_ram: 128
  modules:
    - fatfs
  # 1 tier0 platform per supported architecture
  platform_key:
    - arch
    - simulation
tests:
  portability.posix.mapped_files:
    filter: not CONFIG_NATIVE_LIBC
  portability.posix.mapped_files.userspace:
    filter: (not CONFIG_NATIVE_LIBC) and CONFIG_ARCH_HAS_USERSPACE
    tags: userspace
    min_ram: 160
    platform_exclude:
      # 8-region MPU: after stack guard, thread stack, libc, malloc and ztest one domain
      # slot remains, and each mapping a user thread reaches needs one of its own
      - mps2/an385
    extra_configs:
      - CONFIG_TEST_USERSPACE=y
      - CONFIG_USERSPACE=y
  portability.posix.mapped_files.minimal:
    filter: not CONFIG_NATIVE_LIBC
    extra_configs:
      - CONFIG_MINIMAL_LIBC=y
  portability.posix.mapped_files.newlib:
    filter: (not CONFIG_NATIVE_LIBC) and (TOOLCHAIN_HAS_NEWLIB == 1)
    extra_configs:
      - CONFIG_NEWLIB_LIBC=y
  portability.posix.mapped_files.picolibc:
    tags: picolibc
    filter: (not CONFIG_NATIVE_LIBC) and CONFIG_PICOLIBC_SUPPORTED
    extra_configs:
      - CONFIG_PICOLIBC=y
  portability.posix.mapped_files.linux_compat:
    tags: native
    platform_allow:
      - native_sim
      - native_sim/native/64
    filter: CONFIG_NATIVE_LIBC
    extra_configs:
      - CONFIG_POSIX_TEST_LINUX_COMPAT=y
```

## tests/posix/memory_protection/testcase.yaml
```yaml
common:
  ignore_faults: true
  tags:
    - posix_memory_protection
  # 1 tier0 platform per supported architecture
  platform_key:
    - arch
    - simulation
  min_flash: 64
  min_ram: 32
tests:
  portability.posix.memory_protection:
    filter: not CONFIG_NATIVE_LIBC
  portability.posix.memory_protection.userspace:
    filter: (not CONFIG_NATIVE_LIBC) and CONFIG_ARCH_HAS_USERSPACE
    tags: userspace
    extra_configs:
      - CONFIG_TEST_USERSPACE=y
      - CONFIG_USERSPACE=y
      # 8-region MPU: stack guard + thread stack leave only 3 domain slots
      - platform:mps2/an385:CONFIG_TEST_USERSPACE_WITHOUT_HW_STACK_PROTECTION=y
  portability.posix.memory_protection.minimal:
    filter: not CONFIG_NATIVE_LIBC
    extra_configs:
      - CONFIG_MINIMAL_LIBC=y
  portability.posix.memory_protection.newlib:
    filter: (not CONFIG_NATIVE_LIBC) and (TOOLCHAIN_HAS_NEWLIB == 1)
    extra_configs:
      - CONFIG_NEWLIB_LIBC=y
  portability.posix.memory_protection.picolibc:
    tags: picolibc
    filter: (not CONFIG_NATIVE_LIBC) and CONFIG_PICOLIBC_SUPPORTED
    extra_configs:
      - CONFIG_PICOLIBC=y
  portability.posix.memory_protection.linux_compat:
    tags: native
    platform_allow:
      - native_sim
      - native_sim/native/64
    filter: CONFIG_NATIVE_LIBC
    extra_configs:
      - CONFIG_POSIX_TEST_LINUX_COMPAT=y
```

## tests/posix/message_passing/testcase.yaml
```yaml
common:
  tags:
    - posix_message_passing
  # 1 tier0 platform per supported architecture
  platform_key:
    - arch
    - simulation
  min_flash: 64
  min_ram: 32
tests:
  portability.posix.message_passing:
    filter: not CONFIG_NATIVE_LIBC
  portability.posix.message_passing.userspace:
    filter: (not CONFIG_NATIVE_LIBC) and CONFIG_ARCH_SUPPORTS_USERSPACE_SIGNALS
    tags: userspace
    extra_configs:
      - CONFIG_TEST_USERSPACE=y
      - CONFIG_USERSPACE=y
  portability.posix.message_passing.static_only:
    filter: not CONFIG_NATIVE_LIBC
    extra_configs:
      # equal to the accumulated SYS_MSGQ_MIN (SYS_MSGQ_MIN_ADD_TEST=2): no dynamic queues
      - CONFIG_SYS_MSGQ_MAX=2
  portability.posix.message_passing.minimal:
    filter: not CONFIG_NATIVE_LIBC
    extra_configs:
      - CONFIG_MINIMAL_LIBC=y
      # one-shot SIGEV_THREAD notification contexts are heap-allocated
      - CONFIG_COMMON_LIBC_MALLOC_ARENA_SIZE=1024
  portability.posix.message_passing.newlib:
    filter: (not CONFIG_NATIVE_LIBC) and (TOOLCHAIN_HAS_NEWLIB == 1)
    extra_configs:
      - CONFIG_NEWLIB_LIBC=y
  portability.posix.message_passing.picolibc:
    tags: picolibc
    filter: (not CONFIG_NATIVE_LIBC) and CONFIG_PICOLIBC_SUPPORTED
    extra_configs:
      - CONFIG_PICOLIBC=y
  portability.posix.message_passing.linux_compat:
    tags: native
    platform_allow:
      - native_sim
      - native_sim/native/64
    filter: CONFIG_NATIVE_LIBC
    extra_configs:
      - CONFIG_POSIX_TEST_LINUX_COMPAT=y
      - CONFIG_NATIVE_SIM_SLOWDOWN_TO_REAL_TIME=y
```

## tests/posix/multi_process/exit/testcase.yaml
```yaml
common:
  tags:
    - posix_multi_process
  # 1 tier0 platform per supported architecture
  platform_key:
    - arch
    - simulation
  min_flash: 64
  min_ram: 32
  harness: console
  harness_config:
    type: multi_line
    ordered: true
    regex:
      - "app:exiting"
      - "atexit:first"
      - "atexit:second"
      - "atexit:last"
tests:
  portability.posix.multi_process.exit:
    filter: not CONFIG_NATIVE_LIBC
  portability.posix.multi_process.exit.minimal:
    filter: not CONFIG_NATIVE_LIBC
    extra_configs:
      - CONFIG_MINIMAL_LIBC=y
  portability.posix.multi_process.exit.newlib:
    filter: (not CONFIG_NATIVE_LIBC) and (TOOLCHAIN_HAS_NEWLIB == 1)
    extra_configs:
      - CONFIG_NEWLIB_LIBC=y
  portability.posix.multi_process.exit.picolibc:
    tags: picolibc
    filter: (not CONFIG_NATIVE_LIBC) and CONFIG_PICOLIBC_SUPPORTED
    extra_configs:
      - CONFIG_PICOLIBC=y
  portability.posix.multi_process.exit.linux_compat:
    tags: native
    platform_allow:
      - native_sim
      - native_sim/native/64
    filter: CONFIG_NATIVE_LIBC
```

## tests/posix/multi_process/testcase.yaml
```yaml
common:
  tags:
    - posix_multi_process
  # 1 tier0 platform per supported architecture
  platform_key:
    - arch
    - simulation
  min_flash: 64
  min_ram: 32
tests:
  portability.posix.multi_process:
    filter: not CONFIG_NATIVE_LIBC
  portability.posix.multi_process.userspace:
    filter: (not CONFIG_NATIVE_LIBC) and CONFIG_ARCH_HAS_USERSPACE
    tags: userspace
    extra_configs:
      - CONFIG_TEST_USERSPACE=y
      - CONFIG_USERSPACE=y
  portability.posix.multi_process.minimal:
    filter: not CONFIG_NATIVE_LIBC
    extra_configs:
      - CONFIG_MINIMAL_LIBC=y
  portability.posix.multi_process.newlib:
    filter: (not CONFIG_NATIVE_LIBC) and (TOOLCHAIN_HAS_NEWLIB == 1)
    extra_configs:
      - CONFIG_NEWLIB_LIBC=y
  portability.posix.multi_process.picolibc:
    tags: picolibc
    filter: (not CONFIG_NATIVE_LIBC) and CONFIG_PICOLIBC_SUPPORTED
    extra_configs:
      - CONFIG_PICOLIBC=y
  portability.posix.multi_process.linux_compat:
    tags: native
    platform_allow:
      - native_sim
      - native_sim/native/64
    filter: CONFIG_NATIVE_LIBC
    extra_configs:
      - CONFIG_POSIX_TEST_LINUX_COMPAT=y
      - CONFIG_NATIVE_SIM_SLOWDOWN_TO_REAL_TIME=y
```

## tests/posix/non_portable/testcase.yaml
```yaml
common:
  tags:
    - posix_non_portable
  min_ram: 64
  platform_key:
    - arch
    - simulation
tests:
  portability.posix.non_portable:
    filter: not CONFIG_NATIVE_LIBC
  # wait3()/wait4() need processes; the CPU time they report needs its accounting
  portability.posix.non_portable.multi_process:
    filter: not CONFIG_NATIVE_LIBC
    extra_configs:
      - CONFIG_POSIX_MULTI_PROCESS=y
      - CONFIG_THREAD_RUNTIME_STATS=y
      - CONFIG_SCHED_THREAD_USAGE=y
  portability.posix.non_portable.userspace:
    filter: (not CONFIG_NATIVE_LIBC) and CONFIG_ARCH_HAS_USERSPACE
    tags: userspace
    extra_configs:
      - CONFIG_TEST_USERSPACE=y
      - CONFIG_USERSPACE=y
  portability.posix.non_portable.linux_compat:
    tags: native
    platform_allow:
      - native_sim
      - native_sim/native/64
    filter: CONFIG_NATIVE_LIBC
    extra_configs:
      - CONFIG_POSIX_TEST_LINUX_COMPAT=y
```

## tests/posix/pipe/testcase.yaml
```yaml
common:
  tags:
    - posix_pipe
  # 1 tier0 platform per supported architecture
  platform_key:
    - arch
    - simulation
  min_flash: 64
  min_ram: 32
tests:
  portability.posix.pipe:
    filter: not CONFIG_NATIVE_LIBC
  portability.posix.pipe.userspace:
    filter: (not CONFIG_NATIVE_LIBC) and CONFIG_ARCH_SUPPORTS_USERSPACE_SIGNALS
    tags: userspace
    extra_configs:
      - CONFIG_TEST_USERSPACE=y
      - CONFIG_USERSPACE=y
  portability.posix.pipe.minimal:
    filter: not CONFIG_NATIVE_LIBC
    extra_configs:
      - CONFIG_MINIMAL_LIBC=y
  portability.posix.pipe.newlib:
    filter: (not CONFIG_NATIVE_LIBC) and (TOOLCHAIN_HAS_NEWLIB == 1)
    extra_configs:
      - CONFIG_NEWLIB_LIBC=y
  portability.posix.pipe.picolibc:
    tags: picolibc
    filter: (not CONFIG_NATIVE_LIBC) and CONFIG_PICOLIBC_SUPPORTED
    extra_configs:
      - CONFIG_PICOLIBC=y
  portability.posix.pipe.linux_compat:
    tags: native
    platform_allow:
      - native_sim
      - native_sim/native/64
    filter: CONFIG_NATIVE_LIBC
    extra_configs:
      - CONFIG_POSIX_TEST_LINUX_COMPAT=y
```

## tests/posix/regexp/testcase.yaml
```yaml
common:
  tags:
    - posix_regexp
  platform_key:
    - arch
    - simulation
  min_flash: 64
  min_ram: 32
tests:
  portability.posix.regexp:
    filter: not CONFIG_NATIVE_LIBC
  portability.posix.regexp.minimal:
    filter: not CONFIG_NATIVE_LIBC
    extra_configs:
      - CONFIG_MINIMAL_LIBC=y
  portability.posix.regexp.newlib:
    filter: (not CONFIG_NATIVE_LIBC) and (TOOLCHAIN_HAS_NEWLIB == 1)
    extra_configs:
      - CONFIG_NEWLIB_LIBC=y
  portability.posix.regexp.picolibc:
    tags: picolibc
    filter: (not CONFIG_NATIVE_LIBC) and CONFIG_PICOLIBC_SUPPORTED
    extra_configs:
      - CONFIG_PICOLIBC=y
  portability.posix.regexp.linux_compat:
    tags: native
    platform_allow:
      - native_sim
      - native_sim/native/64
    filter: CONFIG_NATIVE_LIBC
    extra_configs:
      - CONFIG_POSIX_TEST_LINUX_COMPAT=y
```

## tests/posix/rw_locks/testcase.yaml
```yaml
common:
  tags:
    - posix_rw_locks
  # 1 tier0 platform per supported architecture
  platform_key:
    - arch
    - simulation
  min_flash: 64
  min_ram: 32
tests:
  portability.posix.rw_locks:
    filter: not CONFIG_NATIVE_LIBC
  portability.posix.rw_locks.minimal:
    filter: not CONFIG_NATIVE_LIBC
    extra_configs:
      - CONFIG_MINIMAL_LIBC=y
  portability.posix.rw_locks.newlib:
    filter: (not CONFIG_NATIVE_LIBC) and (TOOLCHAIN_HAS_NEWLIB == 1)
    extra_configs:
      - CONFIG_NEWLIB_LIBC=y
      - CONFIG_NEWLIB_LIBC_MIN_REQUIRED_HEAP_SIZE=8192
  portability.posix.rw_locks.picolibc:
    tags: picolibc
    filter: (not CONFIG_NATIVE_LIBC) and CONFIG_PICOLIBC_SUPPORTED
    extra_configs:
      - CONFIG_PICOLIBC=y
  portability.posix.rw_locks.linux_compat:
    tags: native
    platform_allow:
      - native_sim
      - native_sim/native/64
    filter: CONFIG_NATIVE_LIBC
    extra_configs:
      - CONFIG_POSIX_TEST_LINUX_COMPAT=y
```
