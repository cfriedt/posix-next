## CMakeLists.txt
```
# SPDX-License-Identifier: Apache-2.0

cmake_minimum_required(VERSION 3.20.0)
find_package(Zephyr REQUIRED HINTS $ENV{ZEPHYR_BASE})
project(posix_realtime_signals)

target_sources(app PRIVATE src/main.c ../shared/msleep.c)

target_compile_options(app PRIVATE -U_POSIX_C_SOURCE -D_POSIX_C_SOURCE=200809L)
```

## prj.conf
```kconfig
CONFIG_ZTEST=y

CONFIG_POSIX_AEP_CHOICE_PSE51=y
CONFIG_POSIX_REALTIME_SIGNALS=y
# sigqueue() is process-directed; the tests use getpid() as its target
CONFIG_POSIX_MULTI_PROCESS=y
```

## src/main.c
```c
/*
 * Copyright (c) 2024, Friedt Professional Engineering Services, Inc.
 *
 * SPDX-License-Identifier: Apache-2.0
 */

#include <errno.h>
#include <limits.h>

#include <signal.h>
#include <pthread.h>
#include <string.h>
#include <unistd.h>

#if !defined(CONFIG_NATIVE_LIBC)
#undef sigemptyset
#undef sigfillset
#undef sigaddset
#undef sigdelset
#undef sigismember
#endif

#include <zephyr/kernel.h>
#include <zephyr/kernel/signal.h>
#include <zephyr/sys/util.h>
#include <zephyr/ztest.h>

#include "../../shared/linux_compat_test.h"

#ifdef CONFIG_USERSPACE
int pthread_kill(pthread_t thread, int sig);
#endif

#define SIGSET_NLONGS (sizeof(sigset_t) / sizeof(unsigned long))

BUILD_ASSERT(SIGSET_NLONGS > 0, "sigset_t has no storage");

#ifndef RTSIG_MAX
#define RTSIG_MAX CONFIG_POSIX_RTSIG_MAX
#endif
#ifndef SIGQUEUE_MAX
#define SIGQUEUE_MAX _POSIX_SIGQUEUE_MAX
#endif

BUILD_ASSERT(RTSIG_MAX > 0);
BUILD_ASSERT(SIGQUEUE_MAX > 0);
BUILD_ASSERT(SIGQUEUE_MAX >= SIGNAL_QUEUE_SIZE);

static ZTEST_BMEM bool rt_sigset_usable;
/* number of real-time signals that actually fit in sigset_t (and below SIGRTMAX) */
static ZTEST_BMEM int rt_nsigs;

/*
 * sigqueue() is process-directed. With the host libc, a process-directed signal may be
 * delivered to any of the simulator's host threads (with terminating default action), so
 * queue directly to the test thread there. On Zephyr the callers queue from the target
 * thread itself, so the caller's own process is the target.
 */
static int queue_rt_signal(pthread_t target, int signo, union sigval value)
{
#if defined(CONFIG_NATIVE_LIBC)
	/* glibc only declares pthread_sigqueue() with _GNU_SOURCE, which this test
	 * does not define (it builds with _POSIX_C_SOURCE=200809L)
	 */
	extern int pthread_sigqueue(pthread_t thread, int sig, const union sigval value);
	int ret = pthread_sigqueue(target, signo, value);

	if (ret != 0) {
		errno = ret;
		return -1;
	}

	return 0;
#else
	ARG_UNUSED(target);

	return sigqueue(getpid(), signo, value);
#endif
}

static void skip_if_rt_sigset_too_small(void)
{
	if (!rt_sigset_usable) {
		/*
		 * Some libc's provide a sigset_t that is too small for real-time
		 * signals at SIGRTMIN (e.g. picolibc on 32-bit native_sim).
		 */
		ztest_test_skip();
	}
}

static void block_rt_signals(void);

static ZTEST_BMEM sigset_t rt_sigset;

static ZTEST_BMEM struct sigqueue_work {
	struct k_work_delayable dwork;
	pid_t pid;
} sigq_work;

static void do_queue(struct k_work *work)
{
	struct sigqueue_work *sq_work = CONTAINER_OF(
		CONTAINER_OF(work, struct k_work_delayable, work), struct sigqueue_work, dwork);

	/* the work queue thread may belong to another process: use the captured pid */
	zassert_ok(sigqueue(sq_work->pid, SIGRTMIN, (union sigval){0}));
}

/* unused with the host libc, where blocking in a host call stalls the k_work queue */
__maybe_unused static void queue_signal_after_ms(int delay_ms)
{
	(void)k_work_cancel_delayable(&sigq_work.dwork);
	sigq_work.pid = getpid();
	k_work_init_delayable(&sigq_work.dwork, do_queue);
	k_work_schedule(&sigq_work.dwork, K_MSEC(delay_ms));
}

static void drain_pending_rt_signals(void)
{
	sigset_t set = rt_sigset;
	struct timespec timeout = {0};
	int signo;

	while ((signo = sigtimedwait(&set, NULL, &timeout)) >= 0) {
		(void)signo;
	}
	errno = 0;
}

static void unblock_rt_signal(int signo)
{
	struct k_sig_set mask;

	if (k_is_user_context()) {
		sigset_t pmask;

		sigemptyset(&pmask);
		zassert_ok(sigaddset(&pmask, signo));
		zassert_ok(pthread_sigmask(SIG_UNBLOCK, &pmask, NULL));
		return;
	}

	zassert_ok(k_sig_emptyset(&mask));
	zassert_ok(k_sig_addset(&mask, signo));
	zassert_ok(k_sig_mask(K_SIG_UNBLOCK, &mask, NULL));
}

static void block_rt_signals(void)
{
	sigset_t mask;

	if (IS_ENABLED(CONFIG_NATIVE_LIBC)) {
		/*
		 * With the host libc, the real-time signals themselves must be blocked so
		 * that they remain pending for sigtimedwait()/sigwaitinfo() instead of
		 * being delivered with their default (terminating) action.
		 */
		zassert_ok(pthread_sigmask(SIG_BLOCK, &rt_sigset, NULL));
		return;
	}

	sigfillset(&mask);
	for (int i = 0; i < rt_nsigs; ++i) {
		zassert_ok(sigdelset(&mask, (SIGRTMIN + i)));
	}

	zassert_ok(pthread_sigmask(SIG_BLOCK, &mask, NULL));
}

static void test_sigqueue(void)
{
	sigset_t set = rt_sigset;
	siginfo_t info;
	struct timespec timeout = {0};

	{
		zassert_not_ok(sigqueue(-1, -1, (union sigval){0}));
#if defined(CONFIG_NATIVE_LIBC)
		zassert_true(errno == EINVAL || errno == ESRCH,
			     "errno was %d, expected EINVAL or ESRCH", errno);
#else
		zassert_equal(errno, EINVAL);
#endif

		zassert_not_ok(sigqueue(-1, SIGUSR1, (union sigval){0}));
		zassert_equal(errno, ESRCH, "errno was %d instead of ESRCH (%d)", errno, ESRCH);

		zassert_not_ok(queue_rt_signal(pthread_self(), -1, (union sigval){0}));
#if defined(CONFIG_NATIVE_LIBC)
		zassert_true(errno == EINVAL || errno == ESRCH,
			     "errno was %d, expected EINVAL or ESRCH", errno);
#else
		zassert_equal(errno, EINVAL, "errno was %d instead of EINVAL (%d)", errno, EINVAL);
#endif
	}

	block_rt_signals();

	for (int i = 0; i < SIGNAL_QUEUE_SIZE; ++i) {
		zassert_ok(queue_rt_signal(pthread_self(), SIGRTMIN,
					   (union sigval){.sival_int = i}),
			   "failed to queue the %d-th signal", i);
	}

	/* the host queue depth is governed by RLIMIT_SIGPENDING, not SIGQUEUE_MAX */
	IF_NOT_NATIVE_LIBC({
		zassert_not_ok(sigqueue(getpid(), SIGRTMIN, (union sigval){0}));
		zassert_equal(errno, EAGAIN);
	})

	for (int i = 0; i < SIGNAL_QUEUE_SIZE; ++i) {
		int actual;

		info = (siginfo_t){0};
		actual = sigtimedwait(&set, &info, &timeout);

		zassert_equal(
			SIGRTMIN, actual,
			"iteration %d expected SIGRTMIN (%d) but sigtimedwait() returned %d "
			"(errno: %d)",
			i, SIGRTMIN, actual, errno);
		zassert_equal(info.si_value.sival_int, i);
	}

	for (int i = rt_nsigs - 1; i >= 0; --i) {
		zassert_ok(queue_rt_signal(pthread_self(), (SIGRTMIN + i), (union sigval){0}),
			   "unable to queue signal %d", (SIGRTMIN + i));
	}

	for (int i = 0; i < rt_nsigs; ++i) {
		int actual = sigtimedwait(&set, NULL, &timeout);

		zassert_equal((SIGRTMIN + i), actual,
			      "expected signal %d, but sigtimedwait() returned %d", (SIGRTMIN + i),
			      actual);
	}
}

static void test_sigtimedwait(void)
{
	sigset_t set = rt_sigset;
	siginfo_t info;
	pthread_t self = pthread_self();
	uint32_t begin_ms, delta_ms, end_ms;
	struct timespec timeout = {0};
	struct timespec wait_100ms = {
		.tv_sec = 0,
		.tv_nsec = 100 * NSEC_PER_MSEC,
	};

	const struct stw_args_exp {
		const sigset_t *set;
		siginfo_t *info;
		struct timespec *timeout;
		int expected_errno;
	} harness[] = {
		{NULL, NULL, NULL, EINVAL},
		{NULL, NULL, &timeout, EINVAL},
		{NULL, &info, NULL, EINVAL},
		{NULL, &info, &timeout, EINVAL},
		{&set, NULL, NULL, 0},
		{&set, NULL, &timeout, 0},
		{&set, &info, NULL, 0},
		{&set, &info, &timeout, 0},
	};

	block_rt_signals();

	ARRAY_FOR_EACH_PTR(harness, a) {
		/*
		 * The host libc declares the set argument of sigtimedwait()
		 * and sigwaitinfo() nonnull, so the NULL-set probes are
		 * undefined against it; UBSAN traps them at the call site
		 * before EFAULT can be observed.
		 */
		if (IS_ENABLED(CONFIG_UBSAN) && IS_ENABLED(CONFIG_NATIVE_LIBC) &&
		    a->set == NULL) {
			continue;
		}

		errno = 0;
		if (a->expected_errno == 0) {
			zassert_ok(queue_rt_signal(self, SIGRTMIN, (union sigval){0}));
			zassert_equal(SIGRTMIN, sigtimedwait(a->set, a->info, a->timeout));
			if (a->info != NULL) {
				zassert_equal(a->info->si_signo, SIGRTMIN);
			}
		} else {
			zassert_equal(-1, sigtimedwait(a->set, a->info, a->timeout));
			if (IS_ENABLED(CONFIG_NATIVE_LIBC)) {
				/* the host libc reports EFAULT for a NULL set */
				zassert_true(errno == a->expected_errno || errno == EFAULT,
					     "errno was %d", errno);
			} else {
				zassert_equal(errno, a->expected_errno);
			}
		}
	}

	begin_ms = now_ms();
	zassert_equal(-1, sigtimedwait(&set, NULL, &timeout));
	zassert_equal(errno, EAGAIN);
	end_ms = now_ms();
	delta_ms = end_ms - begin_ms;
	zassert_true(delta_ms < 50);

	begin_ms = now_ms();
	zassert_equal(-1, sigtimedwait(&set, NULL, &wait_100ms));
	zassert_equal(errno, EAGAIN);
	end_ms = now_ms();
	delta_ms = end_ms - begin_ms;
	zassert_true(delta_ms >= 100);

	/* k_work items cannot make progress while the test thread blocks in the host libc */
	IF_NOT_NATIVE_LIBC({
		struct timespec wait_300ms = {
			.tv_sec = 0,
			.tv_nsec = 300 * NSEC_PER_MSEC,
		};

		begin_ms = now_ms();
		queue_signal_after_ms(100);
		zassert_equal(SIGRTMIN, sigtimedwait(&set, NULL, &wait_300ms));
		end_ms = now_ms();
		delta_ms = end_ms - begin_ms;
		zassert_true(delta_ms >= 100);
		zassert_true(delta_ms < 200);
	})
}

static void test_sigwaitinfo(void)
{
	sigset_t set = rt_sigset;
	siginfo_t info;

	const struct swi_args_exp {
		const sigset_t *set;
		siginfo_t *info;
		int expected_errno;
	} harness[] = {
		{NULL, NULL, EINVAL},
		{NULL, &info, EINVAL},
		{&set, NULL, 0},
		{&set, &info, 0},
	};

	block_rt_signals();

	ARRAY_FOR_EACH_PTR(harness, a) {
		/*
		 * The host libc declares the set argument of sigtimedwait()
		 * and sigwaitinfo() nonnull, so the NULL-set probes are
		 * undefined against it; UBSAN traps them at the call site
		 * before EFAULT can be observed.
		 */
		if (IS_ENABLED(CONFIG_UBSAN) && IS_ENABLED(CONFIG_NATIVE_LIBC) &&
		    a->set == NULL) {
			continue;
		}

		errno = 0;
		if (a->expected_errno == 0) {
			zassert_ok(queue_rt_signal(pthread_self(), SIGRTMIN,
						   (union sigval){.sival_int = 42}));
			zassert_equal(SIGRTMIN, sigwaitinfo(a->set, a->info));
			if (a->info != NULL) {
				zassert_equal(a->info->si_signo, SIGRTMIN);
				zassert_equal(a->info->si_value.sival_int, 42);
			}
		} else {
			zassert_equal(-1, sigwaitinfo(a->set, a->info));
			if (IS_ENABLED(CONFIG_NATIVE_LIBC)) {
				/* the host libc reports EFAULT for a NULL set */
				zassert_true(errno == a->expected_errno || errno == EFAULT,
					     "errno was %d", errno);
			} else {
				zassert_equal(errno, a->expected_errno);
			}
		}
	}

	/* k_work items cannot make progress while the test thread blocks in the host libc */
	IF_NOT_NATIVE_LIBC({
		uint32_t begin_ms, delta_ms, end_ms;

		begin_ms = now_ms();
		queue_signal_after_ms(100);
		zassert_equal(SIGRTMIN, sigwaitinfo(&set, NULL));
		end_ms = now_ms();
		delta_ms = end_ms - begin_ms;
		zassert_true(delta_ms >= 100);
		zassert_true(delta_ms < 200);
	})
}

static ZTEST_BMEM volatile bool rt_handler_called;

static void rt_k_handler(int sig, struct k_sig_info *info, void *ucontext)
{
	ARG_UNUSED(sig);
	ARG_UNUSED(info);
	ARG_UNUSED(ucontext);

	rt_handler_called = true;
}

/*
 * Zephyr delivers queued signals from z_sig_handle() at thread swap points, not
 * k_sig_queue() syscall wrapper. That is not Linux-style preemption; signals
 * from other threads are delivered when the target thread next completes a
 * syscall.
 */
static void test_rt_delivery_deferred(void)
{
	struct k_sig_action action = {
		.handler = rt_k_handler,
	};

	rt_handler_called = false;
	unblock_rt_signal(K_SIG_RTMIN);
	zassert_ok(k_sig_action(K_SIG_RTMIN, &action, NULL));
	zassert_ok(k_sig_queue((k_pid_t)k_current_get(), K_SIG_RTMIN, (union k_sig_val){0}));
	zassert_true(rt_handler_called,
		     "handler runs by the time k_sig_queue() returns (syscall check)");

	action.handler = K_SIG_DFL;
	zassert_ok(k_sig_action(K_SIG_RTMIN, &action, NULL));
}

ZTEST(posix_realtime_signals, test_sigqueue)
{
	skip_if_rt_sigset_too_small();
	test_sigqueue();
}

ZTEST(posix_realtime_signals, test_sigtimedwait)
{
	skip_if_rt_sigset_too_small();
	test_sigtimedwait();
}

/* re-armed: the first alarm may land before the wait it is meant to interrupt */
static void sigwaitinfo_signal_handler(int sig)
{
	ARG_UNUSED(sig);
	(void)alarm(1);
}

/* a caught signal outside the set ends the wait with EINTR */
static void test_sigwaitinfo_interrupted(void)
{
	struct sigaction act = {.sa_handler = sigwaitinfo_signal_handler};
	sigset_t set = rt_sigset;
	sigset_t alrm;
	siginfo_t info;

	block_rt_signals();
	zassert_ok(sigemptyset(&alrm));
	zassert_ok(sigaddset(&alrm, SIGALRM));
	zassert_ok(sigprocmask(SIG_UNBLOCK, &alrm, NULL));
	zassert_ok(sigaction(SIGALRM, &act, NULL));
	zassert_equal(alarm(1), 0);
	zassert_equal(sigwaitinfo(&set, &info), -1);
	zassert_equal(errno, EINTR);
	zassert_true(alarm(0) <= 1);
	act.sa_handler = SIG_DFL;
	zassert_ok(sigaction(SIGALRM, &act, NULL));
	zassert_ok(sigprocmask(SIG_BLOCK, &alrm, NULL));
}

ZTEST(posix_realtime_signals, test_sigwaitinfo)
{
	skip_if_rt_sigset_too_small();
	test_sigwaitinfo();
	/* the host libc delivers a process-directed signal to any of the simulator's host threads */
	if (!IS_ENABLED(CONFIG_NATIVE_LIBC)) {
		test_sigwaitinfo_interrupted();
	}
}

ZTEST(posix_realtime_signals, test_rt_delivery_deferred)
{
	test_rt_delivery_deferred();
}

ZTEST_USER(posix_realtime_signals, test_sigqueue_user)
{
	skip_if_rt_sigset_too_small();
	test_sigqueue();
}

ZTEST_USER(posix_realtime_signals, test_sigtimedwait_user)
{
	skip_if_rt_sigset_too_small();
	test_sigtimedwait();
}

ZTEST_USER(posix_realtime_signals, test_sigwaitinfo_user)
{
	skip_if_rt_sigset_too_small();
	test_sigwaitinfo();
}

#ifdef CONFIG_USERSPACE
ZTEST_USER(posix_realtime_signals, test_cannot_sigqueue_kernel_from_user)
{
	extern struct k_thread z_main_thread;

	zassert_equal(EPERM, pthread_kill((pthread_t)(uintptr_t)&z_main_thread, SIGRTMIN));
}
#endif

static void *setup(void)
{
	sigset_t probe;

	sigemptyset(&probe);
	if (sigaddset(&probe, SIGRTMIN) != 0) {
		/*
		 * Some libc's provide a sigset_t that is too small for real-time
		 * signals at SIGRTMIN, reserve that signal number,
		 */
		rt_sigset_usable = false;
		return NULL;
	}

	rt_sigset_usable = true;
	rt_nsigs = 0;
	sigemptyset(&rt_sigset);
	for (int i = 0; i < RTSIG_MAX; ++i) {
		const int signo = SIGRTMIN + i;

		if (signo > SIGRTMAX) {
			break;
		}
		if ((signo - 1) >= SIGSET_NLONGS * BITS_PER_LONG) {
			break;
		}
		if (sigaddset(&rt_sigset, signo) != 0) {
			break;
		}
		++rt_nsigs;
	}

	return NULL;
}

static void before(void *arg)
{
	ARG_UNUSED(arg);

	(void)k_work_cancel_delayable(&sigq_work.dwork);
	drain_pending_rt_signals();
	{
		struct k_sig_action action = {
			.handler = K_SIG_DFL,
		};

		(void)k_sig_action(K_SIG_RTMIN, &action, NULL);
	}
}

static void after(void *arg)
{
	ARG_UNUSED(arg);

	(void)k_work_cancel_delayable(&sigq_work.dwork);
}

ZTEST_SUITE(posix_realtime_signals, NULL, setup, before, after, NULL);
```
