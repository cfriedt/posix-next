## CMakeLists.txt
```
# SPDX-License-Identifier: Apache-2.0

cmake_minimum_required(VERSION 3.20.0)
find_package(Zephyr REQUIRED HINTS $ENV{ZEPHYR_BASE})
project(posix_fork)

FILE(GLOB app_sources src/*.c)
target_sources(app PRIVATE ${app_sources})

target_compile_options(app PRIVATE -U_POSIX_C_SOURCE -D_POSIX_C_SOURCE=200809L)
```

## prj.conf
```kconfig
CONFIG_ZTEST=y

CONFIG_POSIX_AEP_CHOICE_BASE=y
CONFIG_POSIX_MULTI_PROCESS=y
CONFIG_USERSPACE=y
CONFIG_TEST_USERSPACE=y
CONFIG_PROCESS_VM=y
# fork's same-address TLS requires the arch current-thread lookup
CONFIG_CURRENT_THREAD_USE_TLS=n
CONFIG_SYS_PROCESS_MAX=4
# three fork round-trips: the reaped children's tables free lazily
CONFIG_HEAP_MEM_POOL_SIZE=196608
# a child's copies come from the page-frame pool: an arena the kernel heap could not hold
CONFIG_COMMON_LIBC_MALLOC_ARENA_SIZE=524288
CONFIG_MAX_THREAD_BYTES=5
CONFIG_SYS_THREAD_THREAD_MIN=4
CONFIG_SYS_THREAD_STACK_MIN=4

# fd inheritance sections use an eventfd as the shared description
CONFIG_POSIX_DEVICE_IO=y
CONFIG_EVENTFD=y

# the disposition inheritance section queries sigaction() across fork
CONFIG_POSIX_SIGNALS=y
```

## boards/qemu_riscv64_qemu_virt_riscv64_sv48.conf
```kconfig
# SPDX-FileCopyrightText: Copyright The Zephyr Project Contributors
# SPDX-License-Identifier: Apache-2.0

# four-level tables: the ztest domain, the three forked children and their
# kernel views each privatize a table per level (page tables are not reclaimed)
CONFIG_MAX_XLAT_TABLES=64
```

## boards/qemu_x86_64.conf
```kconfig
# SPDX-FileCopyrightText: Copyright The Zephyr Project Contributors
# SPDX-License-Identifier: Apache-2.0

# one additional domain per fork round-trip (page tables are not reclaimed):
# the ztest domain plus the three forked children
CONFIG_X86_MAX_ADDITIONAL_MEM_DOMAINS=4
```

## src/main.c
```c
/*
 * SPDX-FileCopyrightText: Copyright The Zephyr Project Contributors
 *
 * SPDX-License-Identifier: Apache-2.0
 */

#include <errno.h>
#include <stdlib.h>
#include <sys/eventfd.h>
#include <sys/wait.h>
#include <unistd.h>

#include <zephyr/ztest.h>

/*
 * Experimental CONFIG_PROCESS_VM fork over the kernel-assisted resume: the
 * child's first run returns to user mode from the parent's captured syscall
 * frame (no setjmp/longjmp), so fork() must be called from user mode - a
 * kernel-mode caller has no syscall frame and gets ENOTSUP.
 */

static ZTEST_DMEM volatile int fork_shared = 10;
static Z_THREAD_LOCAL volatile int fork_tls = 30;

ZTEST_USER(posix_fork, test_fork)
{
	volatile int on_stack = 20;
	volatile int *tls_addr = &fork_tls;

	zassert_equal(fork_shared, 10, "app-data not initialized before fork");
	zassert_equal(fork_tls, 30, "TLS not initialized before fork");

	pid_t pid = fork();

	zassert_true(pid >= 0, "fork failed: %d", errno);

	if (pid == 0) {
		/* TLS keeps its address and contents across fork (POSIX) */
		if ((&fork_tls != tls_addr) || (fork_tls != 30)) {
			_exit(2);
		}
		fork_shared = 11;
		on_stack = 21;
		fork_tls = 31;
		_exit((fork_shared == 11 && on_stack == 21 && fork_tls == 31) ? 7 : 1);
	}

	int status = -1;

	zassert_equal(waitpid(pid, &status, 0), pid);
	zassert_true(WIFEXITED(status));
	zassert_equal(WEXITSTATUS(status), 7, "child could not diverge its own copy");

	zassert_equal(on_stack, 20, "parent stack was mutated");
	zassert_equal(fork_shared, 10, "parent app-data was mutated");
	zassert_equal(fork_tls, 30, "parent TLS was mutated");

	/* descriptors: the child inherits copies sharing the descriptions */
	eventfd_t val = 0;
	int efd = eventfd(0, 0);

	zassert_true(efd >= 0, "eventfd failed: %d", errno);

	pid = fork();
	zassert_true(pid >= 0, "fork failed: %d", errno);
	if (pid == 0) {
		/* the inherited descriptor reaches the same open description */
		if (eventfd_write(efd, 5) != 0) {
			_exit(3);
		}
		/* closing here drops only this process's descriptor */
		_exit((close(efd) == 0) ? 8 : 4);
	}

	status = -1;
	zassert_equal(waitpid(pid, &status, 0), pid);
	zassert_true(WIFEXITED(status));
	zassert_equal(WEXITSTATUS(status), 8);

	/* the parent's descriptor survives the child's close and exit */
	zassert_ok(eventfd_read(efd, &val));
	zassert_equal(val, 5);
	zassert_ok(close(efd));
}

ZTEST_SUITE(posix_fork, NULL, NULL, NULL, NULL, NULL);
```
