## Kconfig
```kconfig
# SPDX-FileCopyrightText: Copyright The Zephyr Project Contributors
# SPDX-License-Identifier: Apache-2.0

rsource "lib/posix/Kconfig"
rsource "lib/xz/Kconfig"
rsource "subsys/kcl/Kconfig"
```

## lib/posix/Kconfig
```kconfig
# Copyright (c) 2024 Meta
# Copyright (c) 2025 Tenstorrent AI ULC
#
# SPDX-License-Identifier: Apache-2.0

menu "POSIX API Support"

# POSIX Subprofile Definitions
rsource "Kconfig.profile"

# Toolchain hooks for external implementations
rsource "Kconfig.toolchain"

# POSIX C Library Extensions
# This menu is for POSIX Option Groups that do not require OS support.
menu "POSIX C Library Extensions"
rsource "c_lang_support_r/Kconfig"
rsource "c_lib_ext/Kconfig"
endmenu

# POSIX System Interfaces
menuconfig POSIX_SYSTEM_INTERFACES
	bool "POSIX System Interfaces"
	select NATIVE_LIBC_INCOMPATIBLE if !POSIX_TEST_LINUX_COMPAT
	help
	  Select 'y' here to support POSIX System Interfaces within Zephyr.

	  Options in this menu are organized by POSIX subprofiling Option Group.

	  For more information, see
	  https://pubs.opengroup.org/onlinepubs/9699919799/xrat/V4_subprofiles.html


if POSIX_SYSTEM_INTERFACES
config POSIX_LLEXT_SYMBOLS
	bool "Export the POSIX surface to linkable loadable extensions"
	depends on LLEXT
	help
	  Select 'y' here and every function of every enabled POSIX Option
	  Group is exported to linkable loadable extensions, so a conformant
	  application built as an extension resolves the whole surface at
	  load time.

rsource "options/Kconfig"

# POSIX Shell utilities
rsource "shell/Kconfig"
endif

endmenu

# Eventfd Support (not officially POSIX)
rsource "eventfd/Kconfig"
```

## lib/posix/advisory_info/Kconfig
```kconfig
# SPDX-FileCopyrightText: Copyright The Zephyr Project Contributors
# SPDX-License-Identifier: Apache-2.0

config POSIX_ADVISORY_INFO
	bool "POSIX advisory information"
	help
	  Select 'y' here and Zephyr will provide implementations of the
	  _POSIX_ADVISORY_INFO Option: posix_fadvise(), posix_fallocate(),
	  posix_madvise(), and posix_memalign(). Access-pattern advice is
	  checked and kept for nothing, since no cache acts on it;
	  posix_fallocate() extends the file to cover the region.
```

## lib/posix/asynchronous_io/Kconfig
```kconfig
# SPDX-FileCopyrightText: Copyright The Zephyr Project Contributors
#
# SPDX-License-Identifier: Apache-2.0

config POSIX_ASYNCHRONOUS_IO
	bool "POSIX asynchronous I/O"
	select SYS_AIO
	help
	  Enable the POSIX_ASYNCHRONOUS_IO Option Group: asynchronous read,
	  write, and file synchronization over the OS-managed request pool
	  (CONFIG_SYS_AIO), with per-request and list-completion sigevent
	  notification.

	  When enabled, the following functions are available:

	  aio_cancel(), aio_error(), aio_fsync(), aio_read(), aio_return(),
	  aio_suspend(), aio_write(), lio_listio()

if POSIX_ASYNCHRONOUS_IO

config POSIX_PRIORITIZED_IO
	bool "POSIX prioritized asynchronous I/O"
	default y
	select SYS_AIO_PRIORITY
	help
	  Enable the _POSIX_PRIORITIZED_IO Option: asynchronous I/O requests
	  are processed in priority order rather than submission order, each
	  at the scheduling priority of the calling thread lowered by the
	  control block's aio_reqprio (0 through AIO_PRIO_DELTA_MAX,
	  one Zephyr priority level per unit).

config POSIX_AIO_MAX
	def_int SYS_AIO_MAX
	help
	  Maximum number of outstanding asynchronous I/O operations. Derived
	  from the bound on the system asynchronous I/O request pool.

config POSIX_AIO_LISTIO_MAX
	def_int SYS_AIO_WAIT_MAX
	help
	  Maximum number of operations in one lio_listio() call. Derived from
	  the bound on the number of requests one sys_aio_wait() call can
	  wait on.

config SYS_AIO_MIN_ADD_POSIX_ASYNCHRONOUS_IO
	int
	default 0
	help
	  Contribution of the POSIX asynchronous I/O option group to the
	  accumulated minimum (guaranteed, statically allocated) size of the
	  system asynchronous I/O request pool.

config HEAP_MEM_POOL_ADD_SIZE_AIO
	def_int 512
	help
	  Heap contribution for asynchronous I/O requests allocated beyond
	  the statically guaranteed pool minimum.

endif # POSIX_ASYNCHRONOUS_IO
```

## lib/posix/c_lang_wide_char/Kconfig
```kconfig
# SPDX-FileCopyrightText: Copyright The Zephyr Project Contributors
# SPDX-License-Identifier: Apache-2.0

config POSIX_C_LANG_WIDE_CHAR
	bool "Wide-Character ISO C Library"
	depends on !MINIMAL_LIBC
	help
	  Select 'y' here and Zephyr will provide the POSIX_C_LANG_WIDE_CHAR
	  Option Group: the wide-character functions of <wchar.h> and
	  <wctype.h> come from the C library, and the wcstold() the Zephyr
	  SDK's Picolibc omits is provided here.
```

## lib/posix/device_specific/Kconfig
```kconfig
# SPDX-FileCopyrightText: Copyright The Zephyr Project Contributors
# SPDX-License-Identifier: Apache-2.0

config POSIX_DEVICE_SPECIFIC
	bool "POSIX terminal device interfaces"
	depends on POSIX_DEVICE_IO
	help
	  Select 'y' here and Zephyr will provide implementations of the
	  POSIX_DEVICE_SPECIFIC Option Group: the termios attribute and
	  line-control functions, ctermid(), isatty(), and ttyname(). The
	  console is the one terminal; attribute changes round-trip, and
	  the synchronous console driver completes drain, flush, flow, and
	  break operations trivially.
```

## lib/posix/device_specific_r/Kconfig
```kconfig
# SPDX-FileCopyrightText: Copyright The Zephyr Project Contributors
# SPDX-License-Identifier: Apache-2.0

config POSIX_DEVICE_SPECIFIC_R
	bool "POSIX terminal device interfaces (thread-safe)"
	select POSIX_DEVICE_SPECIFIC
	help
	  Select 'y' here and Zephyr will provide an implementation of the
	  POSIX_DEVICE_SPECIFIC_R Option Group: ttyname_r().
```

## lib/posix/fifo/Kconfig
```kconfig
# SPDX-FileCopyrightText: Copyright The Zephyr Project Contributors
# SPDX-License-Identifier: Apache-2.0

config POSIX_FIFO
	bool "POSIX FIFO special files"
	depends on POSIX_FILE_SYSTEM
	select ZVFS_PIPE if !TC_PROVIDES_POSIX_FIFO
	select ZVFS_FIFO if !TC_PROVIDES_POSIX_FIFO
	help
	  Select 'y' here and Zephyr will provide an implementation of the
	  POSIX_FIFO Option Group: mkfifo(). A FIFO is a node the file system
	  stores (ext2 provides it) that open() connects to a pipe; the pipes
	  come from the pool of CONFIG_ZVFS_PIPE_MAX, and the open descriptions
	  from CONFIG_ZVFS_FIFO_OPEN_MAX.
```

## lib/posix/fifo_fd/Kconfig
```kconfig
# SPDX-FileCopyrightText: Copyright The Zephyr Project Contributors
# SPDX-License-Identifier: Apache-2.0

config POSIX_FIFO_FD
	bool "POSIX FIFO file descriptor routines"
	depends on POSIX_FIFO
	help
	  Select 'y' here and Zephyr will provide implementations of the
	  POSIX_FIFO_FD Option Group: mkfifoat() and mknodat(); the latter
	  makes FIFOs and regular files, since no device special file exists
	  to create.
```

## lib/posix/file_attributes/Kconfig
```kconfig
# SPDX-FileCopyrightText: Copyright The Zephyr Project Contributors
# SPDX-License-Identifier: Apache-2.0

config POSIX_FILE_ATTRIBUTES
	bool "POSIX file ownership and permissions"
	depends on POSIX_FILE_SYSTEM
	help
	  Select 'y' here and Zephyr will provide implementations of the
	  POSIX_FILE_ATTRIBUTES Option Group: chmod(), chown(), fchmod(),
	  fchown(), and umask(). Modes and owners are stored by the file
	  system (tmpfs and ext2 record them); on one that records none the
	  calls fail with ENOTSUP and stat() reports a synthesised mode.
```

## lib/posix/file_attributes_fd/Kconfig
```kconfig
# SPDX-FileCopyrightText: Copyright The Zephyr Project Contributors
# SPDX-License-Identifier: Apache-2.0

config POSIX_FILE_ATTRIBUTES_FD
	bool "POSIX file attributes file descriptor routines"
	depends on POSIX_FILE_ATTRIBUTES
	help
	  Select 'y' here and Zephyr will provide implementations of the
	  POSIX_FILE_ATTRIBUTES_FD Option Group: fchmodat() and fchownat().
	  Like chmod() and chown(), they validate their arguments against a
	  file system that keeps neither permissions nor ownership.
```

## lib/posix/file_system_ext/Kconfig
```kconfig
# SPDX-FileCopyrightText: Copyright The Zephyr Project Contributors
# SPDX-License-Identifier: Apache-2.0

config POSIX_FILE_SYSTEM_EXT
	bool "POSIX file system extension routines"
	depends on POSIX_FILE_SYSTEM
	help
	  Select 'y' here and Zephyr will provide implementations of the
	  POSIX_FILE_SYSTEM_EXT Option Group: alphasort(), dirfd(),
	  getdelim(), getline(), mkdtemp(), and scandir().
```

## lib/posix/file_system_fd/Kconfig
```kconfig
# SPDX-FileCopyrightText: Copyright The Zephyr Project Contributors
# SPDX-License-Identifier: Apache-2.0

config POSIX_FILE_SYSTEM_FD
	bool "POSIX file system file descriptor routines"
	depends on POSIX_FILE_SYSTEM
	help
	  Select 'y' here and Zephyr will provide implementations of the
	  POSIX_FILE_SYSTEM_FD Option Group: faccessat(), fdopendir(),
	  fstatat(), linkat(), mkdirat(), openat(), renameat(), unlinkat(),
	  and utimensat(). Relative paths resolve against a directory file
	  descriptor, or against the working directory with AT_FDCWD.
```

## lib/posix/file_system_glob/Kconfig
```kconfig
# SPDX-FileCopyrightText: Copyright The Zephyr Project Contributors
# SPDX-License-Identifier: Apache-2.0

config POSIX_FILE_SYSTEM_GLOB
	bool "POSIX pathname pattern matching"
	depends on POSIX_FILE_SYSTEM
	select POSIX_C_LIB_EXT
	help
	  Select 'y' here and Zephyr will provide implementations of the
	  POSIX_FILE_SYSTEM_GLOB Option Group: glob() and globfree().
	  Pattern matching within a path segment uses fnmatch() from
	  POSIX_C_LIB_EXT.
```

## lib/posix/file_system_r/Kconfig
```kconfig
# SPDX-FileCopyrightText: Copyright The Zephyr Project Contributors
# SPDX-License-Identifier: Apache-2.0

config POSIX_FILE_SYSTEM_R
	bool "Thread-Safe File System"
	select FILE_SYSTEM
	select ZVFS
	select ZVFS_FDTABLE
	select ZVFS_FS
	help
	  Select 'y' here and Zephyr will provide an implementation of the POSIX_FILE_SYSTEM_R
	  Option Group, consisting of readdir_r().
```

## lib/posix/job_control/Kconfig
```kconfig
# SPDX-FileCopyrightText: Copyright The Zephyr Project Contributors
# SPDX-License-Identifier: Apache-2.0

config POSIX_JOB_CONTROL
	bool "POSIX job control"
	depends on POSIX_MULTI_PROCESS && POSIX_SIGNALS
	select PROCESS_STOP
	help
	  Select 'y' here and Zephyr will provide implementations of the
	  POSIX_JOB_CONTROL Option Group: tcgetpgrp(), tcsetpgrp(), and
	  tcgetsid() over the console terminal, together with the kernel's
	  stop and continue semantics: the stop signals suspend a process,
	  SIGCONT resumes it, and waitpid() reports the transitions via
	  WUNTRACED and WCONTINUED.
```

## lib/posix/memlock/Kconfig
```kconfig
# SPDX-FileCopyrightText: Copyright The Zephyr Project Contributors
# SPDX-License-Identifier: Apache-2.0

config POSIX_MEMLOCK
	bool "POSIX memory locking"
	depends on POSIX_MAPPED_FILES
	select ZVFS_MLOCK
	imply DEMAND_PAGING
	help
	  Select 'y' here and Zephyr will provide support for mlockall() and munlockall().

	  Note: Locking keeps pages resident under DEMAND_PAGING. Without it every page is
	  resident already and the functions succeed without effect.
```

## lib/posix/memory_protection/Kconfig
```kconfig
# SPDX-FileCopyrightText: Copyright The Zephyr Project Contributors
# SPDX-License-Identifier: Apache-2.0

config POSIX_MEMORY_PROTECTION
	bool "POSIX memory protection"
	select ZVFS
	select ZVFS_FDTABLE
	select ZVFS_MMAP
	help
	  Select 'y' here and Zephyr will provide support for mprotect().
```

## lib/posix/message_passing/Kconfig
```kconfig
# SPDX-FileCopyrightText: Copyright The Zephyr Project Contributors
# SPDX-License-Identifier: Apache-2.0

menuconfig POSIX_MESSAGE_PASSING
	bool "POSIX message queue support"
	select SYS_MSGQ
	help
	  This enabled POSIX message queue related APIs.

if POSIX_MESSAGE_PASSING

config POSIX_MQ_OPEN_MAX
	def_int SYS_MSGQ_MAX
	help
	  Maximum number of message queues that may be open at once. Derived
	  from the bound on the system message queue pool.

config POSIX_MQ_PRIO_MAX
	int "Maximum number of POSIX message priorities"
	default 32
	help
	  Maximum number of message priorities supported by the implementation.
	  Message priorities range from 0 to POSIX_MQ_PRIO_MAX - 1.

config MSG_SIZE_MAX
	def_int SYS_MSGQ_BUF_SIZE
	help
	  Maximum size of a POSIX message in bytes. Derived from the per-queue
	  message storage budget.

config MQUEUE_NAMELEN_MAX
	def_int SYS_MSGQ_NAMELEN_MAX
	help
	  Maximum POSIX message queue name length, in characters. Derived from
	  the system message queue name bound.

config SIGNAL_SET_SIZE_MIN_POSIX_MESSAGE_PASSING
	int
	depends on SIGNAL
	default 43
	help
	  mq_notify() with SIGEV_SIGNAL accepts any POSIX signal number
	  (SIGRTMAX = 33 + 8 by default), and the kernel message queue
	  dispatcher (SIGEV_THREAD) wakes on the reserved second-highest
	  slot, K_SIG_SYS_MSGQ, below the timer dispatcher's top-of-set
	  K_SIG_SYS_TIMER - so the set must extend two past SIGRTMAX for
	  neither to be POSIX-reachable.

config SIGNAL_QUEUE_SIZE_ADD_POSIX_MESSAGE_PASSING
	int
	depends on SIGNAL
	default 4
	help
	  Queued signal instances contributed by message arrival notifications.

config SYS_MSGQ_MIN_ADD_POSIX_MESSAGE_PASSING
	int
	default 0
	help
	  Contribution of the POSIX message passing option group to the
	  accumulated minimum (guaranteed, statically allocated) size of the
	  system message queue pool. Applications that require guaranteed
	  message queues should raise this.

config HEAP_MEM_POOL_ADD_SIZE_MQUEUE
	def_int 1024
	help
	  Message queues beyond the guaranteed (statically allocated) minimum
	  of the system message queue pool, and their message storage, are
	  allocated from the kernel heap.

endif
```

## lib/posix/non_portable/Kconfig
```kconfig
# Copyright (c) 2025 Friedt Professional Engineering Services, Inc.
#
# SPDX-License-Identifier: Apache-2.0

menuconfig POSIX_NON_PORTABLE
	bool "POSIX non-portable extensions"
	depends on POSIX_THREADS
	# timed waits arm absolute deadlines as absolute 64-bit kernel timeouts
	select TIMEOUT_64BIT
	select THREAD_NAME
	imply SCHED_CPU_MASK
	help
	  Select 'y' here to enable POSIX non-portable (_np) pthread extensions:
	  pthread_getaffinity_np(), pthread_getname_np(), pthread_setaffinity_np(),
	  pthread_setname_np(), pthread_timedjoin_np(), and pthread_tryjoin_np().

	  pthread_setaffinity_np() can only restrict a thread to a subset of the
	  CPUs with SCHED_CPU_MASK, which this option implies where the scheduler
	  supports it.

if POSIX_NON_PORTABLE

module = POSIX_NON_PORTABLE
module-str = POSIX non-portable pthread extensions
source "subsys/logging/Kconfig.template.log_config"

endif # POSIX_NON_PORTABLE
```

## lib/posix/options/Kconfig.xsi_realtime
```kconfig
# Copyright (c) 2024 Tenstorrent AI ULC
#
# SPDX-License-Identifier: Apache-2.0

config XSI_REALTIME
	bool "X/Open realtime"
	imply POSIX_FSYNC
	imply POSIX_MEMLOCK
	imply POSIX_MEMLOCK_RANGE
	imply POSIX_MESSAGE_PASSING
	# Not yet implemented, but optional
	# imply POSIX_PRIORITIZED_IO
	imply POSIX_PRIORITY_SCHEDULING
	imply POSIX_SHARED_MEMORY_OBJECTS
	imply POSIX_SYNCHRONIZED_IO
	help
	  Select 'y' here and the following functions will be provided:

	  fsync(), mlockall(), munlockall(), mlock(), munlock(), mq_close(), mq_getattr(), mq_notify(),
	  mq_open(), mq_receive(), mq_send(), mq_setattr(), mq_unlink(), sched_get_priority_max(),
	  sched_get_priority_min(), sched_getparam(), sched_getscheduler(), sched_rr_get_interval(),
	  sched_setparam(), sched_setscheduler(), sched_yield(), mmap(), munmap(), shm_open(),
	  shm_unlink()

	  The functions fsync(), fdatasync(), and open() will provide synchronized I/O capability.

	  For more information, please see
	  https://pubs.opengroup.org/onlinepubs/9699919799/basedefs/V1_chap02.html
```
