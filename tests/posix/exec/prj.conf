## CMakeLists.txt
```
# SPDX-License-Identifier: Apache-2.0

cmake_minimum_required(VERSION 3.20.0)
find_package(Zephyr REQUIRED HINTS $ENV{ZEPHYR_BASE})
project(posix_exec)

FILE(GLOB app_sources src/main.c)
target_sources(app PRIVATE ${app_sources})

target_compile_options(app PRIVATE -U_POSIX_C_SOURCE -D_POSIX_C_SOURCE=200809L)

# the executable image under test: a real ELF extension
add_llext_target(hello_ext
  OUTPUT  ${PROJECT_BINARY_DIR}/llext/hello.llext
  SOURCES ${PROJECT_SOURCE_DIR}/src/hello_ext.c
)
generate_inc_file_for_target(app ${PROJECT_BINARY_DIR}/llext/hello.llext
  ${ZEPHYR_BINARY_DIR}/include/generated/hello_ext.inc
)
```

## prj.conf
```kconfig
CONFIG_ZTEST=y

CONFIG_POSIX_AEP_CHOICE_BASE=y
CONFIG_POSIX_MULTI_PROCESS=y
CONFIG_POSIX_DEVICE_IO=y
# the PATH search sections change the working directory
CONFIG_POSIX_FILE_SYSTEM=y
CONFIG_POSIX_EXEC_LLEXT=y
# small enough for the table-full and stale-slot-sweep sections to fill
CONFIG_POSIX_EXEC_LLEXT_MAX=2

CONFIG_LLEXT=y
CONFIG_LLEXT_HEAP_SIZE=16

CONFIG_FILE_SYSTEM=y
CONFIG_FAT_FILESYSTEM_ELM=y
CONFIG_FS_FATFS_LFN=y

CONFIG_SYS_PROCESS_MAX=4
CONFIG_HEAP_MEM_POOL_SIZE=32768
CONFIG_MAIN_STACK_SIZE=4096
CONFIG_ZTEST_STACK_SIZE=4096
CONFIG_COMMON_LIBC_MALLOC_ARENA_SIZE=16384

# base scenarios execute-from-RAM without an MPU; the .mpu scenario turns it
# back on together with CONFIG_USERSPACE (unknown-symbol =n is a no-op)
CONFIG_ARM_MPU=n
```

## src/main.c
```c
/*
 * SPDX-FileCopyrightText: Copyright The Zephyr Project Contributors
 *
 * SPDX-License-Identifier: Apache-2.0
 */

#include <errno.h>
#include <fcntl.h>
#include <signal.h>
#include <stdlib.h>
#include <string.h>
#include <sys/wait.h>
#include <unistd.h>

#include <ff.h>
#include <zephyr/fs/fs.h>
#include <zephyr/kernel.h>
#include <zephyr/llext/llext.h>
#include <zephyr/llext/symbol.h>
#include <zephyr/sys/process.h>
#include <zephyr/ztest.h>

/* resolve the image's _exit() and execve() references at llext link time */
EXPORT_SYMBOL(_exit);
EXPORT_SYMBOL(execve);

#define EXEC_IMAGE "/RAM:/hello.llext"
#define EXEC_CHAIN_IMAGE "/RAM:/hello2.llext"
#define EXEC_NOEXEC_IMAGE "/RAM:/noexec.llext"
/* a directory beside the image, and a search path reaching the image behind it; PATH is
 * colon-separated, so the FAT mount's name is reached through the working directory
 */
#define EXEC_DIR "/RAM:/wd"
#define EXEC_PATH "wd:."

static const uint8_t hello_llext[] = {
#include "hello_ext.inc"
};

static const uint8_t noexec_llext[] = {
#include "noexec_ext.inc"
};

static FATFS fat_fs;
static struct fs_mount_t fs_mnt = {
	.type = FS_FATFS,
	.mnt_point = "/RAM:",
	.fs_data = &fat_fs,
};

/* execve() loads the extension on the caller's stack; 64-bit frames need room */
#define EXEC_CHILD_STACK_SIZE (IS_ENABLED(CONFIG_64BIT) ? 4096 : 3072)

static K_THREAD_STACK_DEFINE(exec_child_stack, EXEC_CHILD_STACK_SIZE);
static struct k_thread exec_child_thread;

/* enough children to occupy every image slot at once */
static K_THREAD_STACK_ARRAY_DEFINE(exec_extra_stacks, CONFIG_POSIX_EXEC_LLEXT_MAX,
				   EXEC_CHILD_STACK_SIZE);
static struct k_thread exec_extra_threads[CONFIG_POSIX_EXEC_LLEXT_MAX];

static char *const exec_argv[] = {"hello", "x", NULL};
static char *const exec_exit_argv[] = {"hello", "e", NULL};
static char *const exec_chain_argv[] = {"hello", "c", NULL};

static void exec_child_entry(void *p1, void *p2, void *p3)
{
	ARG_UNUSED(p2);
	ARG_UNUSED(p3);

	(void)execve(EXEC_IMAGE, p1, NULL);
	_exit(99);
}

/* the same name found along PATH, through each exec entry point */
static void execvp_child_entry(void *p1, void *p2, void *p3)
{
	ARG_UNUSED(p2);
	ARG_UNUSED(p3);

	/* a child's working directory and environment are its own */
	if ((chdir("/RAM:") != 0) || (setenv("PATH", EXEC_PATH, 1) != 0)) {
		_exit(127);
	}
	(void)execvp("hello.llext", p1);
	_exit(128 + (errno & 0x7f));
}

static void execlp_child_entry(void *p1, void *p2, void *p3)
{
	ARG_UNUSED(p1);
	ARG_UNUSED(p2);
	ARG_UNUSED(p3);

	/* a child's working directory and environment are its own */
	if ((chdir("/RAM:") != 0) || (setenv("PATH", EXEC_PATH, 1) != 0)) {
		_exit(127);
	}
	(void)execlp("hello.llext", "hello", "x", NULL);
	_exit(128 + (errno & 0x7f));
}

static pid_t exec_spawn_with(k_thread_entry_t entry, char *const argv[])
{
	k_pid_t child = NULL;
	struct sys_clone_args args = {
		.entry = entry,
		.p1 = (void *)argv,
		.thread = &exec_child_thread,
		.stack = exec_child_stack,
		.stack_size = EXEC_CHILD_STACK_SIZE,
		.prio = k_thread_priority_get(k_current_get()),
	};

	zassert_ok(sys_clone(&args, &child));

	return (pid_t)sys_process_id(child);
}

static pid_t exec_spawn(char *const argv[])
{
	return exec_spawn_with(exec_child_entry, argv);
}

/* a bare name is searched along PATH for an executable regular file */
static void exec_path_search(k_thread_entry_t entry, int (*exec_name)(const char *name))
{
	int status = -1;
	pid_t pid;

	zassert_ok(chdir("/RAM:"));
	zassert_ok(setenv("PATH", EXEC_PATH, 1));
	pid = exec_spawn_with(entry, exec_argv);
	zassert_true(pid > 0);
	zassert_equal(waitpid(pid, &status, 0), pid);
	zassert_true(WIFEXITED(status));
	zassert_equal(WEXITSTATUS(status), 42, "image found along PATH did not run: %d",
		      WEXITSTATUS(status));
	zassert_is_null(llext_by_name("hello.llext"), "image not unloaded after a normal return");

	/* nothing of that name along the path */
	errno = 0;
	zassert_equal(exec_name("nope.llext"), -1);
	zassert_equal(errno, ENOENT);
	/* a directory of that name is not an executable file */
	errno = 0;
	zassert_equal(exec_name("wd"), -1);
	zassert_equal(errno, EACCES);
	/* with a slash the name is taken as given */
	errno = 0;
	zassert_equal(exec_name("/RAM:/nope.llext"), -1);
	zassert_equal(errno, ENOENT);
	/* without PATH the default search path applies, and the image is not there */
	zassert_ok(unsetenv("PATH"));
	errno = 0;
	zassert_equal(exec_name("hello.llext"), -1);
	zassert_equal(errno, ENOENT);
	zassert_ok(chdir("/"));
}

static int execvp_name(const char *name)
{
	char *const argv[] = {"nope", NULL};

	return execvp(name, argv);
}

static int execlp_name(const char *name)
{
	return execlp(name, "nope", NULL);
}

static void execve_return_status(void)
{
	int status = -1;
	pid_t pid = exec_spawn(exec_argv);

	/* a child execs a real ELF extension: same pid, freshly loaded image */
	zassert_true(pid > 0);
	zassert_equal(waitpid(pid, &status, 0), pid);
	zassert_true(WIFEXITED(status));
	zassert_equal(WEXITSTATUS(status), 42, "extension main() did not run: %d",
		      WEXITSTATUS(status));
	zassert_is_null(llext_by_name("hello.llext"), "image not unloaded after a normal return");
}

static void execve_exit_reaps_image(void)
{
	int status = -1;
	pid_t pid = exec_spawn(exec_exit_argv);

	/* an image dying via _exit() cannot unload itself; the reaper must */
	zassert_true(pid > 0);
	zassert_equal(waitpid(pid, &status, 0), pid);
	zassert_true(WIFEXITED(status));
	zassert_equal(WEXITSTATUS(status), 43, "extension _exit status lost: %d",
		      WEXITSTATUS(status));
	zassert_is_null(llext_by_name("hello.llext"), "image leaked after _exit()");
}

/* a chain-exec'ing image is unloaded by its successor past the point of no return */
static void execve_chain_unloads_prior(void)
{
	int status = -1;
	pid_t pid = exec_spawn(exec_chain_argv);

	zassert_true(pid > 0);
	zassert_equal(waitpid(pid, &status, 0), pid);
	zassert_true(WIFEXITED(status));
	zassert_equal(WEXITSTATUS(status), 43, "chain-exec'd image did not run: %d",
		      WEXITSTATUS(status));
	zassert_is_null(llext_by_name("hello.llext"), "chain-exec leaked the prior image");
	zassert_is_null(llext_by_name("hello2.llext"), "successor image not unloaded by reap");
}

/* failed resolution and loading report errors without disturbing the caller */
static void execve_load_errors(void)
{
	char *const argv[] = {"nope", NULL};

	/* nothing prelinked or on the file system by that name */
	errno = 0;
	zassert_equal(execve("/RAM:/nope.llext", argv, NULL), -1);
	zassert_equal(errno, ENOENT);

	/* a loadable object that exports no main() is not an executable image */
	errno = 0;
	zassert_equal(execve(EXEC_NOEXEC_IMAGE, argv, NULL), -1);
	zassert_equal(errno, ENOEXEC);
	zassert_is_null(llext_by_name("noexec.llext"), "refused image left loaded");
}

/* combined argument strings past the exec budget fail after the load */
static void execve_args_too_big(void)
{
	static char big[CONFIG_POSIX_EXEC_ARG_BYTES + 1];
	char *const argv[] = {"hello", big, NULL};

	memset(big, 'a', sizeof(big) - 1);

	errno = 0;
	zassert_equal(execve(EXEC_IMAGE, argv, NULL), -1);
	zassert_equal(errno, E2BIG);
	zassert_is_null(llext_by_name("hello.llext"), "refused image left loaded");
}

/* zombies not yet waited for hold their image slots; a full table is ENOMEM */
static void execve_table_enomem(void)
{
	int status = -1;
	siginfo_t info;
	pid_t pids[CONFIG_POSIX_EXEC_LLEXT_MAX];

	for (size_t i = 0; i < ARRAY_SIZE(pids); i++) {
		k_pid_t child = NULL;
		struct sys_clone_args args = {
			.entry = exec_child_entry,
			.p1 = (void *)exec_exit_argv,
			.thread = &exec_extra_threads[i],
			.stack = exec_extra_stacks[i],
			.stack_size = EXEC_CHILD_STACK_SIZE,
			.prio = k_thread_priority_get(k_current_get()),
		};

		zassert_ok(sys_clone(&args, &child));
		pids[i] = (pid_t)sys_process_id(child);
		/* observe the death without reaping: the zombie keeps its slot */
		zassert_ok(waitid(P_PID, (id_t)pids[i], &info, WEXITED | WNOWAIT));
	}

	errno = 0;
	zassert_equal(execve(EXEC_IMAGE, exec_argv, NULL), -1);
	zassert_equal(errno, ENOMEM);

	/* reaping the zombies unloads their images */
	for (size_t i = 0; i < ARRAY_SIZE(pids); i++) {
		zassert_equal(waitpid(pids[i], &status, 0), pids[i]);
		zassert_true(WIFEXITED(status));
		zassert_equal(WEXITSTATUS(status), 43);
	}
	zassert_is_null(llext_by_name("hello.llext"), "zombie images leaked after reap");
}

struct exec_orphan_args {
	struct k_thread *thread;
	k_thread_stack_t *stack;
};

static void exec_orphan_mid_entry(void *p1, void *p2, void *p3)
{
	struct exec_orphan_args *oa = p1;
	siginfo_t info;
	k_pid_t grand = NULL;
	struct sys_clone_args args = {
		.entry = exec_child_entry,
		.p1 = (void *)exec_exit_argv,
		.thread = oa->thread,
		.stack = oa->stack,
		.stack_size = EXEC_CHILD_STACK_SIZE,
		.prio = k_thread_priority_get(k_current_get()),
	};

	ARG_UNUSED(p2);
	ARG_UNUSED(p3);

	if (sys_clone(&args, &grand) != 0) {
		_exit(98);
	}
	/* observe the grandchild's death without reaping it */
	if (waitid(P_PID, (id_t)sys_process_id(grand), &info, WEXITED | WNOWAIT) != 0) {
		_exit(97);
	}
	/* dying with an unreaped child: init auto-reaps the orphaned zombie,
	 * retiring its pid while its image slot is still registered
	 */
	_exit(0);
}

/* a table full of slots whose pids retired without a waitpid() is swept */
static void execve_sweep_stale_slots(void)
{
	int status = -1;
	pid_t pid;

	for (size_t i = 0; i < CONFIG_POSIX_EXEC_LLEXT_MAX; i++) {
		struct exec_orphan_args oa = {
			.thread = &exec_extra_threads[i],
			.stack = exec_extra_stacks[i],
		};
		k_pid_t mid = NULL;
		struct sys_clone_args args = {
			.entry = exec_orphan_mid_entry,
			.p1 = &oa,
			.thread = &exec_child_thread,
			.stack = exec_child_stack,
			.stack_size = EXEC_CHILD_STACK_SIZE,
			.prio = k_thread_priority_get(k_current_get()),
		};

		zassert_ok(sys_clone(&args, &mid));
		pid = (pid_t)sys_process_id(mid);
		zassert_true(pid > 0);
		zassert_equal(waitpid(pid, &status, 0), pid);
		zassert_true(WIFEXITED(status));
		zassert_equal(WEXITSTATUS(status), 0, "orphan setup failed: %d",
			      WEXITSTATUS(status));
	}

	/* every slot is stale: the next exec sweeps them and still succeeds */
	pid = exec_spawn(exec_argv);
	zassert_true(pid > 0);
	zassert_equal(waitpid(pid, &status, 0), pid);
	zassert_true(WIFEXITED(status));
	zassert_equal(WEXITSTATUS(status), 42);
	zassert_is_null(llext_by_name("hello.llext"), "stale slots not swept");
}

ZTEST(posix_exec, test_execve)
{
	execve_return_status();
	execve_exit_reaps_image();
	execve_chain_unloads_prior();
	execve_load_errors();
	execve_args_too_big();
	execve_table_enomem();
	execve_sweep_stale_slots();
}

ZTEST(posix_exec, test_execvp)
{
	exec_path_search(execvp_child_entry, execvp_name);
}

ZTEST(posix_exec, test_execlp)
{
	exec_path_search(execlp_child_entry, execlp_name);
}

static void exec_setup_write(const char *path, const uint8_t *blob, size_t len)
{
	int fd;
	int ret;

	fd = open(path, O_RDWR | O_CREAT, 0644);
	zassert_true(fd >= 0, "open %s failed: %d", path, errno);
	ret = write(fd, blob, len);
	zassert_equal(ret, (int)len);
	zassert_ok(close(fd));
}

static void *exec_setup(void)
{
	zassert_ok(fs_mount(&fs_mnt));
	exec_setup_write(EXEC_IMAGE, hello_llext, sizeof(hello_llext));
	/* the same image under a second name, for the chain-exec round trip */
	exec_setup_write(EXEC_CHAIN_IMAGE, hello_llext, sizeof(hello_llext));
	exec_setup_write(EXEC_NOEXEC_IMAGE, noexec_llext, sizeof(noexec_llext));
	zassert_ok(fs_mkdir(EXEC_DIR));

	return NULL;
}

ZTEST_SUITE(posix_exec, NULL, exec_setup, NULL, NULL, NULL);
```

## src/hello_ext.c
```c
/*
 * SPDX-FileCopyrightText: Copyright The Zephyr Project Contributors
 *
 * SPDX-License-Identifier: Apache-2.0
 */

#include <unistd.h>

#include <zephyr/llext/symbol.h>

/*
 * The executable-image ABI: an exec'd extension exports main(), and its
 * return value becomes the process's exit status.
 */
int main(int argc, char **argv, char **envp)
{
	(void)envp;

	if ((argc == 2) && (argv[1][0] == 'x')) {
		return 42;
	}
	if ((argc == 2) && (argv[1][0] == 'e')) {
		/* die without returning: the reaper must unload the image */
		_exit(43);
	}

	return 1;
}
LL_EXTENSION_SYMBOL(main);
```

## src/noexec_ext.c
```c
/*
 * SPDX-FileCopyrightText: Copyright The Zephyr Project Contributors
 *
 * SPDX-License-Identifier: Apache-2.0
 */

#include <zephyr/llext/symbol.h>

/* a loadable object that is not an executable image: it exports no main() */
int not_main(void)
{
	return 0;
}
LL_EXTENSION_SYMBOL(not_main);
```
