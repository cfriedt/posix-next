## tests/posix/user_groups_r/testcase.yaml
```yaml
common:
  tags:
    - posix_user_groups_r
  # 1 tier0 platform per supported architecture
  platform_key:
    - arch
    - simulation
tests:
  portability.posix.user_groups_r:
    filter: not CONFIG_NATIVE_LIBC
  portability.posix.user_groups_r.userspace:
    filter: (not CONFIG_NATIVE_LIBC) and CONFIG_ARCH_HAS_USERSPACE
    tags: userspace
    extra_configs:
      - CONFIG_TEST_USERSPACE=y
      - CONFIG_USERSPACE=y
  portability.posix.user_groups_r.minimal:
    filter: not CONFIG_NATIVE_LIBC
    extra_configs:
      - CONFIG_MINIMAL_LIBC=y
  portability.posix.user_groups_r.newlib:
    filter: (not CONFIG_NATIVE_LIBC) and (TOOLCHAIN_HAS_NEWLIB == 1)
    extra_configs:
      - CONFIG_NEWLIB_LIBC=y
  portability.posix.user_groups_r.picolibc:
    tags: picolibc
    filter: (not CONFIG_NATIVE_LIBC) and CONFIG_PICOLIBC_SUPPORTED
    extra_configs:
      - CONFIG_PICOLIBC=y
  portability.posix.user_groups_r.tls:
    filter: (not CONFIG_NATIVE_LIBC) and CONFIG_ARCH_HAS_THREAD_LOCAL_STORAGE and
      CONFIG_TOOLCHAIN_SUPPORTS_THREAD_LOCAL_STORAGE
    extra_configs:
      - CONFIG_NEWLIB_LIBC=n
      - CONFIG_THREAD_LOCAL_STORAGE=y
  portability.posix.user_groups_r.tls.newlib:
    filter: (not CONFIG_NATIVE_LIBC) and (TOOLCHAIN_HAS_NEWLIB == 1) and
      CONFIG_ARCH_HAS_THREAD_LOCAL_STORAGE and CONFIG_TOOLCHAIN_SUPPORTS_THREAD_LOCAL_STORAGE
    extra_configs:
      - CONFIG_NEWLIB_LIBC=y
      - CONFIG_THREAD_LOCAL_STORAGE=y
  portability.posix.user_groups_r.linux_compat:
    tags: native
    platform_allow:
      - native_sim
      - native_sim/native/64
    filter: CONFIG_NATIVE_LIBC
    extra_configs:
      - CONFIG_POSIX_TEST_LINUX_COMPAT=y
      - CONFIG_ZVFS_OPEN_MAX=7
```

## tests/posix/wide_char_device_io/testcase.yaml
```yaml
common:
  tags:
    - fatfs
    - posix_wide_char_device_io
  min_ram: 128
  modules:
    - fatfs
  # 1 tier0 platform per supported architecture
  platform_key:
    - arch
    - simulation
tests:
  portability.posix.wide_char_device_io.newlib:
    filter: (not CONFIG_NATIVE_LIBC) and (TOOLCHAIN_HAS_NEWLIB == 1)
    extra_configs:
      - CONFIG_NEWLIB_LIBC=y
  portability.posix.wide_char_device_io.picolibc:
    tags: picolibc
    filter: (not CONFIG_NATIVE_LIBC) and CONFIG_PICOLIBC_SUPPORTED
    extra_configs:
      - CONFIG_PICOLIBC=y
  portability.posix.wide_char_device_io.picolibc.userspace:
    tags:
      - picolibc
      - userspace
    filter: (not CONFIG_NATIVE_LIBC) and CONFIG_PICOLIBC_SUPPORTED and CONFIG_ARCH_HAS_USERSPACE
    extra_configs:
      - CONFIG_PICOLIBC=y
      - CONFIG_TEST_USERSPACE=y
      - CONFIG_USERSPACE=y
      # 8-region MPU: stack guard + thread stack leave only 3 domain slots,
      # one short for zvfs_dir_partition on top of libc/malloc/ztest
      - platform:mps2/an385:CONFIG_TEST_USERSPACE_WITHOUT_HW_STACK_PROTECTION=y
  portability.posix.wide_char_device_io.tls.newlib:
    filter: (not CONFIG_NATIVE_LIBC) and (TOOLCHAIN_HAS_NEWLIB == 1) and
      CONFIG_ARCH_HAS_THREAD_LOCAL_STORAGE and CONFIG_TOOLCHAIN_SUPPORTS_THREAD_LOCAL_STORAGE
    extra_configs:
      - CONFIG_NEWLIB_LIBC=y
      - CONFIG_THREAD_LOCAL_STORAGE=y
  portability.posix.wide_char_device_io.linux_compat:
    tags: native
    platform_allow:
      - native_sim
      - native_sim/native/64
    filter: CONFIG_NATIVE_LIBC
    extra_configs:
      - CONFIG_POSIX_TEST_LINUX_COMPAT=y
      - CONFIG_ZVFS_OPEN_MAX=12
```

## tests/posix/xsi_realtime/testcase.yaml
```yaml
common:
  tags:
    - xsi_realtime
  # 1 tier0 platform per supported architecture
  platform_key:
    - arch
    - simulation
  min_flash: 64
  min_ram: 96
  platform_exclude:
    # linker_zephyr_pre0.cmd:140: syntax error (??)
    - qemu_xtensa/dc233c
tests:
  portability.posix.xsi_realtime:
    integration_platforms:
      - qemu_x86
      - qemu_cortex_a53
      - qemu_riscv64
    filter: not CONFIG_NATIVE_LIBC
  portability.posix.xsi_realtime.minimal:
    integration_platforms:
      - qemu_x86
      - qemu_cortex_a53
      - qemu_riscv64
    filter: not CONFIG_NATIVE_LIBC
    extra_configs:
      - CONFIG_MINIMAL_LIBC=y
  portability.posix.xsi_realtime.newlib:
    integration_platforms:
      - qemu_x86
      - qemu_cortex_a53
      - qemu_riscv64
    filter: (not CONFIG_NATIVE_LIBC) and (TOOLCHAIN_HAS_NEWLIB == 1)
    extra_configs:
      - CONFIG_NEWLIB_LIBC=y
  portability.posix.xsi_realtime.picolibc:
    integration_platforms:
      - qemu_x86
      - qemu_cortex_a53
      - qemu_riscv64
    tags: picolibc
    filter: (not CONFIG_NATIVE_LIBC) and CONFIG_PICOLIBC_SUPPORTED
    extra_configs:
      - CONFIG_PICOLIBC=y
  portability.posix.xsi_realtime.linux_compat:
    tags: native
    platform_allow:
      - native_sim
      - native_sim/native/64
    integration_platforms:
      - native_sim
    filter: CONFIG_NATIVE_LIBC
    extra_configs:
      - CONFIG_POSIX_TEST_LINUX_COMPAT=y
```

## tests/posix/xsi_signals/testcase.yaml
```yaml
common:
  tags:
    - xsi_signals
  # 1 tier0 platform per supported architecture
  platform_key:
    - arch
    - simulation
  min_flash: 64
  min_ram: 32
tests:
  portability.posix.xsi_signals:
    filter: not CONFIG_NATIVE_LIBC
  portability.posix.xsi_signals.userspace:
    filter: (not CONFIG_NATIVE_LIBC) and CONFIG_ARCH_SUPPORTS_USERSPACE_SIGNALS
    tags: userspace
    extra_configs:
      - CONFIG_TEST_USERSPACE=y
      - CONFIG_USERSPACE=y
      # sigaction() requests delivery on the alternate stack
      - CONFIG_POSIX_SIGNALS=y
  portability.posix.xsi_signals.minimal:
    filter: not CONFIG_NATIVE_LIBC
    extra_configs:
      - CONFIG_MINIMAL_LIBC=y
  portability.posix.xsi_signals.newlib:
    filter: (not CONFIG_NATIVE_LIBC) and (TOOLCHAIN_HAS_NEWLIB == 1)
    extra_configs:
      - CONFIG_NEWLIB_LIBC=y
  portability.posix.xsi_signals.picolibc:
    tags: picolibc
    filter: (not CONFIG_NATIVE_LIBC) and CONFIG_PICOLIBC_SUPPORTED
    extra_configs:
      - CONFIG_PICOLIBC=y
```

## tests/posix/xsi_single_process/testcase.yaml
```yaml
common:
  tags:
    - xsi_single_process
  # 1 tier0 platform per supported architecture
  platform_key:
    - arch
    - simulation
  min_ram: 16
tests:
  portability.posix.xsi_single_process:
    filter: not CONFIG_NATIVE_LIBC
    extra_configs:
      - CONFIG_COMMON_LIBC_MALLOC_ARENA_SIZE=256
  portability.posix.xsi_single_process.armclang_std_libc:
    toolchain_allow: armclang
    extra_configs:
      - CONFIG_ARMCLANG_STD_LIBC=y
  portability.posix.xsi_single_process.arcmwdtlib:
    toolchain_allow: arcmwdt
    extra_configs:
      - CONFIG_ARCMWDT_LIBC=y
  portability.posix.xsi_single_process.minimal:
    filter: not CONFIG_NATIVE_LIBC
    extra_configs:
      - CONFIG_MINIMAL_LIBC=y
      - CONFIG_COMMON_LIBC_MALLOC_ARENA_SIZE=256
  portability.posix.xsi_single_process.newlib:
    filter: (not CONFIG_NATIVE_LIBC) and (TOOLCHAIN_HAS_NEWLIB == 1)
    extra_configs:
      - CONFIG_NEWLIB_LIBC=y
      - CONFIG_NEWLIB_LIBC_MIN_REQUIRED_HEAP_SIZE=256
  portability.posix.xsi_single_process.picolibc:
    tags: picolibc
    filter: (not CONFIG_NATIVE_LIBC) and CONFIG_PICOLIBC_SUPPORTED
    extra_configs:
      - CONFIG_PICOLIBC=y
  portability.posix.xsi_single_process.linux_compat:
    tags: native
    platform_allow:
      - native_sim
      - native_sim/native/64
    filter: CONFIG_NATIVE_LIBC
    extra_configs:
      - CONFIG_POSIX_TEST_LINUX_COMPAT=y
      - CONFIG_COMMON_LIBC_MALLOC_ARENA_SIZE=256
```

## tests/posix/xsi_streams/testcase.yaml
```yaml
common:
  filter: not CONFIG_NATIVE_LIBC
  tags:
    - xsi_streams
  # 1 tier0 platform per supported architecture
  platform_key:
    - arch
    - simulation
  integration_platforms:
    - qemu_riscv64
  min_flash: 64
  min_ram: 32
tests:
  portability.posix.xsi_streams: {}
  portability.posix.xsi_streams.userspace:
    filter: (not CONFIG_NATIVE_LIBC) and CONFIG_ARCH_HAS_USERSPACE
    tags: userspace
    extra_configs:
      - CONFIG_TEST_USERSPACE=y
      - CONFIG_USERSPACE=y
  portability.posix.xsi_streams.minimal:
    extra_configs:
      - CONFIG_MINIMAL_LIBC=y
  portability.posix.xsi_streams.newlib:
    filter: TOOLCHAIN_HAS_NEWLIB == 1
    extra_configs:
      - CONFIG_NEWLIB_LIBC=y
  portability.posix.xsi_streams.picolibc:
    tags: picolibc
    filter: CONFIG_PICOLIBC_SUPPORTED
    extra_configs:
      - CONFIG_PICOLIBC=y
  # fails: the host libc has no <stropts.h> / STREAMS interfaces (removed in glibc 2.30)
  # portability.posix.xsi_streams.linux_compat:
  #   tags: native
  #   platform_allow:
  #     - native_sim
  #     - native_sim/native/64
  #   filter: CONFIG_NATIVE_LIBC
  #   extra_configs:
  #     - CONFIG_POSIX_TEST_LINUX_COMPAT=y
```

## tests/posix/xsi_system_logging/testcase.yaml
```yaml
common:
  tags:
    - xsi_system_logging
  # 1 tier0 platform per supported architecture
  platform_key:
    - arch
    - simulation
  min_flash: 64
  min_ram: 32
tests:
  portability.posix.xsi_system_logging:
    filter: not CONFIG_NATIVE_LIBC
  portability.posix.xsi_system_logging.minimal:
    filter: not CONFIG_NATIVE_LIBC
    extra_configs:
      - CONFIG_MINIMAL_LIBC=y
  portability.posix.xsi_system_logging.newlib:
    filter: (not CONFIG_NATIVE_LIBC) and (TOOLCHAIN_HAS_NEWLIB == 1)
    extra_configs:
      - CONFIG_NEWLIB_LIBC=y
  portability.posix.xsi_system_logging.picolibc:
    tags: picolibc
    filter: (not CONFIG_NATIVE_LIBC) and CONFIG_PICOLIBC_SUPPORTED
    extra_configs:
      - CONFIG_PICOLIBC=y
  portability.posix.xsi_system_logging.linux_compat:
    tags: native
    platform_allow:
      - native_sim
      - native_sim/native/64
    filter: CONFIG_NATIVE_LIBC
    extra_configs:
      - CONFIG_POSIX_TEST_LINUX_COMPAT=y
```

## west.yml
```yaml
# SPDX-License-Identifier: Apache-2.0

manifest:
  remotes:
    - name: zephyrproject-rtos
      url-base: https://github.com/zephyrproject-rtos

  # zephyr-keep-sorted-start re(^\s+\- name:)
  projects:
    - name: toybox
      url: https://github.com/cfriedt/toybox
      revision: 498db90f2513d17429536b82a53fd45b64935909
      path: modules/lib/toybox
    - name: zephyr
      remote: zephyrproject-rtos
      revision: v4.5.0
      import:
        name-allowlist:
          - cmsis_6
          - fatfs
          - hostap
          - littlefs
          - mbedtls
          - picolibc
          - tf-psa-crypto
          - zcbor
  # zephyr-keep-sorted-stop

  self:
    path: modules/lib/posix
```
