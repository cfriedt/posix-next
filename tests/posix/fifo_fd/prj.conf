## CMakeLists.txt
```
# SPDX-License-Identifier: Apache-2.0

cmake_minimum_required(VERSION 3.20.0)
find_package(Zephyr REQUIRED HINTS $ENV{ZEPHYR_BASE})
project(posix_fifo_fd)

FILE(GLOB app_sources src/*.c)
target_sources(app PRIVATE ${app_sources})

target_compile_options(app PRIVATE -U_POSIX_C_SOURCE -D_POSIX_C_SOURCE=200809L)
target_compile_options(app PRIVATE -U_XOPEN_SOURCE -D_XOPEN_SOURCE=700)
```

## prj.conf
```kconfig
CONFIG_ZTEST=y
CONFIG_POSIX_AEP_CHOICE_PSE52=y
CONFIG_POSIX_FILE_SYSTEM_FD=y
CONFIG_POSIX_FIFO=y
CONFIG_POSIX_FIFO_FD=y

# XSI provides the S_IF* constants and the XSI struct stat members
CONFIG_XSI=y

# FIFO nodes need ext2
CONFIG_FILE_SYSTEM=y
CONFIG_FILE_SYSTEM_EXT2=y
CONFIG_FILE_SYSTEM_MKFS=y
CONFIG_DISK_ACCESS=y
CONFIG_DISK_DRIVER_RAM=y
CONFIG_TEST_RANDOM_GENERATOR=y
CONFIG_EVENTFD=n

CONFIG_ZVFS_PIPE_MAX=2
CONFIG_ZVFS_FIFO_OPEN_MAX=4
CONFIG_ZVFS_OPEN_IGNORE_MIN=y
CONFIG_ZVFS_OPEN_MAX=12
CONFIG_ZVFS_DIR_MAX=4

CONFIG_MAIN_STACK_SIZE=4096
CONFIG_ZTEST_STACK_SIZE=4096
CONFIG_TEST_EXTRA_STACK_SIZE=4096
CONFIG_HEAP_MEM_POOL_SIZE=65536
CONFIG_COMMON_LIBC_MALLOC_ARENA_SIZE=16384
```

## src/main.c
```c
/*
 * SPDX-FileCopyrightText: Copyright The Zephyr Project Contributors
 * SPDX-License-Identifier: Apache-2.0
 */

#include "fifo_fd_tests.h"

#include <fcntl.h>
#include <sys/stat.h>
#include <unistd.h>

#include <zephyr/kernel.h>

#ifndef CONFIG_NATIVE_LIBC
#include <zephyr/fs/fs.h>

static struct fs_mount_t fs_mnt = {
	.type = FS_EXT2,
	.mnt_point = "/",
	.storage_dev = (void *)"RAM",
};
#endif

static void before(void *arg)
{
	int fd;

	ARG_UNUSED(arg);

	(void)unlink(TEST_FIFO);
	(void)unlink(TEST_FILE);
	(void)rmdir(TEST_ROOT);
	zassert_ok(mkdir(TEST_ROOT, 0777));
	fd = open(TEST_FILE, O_WRONLY | O_CREAT | O_TRUNC, 0600);
	zassert_true(fd >= 0);
	zassert_ok(close(fd));
}

static void *setup(void)
{
#ifndef CONFIG_NATIVE_LIBC
	zassert_ok(fs_mkfs(FS_EXT2, (uintptr_t)"RAM", NULL, 0));
	zassert_ok(fs_mount(&fs_mnt));
#endif
	(void)mkdir(FS_TMPDIR, 0777);

	return NULL;
}

static void teardown(void *arg)
{
	ARG_UNUSED(arg);

	(void)unlink(TEST_FIFO);
	(void)unlink(TEST_FILE);
	(void)rmdir(TEST_ROOT);
#ifndef CONFIG_NATIVE_LIBC
	(void)fs_unmount(&fs_mnt);
#endif
}

ZTEST_SUITE(posix_fifo_fd, NULL, setup, before, NULL, teardown);
```

## src/fifo_fd_tests.h
```c
/*
 * SPDX-FileCopyrightText: Copyright The Zephyr Project Contributors
 * SPDX-License-Identifier: Apache-2.0
 */

#ifndef POSIX_TESTS_FIFO_FD_TESTS_H_
#define POSIX_TESTS_FIFO_FD_TESTS_H_

#include <zephyr/ztest.h>

#include "../../shared/linux_compat_test.h"

#define FS_TMPDIR    "/tmp"
#define TEST_ROOT    FS_TMPDIR "/pfifofd"
#define TEST_FIFO    TEST_ROOT "/fifo"
#define TEST_FILE    TEST_ROOT "/file.txt"
#define TEST_NOENT   TEST_ROOT "/nope"

#endif /* POSIX_TESTS_FIFO_FD_TESTS_H_ */
```

## src/mkfifoat.c
```c
/*
 * SPDX-FileCopyrightText: Copyright The Zephyr Project Contributors
 * SPDX-License-Identifier: Apache-2.0
 */

#include "fifo_fd_tests.h"

#include <errno.h>
#include <fcntl.h>
#include <sys/stat.h>
#include <unistd.h>

ZTEST_USER(posix_fifo_fd, test_mkfifoat)
{
	int dirfd = open(TEST_ROOT, O_RDONLY | O_DIRECTORY);
	int fd = open(TEST_FILE, O_RDONLY);
	struct stat st;

	zassert_true(dirfd >= 0, "open(" TEST_ROOT ") failed: %d", errno);
	zassert_true(fd >= 0, "open(" TEST_FILE ") failed: %d", errno);

	zassert_ok(mkfifoat(dirfd, "fifo", 0644));
	zassert_ok(fstatat(dirfd, "fifo", &st, 0));
	zassert_true(S_ISFIFO(st.st_mode));
	errno = 0;
	zassert_equal(mkfifoat(AT_FDCWD, TEST_FIFO, 0644), -1);
	zassert_equal(errno, EEXIST);
	zassert_ok(unlinkat(dirfd, "fifo", 0));

	zassert_ok(mkfifoat(AT_FDCWD, TEST_FIFO, 0644));
	zassert_ok(stat(TEST_FIFO, &st));
	zassert_true(S_ISFIFO(st.st_mode));
	zassert_ok(unlink(TEST_FIFO));

	errno = 0;
	zassert_equal(mkfifoat(fd, "fifo", 0644), -1);
	zassert_equal(errno, ENOTDIR);

	zassert_ok(close(fd));
	zassert_ok(close(dirfd));
}
```

## src/mknodat.c
```c
/*
 * SPDX-FileCopyrightText: Copyright The Zephyr Project Contributors
 * SPDX-License-Identifier: Apache-2.0
 */

#include "fifo_fd_tests.h"

#include <errno.h>
#include <fcntl.h>
#include <sys/stat.h>
#include <unistd.h>

ZTEST_USER(posix_fifo_fd, test_mknodat)
{
	int dirfd = open(TEST_ROOT, O_RDONLY | O_DIRECTORY);
	struct stat st;

	zassert_true(dirfd >= 0, "open(" TEST_ROOT ") failed: %d", errno);

	zassert_ok(mknodat(dirfd, "fifo", S_IFIFO | 0644, 0));
	zassert_ok(fstatat(dirfd, "fifo", &st, 0));
	zassert_true(S_ISFIFO(st.st_mode));
	errno = 0;
	zassert_equal(mknodat(dirfd, "fifo", S_IFIFO | 0644, 0), -1);
	zassert_equal(errno, EEXIST);
	zassert_ok(unlinkat(dirfd, "fifo", 0));

	/* a regular file, empty */
	zassert_ok(mknodat(dirfd, "reg", S_IFREG | 0644, 0));
	zassert_ok(fstatat(dirfd, "reg", &st, 0));
	zassert_true(S_ISREG(st.st_mode));
	zassert_equal(st.st_size, 0);
	errno = 0;
	zassert_equal(mknodat(dirfd, "reg", S_IFREG | 0644, 0), -1);
	zassert_equal(errno, EEXIST);
	zassert_ok(unlinkat(dirfd, "reg", 0));

	/* no device special files exist to make (the host has them) */
	IF_NOT_NATIVE_LIBC({
		errno = 0;
		zassert_equal(mknodat(dirfd, "chr", S_IFCHR | 0644, 0), -1);
		zassert_equal(errno, EINVAL);
	});

	zassert_ok(close(dirfd));
}
```
