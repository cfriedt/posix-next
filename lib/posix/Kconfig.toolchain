## lib/posix/options/xsi/Kconfig
```kconfig
# Copyright (c) 2025 Tenstorrent AI ULC
#
# SPDX-License-Identifier: Apache-2.0

menuconfig XSI
	bool "X/Open System Interfaces (XSI)"
	select POSIX_FSYNC
	select POSIX_MAPPED_FILES
	select POSIX_THREADS
	select POSIX_MEMORY_PROTECTION
	select POSIX_THREAD_ATTR_STACKADDR
	select POSIX_THREAD_ATTR_STACKSIZE
	# to satisfy _POSIX_THREAD_SAFE_FUNCTIONS
	select POSIX_FILE_SYSTEM_R
	select POSIX_C_LANG_SUPPORT_R
	help
	  Select 'y' to enable X/Open System Interfaces (XSI) option groups such as
	  XSI_ADVANCED_REALTIME, XSI_REALTIME, XSI_THREADS_EXT, XSI_SINGLE_PROCESS,
	  XSI_STREAMS, and XSI_SYSTEM_LOGGING.
```

## lib/posix/options/xsi_advanced_realtime/Kconfig
```kconfig
# Copyright (c) The Zephyr Project Contributors
#
# SPDX-License-Identifier: Apache-2.0

config XSI_ADVANCED_REALTIME
	bool "X/Open Advanced Realtime"
	depends on XSI
	select XSI_REALTIME
	select POSIX_TIMERS
	select POSIX_CPUTIME
	select POSIX_MONOTONIC_CLOCK
	help
	  Select 'y' here to enable the XSI Advanced Realtime option group.

	  An implementation that claims conformance to this option group shall also
	  support the Realtime option group (:kconfig:option:`CONFIG_XSI_REALTIME`).

	  This option group consists of the following options:

	  _POSIX_ADVISORY_INFO, _POSIX_CPUTIME, _POSIX_MONOTONIC_CLOCK, _POSIX_SPAWN,
	  _POSIX_SPORADIC_SERVER, and _POSIX_TYPED_MEMORY_OBJECTS.

	  Defining _POSIX_CPUTIME or _POSIX_MONOTONIC_CLOCK also requires
	  _POSIX_TIMERS; enabling this option group selects POSIX_TIMERS accordingly.

	  If _POSIX_SPORADIC_SERVER is supported, _POSIX_PRIORITY_SCHEDULING is also
	  required (provided via :kconfig:option:`CONFIG_XSI_REALTIME`).

	  For more information, please see
	  https://pubs.opengroup.org/onlinepubs/9699919799/basedefs/V1_chap02.html
```
