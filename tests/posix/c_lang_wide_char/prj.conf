## CMakeLists.txt
```
# SPDX-License-Identifier: Apache-2.0

cmake_minimum_required(VERSION 3.20.0)
find_package(Zephyr REQUIRED HINTS $ENV{ZEPHYR_BASE})
project(posix_c_lang_wide_char)

FILE(GLOB app_sources src/*.c)
target_sources(app PRIVATE ${app_sources})

target_compile_options(app PRIVATE -U_POSIX_C_SOURCE -D_POSIX_C_SOURCE=200809L)
target_compile_options(app PRIVATE -U_XOPEN_SOURCE -D_XOPEN_SOURCE=700)
```

## prj.conf
```kconfig
CONFIG_ZTEST=y

CONFIG_POSIX_C_LANG_WIDE_CHAR=y

CONFIG_HEAP_MEM_POOL_SIZE=8192
CONFIG_COMMON_LIBC_MALLOC_ARENA_SIZE=8192
```

## src/main.c
```c
/*
 * SPDX-FileCopyrightText: Copyright The Zephyr Project Contributors
 * SPDX-License-Identifier: Apache-2.0
 */

#include <zephyr/ztest.h>

ZTEST_SUITE(posix_c_lang_wide_char, NULL, NULL, NULL, NULL, NULL);
```

## src/mbchar.c
```c
/*
 * SPDX-FileCopyrightText: Copyright The Zephyr Project Contributors
 * SPDX-License-Identifier: Apache-2.0
 */

#include <stdio.h>
#include <stdlib.h>
#include <string.h>
#include <wchar.h>

#include <zephyr/ztest.h>

ZTEST_USER(posix_c_lang_wide_char, test_btowc)
{
	zassert_equal(btowc('a'), L'a');
	zassert_equal(btowc('\0'), L'\0');
	zassert_equal(btowc(EOF), WEOF);
}

ZTEST_USER(posix_c_lang_wide_char, test_wctob)
{
	zassert_equal(wctob(L'a'), 'a');
	zassert_equal(wctob(L'\0'), '\0');
	zassert_equal(wctob(WEOF), EOF);
}

ZTEST_USER(posix_c_lang_wide_char, test_mblen)
{
	zassert_equal(mblen(NULL, 0), 0);
	zassert_equal(mblen("a", 1), 1);
	zassert_equal(mblen("", 1), 0);
	zassert_equal(mblen("a", 0), -1);
}

ZTEST_USER(posix_c_lang_wide_char, test_mbtowc)
{
	wchar_t wc = L'x';

	zassert_equal(mbtowc(NULL, NULL, 0), 0);
	zassert_equal(mbtowc(&wc, "a", 1), 1);
	zassert_equal(wc, L'a');
	zassert_equal(mbtowc(&wc, "", 1), 0);
	zassert_equal(wc, L'\0');
	zassert_equal(mbtowc(&wc, "a", 0), -1);
}

ZTEST_USER(posix_c_lang_wide_char, test_wctomb)
{
	char buf[16];

	zassert_equal(wctomb(buf, L'a'), 1);
	zassert_equal(buf[0], 'a');
	zassert_equal(wctomb(buf, L'\0'), 1);
	zassert_equal(buf[0], '\0');
	zassert_equal(wctomb(NULL, L'a'), 0);
}

ZTEST_USER(posix_c_lang_wide_char, test_mbsinit)
{
	mbstate_t st;

	zassert_true(mbsinit(NULL) != 0);
	memset(&st, 0, sizeof(st));
	zassert_true(mbsinit(&st) != 0);
}

ZTEST_USER(posix_c_lang_wide_char, test_mbrlen)
{
	mbstate_t st;

	memset(&st, 0, sizeof(st));
	zassert_equal(mbrlen("a", 1, &st), 1);
	zassert_equal(mbrlen("", 1, &st), 0);
	zassert_equal(mbrlen("a", 0, &st), (size_t)-2);
	zassert_equal(mbrlen("a", 1, NULL), 1);
}

ZTEST_USER(posix_c_lang_wide_char, test_mbrtowc)
{
	mbstate_t st;
	wchar_t wc = L'x';

	memset(&st, 0, sizeof(st));
	zassert_equal(mbrtowc(&wc, "a", 1, &st), 1);
	zassert_equal(wc, L'a');
	zassert_equal(mbrtowc(&wc, "", 1, &st), 0);
	zassert_equal(wc, L'\0');
	zassert_equal(mbrtowc(&wc, "a", 0, &st), (size_t)-2);
	zassert_equal(mbrtowc(NULL, "a", 1, NULL), 1);
}

ZTEST_USER(posix_c_lang_wide_char, test_wcrtomb)
{
	char buf[16];
	mbstate_t st;

	memset(&st, 0, sizeof(st));
	zassert_equal(wcrtomb(buf, L'a', &st), 1);
	zassert_equal(buf[0], 'a');
	zassert_equal(wcrtomb(buf, L'\0', &st), 1);
	zassert_equal(buf[0], '\0');
	zassert_equal(wcrtomb(NULL, L'a', NULL), 1);
}

ZTEST_USER(posix_c_lang_wide_char, test_mbstowcs)
{
	wchar_t wcs[8];

	zassert_equal(mbstowcs(wcs, "abc", ARRAY_SIZE(wcs)), 3);
	zassert_equal(wcscmp(wcs, L"abc"), 0);
	/* a short destination is not terminated */
	wcs[2] = L'x';
	zassert_equal(mbstowcs(wcs, "abc", 2), 2);
	zassert_equal(wcs[2], L'x');
}

ZTEST_USER(posix_c_lang_wide_char, test_wcstombs)
{
	char buf[8];

	zassert_equal(wcstombs(buf, L"abc", sizeof(buf)), 3);
	zassert_str_equal(buf, "abc");
	buf[2] = 'x';
	zassert_equal(wcstombs(buf, L"abc", 2), 2);
	zassert_equal(buf[2], 'x');
}

ZTEST_USER(posix_c_lang_wide_char, test_mbsrtowcs)
{
	const char *src = "abc";
	wchar_t wcs[8];
	mbstate_t st;

	memset(&st, 0, sizeof(st));
	zassert_equal(mbsrtowcs(NULL, &src, 0, &st), 3);
	zassert_equal(mbsrtowcs(wcs, &src, ARRAY_SIZE(wcs), &st), 3);
	zassert_equal(wcscmp(wcs, L"abc"), 0);
	/* the whole string converted */
	zassert_is_null(src);

	/* a short destination stops with src at the rest */
	src = "abc";
	zassert_equal(mbsrtowcs(wcs, &src, 2, &st), 2);
	zassert_str_equal(src, "c");
}

ZTEST_USER(posix_c_lang_wide_char, test_wcsrtombs)
{
	const wchar_t *src = L"abc";
	char buf[8];
	mbstate_t st;

	memset(&st, 0, sizeof(st));
	zassert_equal(wcsrtombs(NULL, &src, 0, &st), 3);
	zassert_equal(wcsrtombs(buf, &src, sizeof(buf), &st), 3);
	zassert_str_equal(buf, "abc");
	zassert_is_null(src);

	src = L"abc";
	zassert_equal(wcsrtombs(buf, &src, 2, &st), 2);
	zassert_equal(wcscmp(src, L"c"), 0);
}
```

## src/swprintf.c
```c
/*
 * SPDX-FileCopyrightText: Copyright The Zephyr Project Contributors
 * SPDX-License-Identifier: Apache-2.0
 */

#include <stdarg.h>
#include <time.h>
#include <wchar.h>

#include <zephyr/ztest.h>

ZTEST_USER(posix_c_lang_wide_char, test_swprintf)
{
	wchar_t buf[32];

	int ret;

	zassert_equal(swprintf(buf, ARRAY_SIZE(buf), L"%d-%ls-%lc", 42, L"wide", L'x'), 9);
	zassert_equal(wcscmp(buf, L"42-wide-x"), 0);

	/* a result that does not fit is an error; Picolibc reports the length it needed instead */
	ret = swprintf(buf, 3, L"%d", 12345);
	zassert_true((ret < 0) || (IS_ENABLED(CONFIG_PICOLIBC) && (ret == 5)),
		     "swprintf: %d", ret);
}

static int vswprintf_wrap(wchar_t *buf, size_t n, const wchar_t *fmt, ...)
{
	va_list ap;
	int ret;

	va_start(ap, fmt);
	ret = vswprintf(buf, n, fmt, ap);
	va_end(ap);

	return ret;
}

ZTEST_USER(posix_c_lang_wide_char, test_vswprintf)
{
	wchar_t buf[32];

	int ret;

	zassert_equal(vswprintf_wrap(buf, ARRAY_SIZE(buf), L"%d-%ls", 42, L"wide"), 7);
	zassert_equal(wcscmp(buf, L"42-wide"), 0);

	ret = vswprintf_wrap(buf, 3, L"%d", 12345);
	zassert_true((ret < 0) || (IS_ENABLED(CONFIG_PICOLIBC) && (ret == 5)),
		     "vswprintf: %d", ret);
}

ZTEST_USER(posix_c_lang_wide_char, test_swscanf)
{
	wchar_t word[8];
	int n;

	zassert_equal(swscanf(L"42 wide", L"%d %7ls", &n, word), 2);
	zassert_equal(n, 42);
	zassert_equal(wcscmp(word, L"wide"), 0);
	zassert_equal(swscanf(L"x", L"%d", &n), 0);
	zassert_equal(swscanf(L"", L"%d", &n), EOF);
}

static int vswscanf_wrap(const wchar_t *s, const wchar_t *fmt, ...)
{
	va_list ap;
	int ret;

	va_start(ap, fmt);
	ret = vswscanf(s, fmt, ap);
	va_end(ap);

	return ret;
}

ZTEST_USER(posix_c_lang_wide_char, test_vswscanf)
{
	wchar_t word[8];
	int n;

	zassert_equal(vswscanf_wrap(L"42 wide", L"%d %7ls", &n, word), 2);
	zassert_equal(n, 42);
	zassert_equal(wcscmp(word, L"wide"), 0);
	zassert_equal(vswscanf_wrap(L"", L"%d", &n), EOF);
}

ZTEST_USER(posix_c_lang_wide_char, test_wcsftime)
{
	/* 2009-02-13 23:31:30 UTC */
	const struct tm tm = {
		.tm_year = 109, .tm_mon = 1, .tm_mday = 13, .tm_hour = 23, .tm_min = 31,
		.tm_sec = 30, .tm_wday = 5, .tm_yday = 43,
	};
	wchar_t buf[32];

	zassert_equal(wcsftime(buf, ARRAY_SIZE(buf), L"%Y-%m-%d %H:%M:%S", &tm), 19);
	zassert_equal(wcscmp(buf, L"2009-02-13 23:31:30"), 0);
	/* a result that does not fit yields 0 */
	zassert_equal(wcsftime(buf, 4, L"%Y-%m-%d", &tm), 0);
}
```

## src/wcs.c
```c
/*
 * SPDX-FileCopyrightText: Copyright The Zephyr Project Contributors
 * SPDX-License-Identifier: Apache-2.0
 */

#include <wchar.h>

#include <zephyr/ztest.h>

ZTEST_USER(posix_c_lang_wide_char, test_wcslen)
{
	zassert_equal(wcslen(L""), 0);
	zassert_equal(wcslen(L"hello"), 5);
}

ZTEST_USER(posix_c_lang_wide_char, test_wcscpy)
{
	wchar_t buf[8];

	zassert_equal(wcscpy(buf, L"hello"), buf);
	zassert_equal(wcscmp(buf, L"hello"), 0);
	zassert_equal(wcscpy(buf, L""), buf);
	zassert_equal(buf[0], L'\0');
}

ZTEST_USER(posix_c_lang_wide_char, test_wcsncpy)
{
	wchar_t buf[8];

	/* pads with nulls, and does not terminate a truncated copy */
	wmemset(buf, L'x', ARRAY_SIZE(buf));
	zassert_equal(wcsncpy(buf, L"ab", 4), buf);
	zassert_equal(wmemcmp(buf, L"ab\0\0", 4), 0);
	zassert_equal(buf[4], L'x');
	zassert_equal(wcsncpy(buf, L"hello", 3), buf);
	zassert_equal(wmemcmp(buf, L"hel", 3), 0);
	zassert_equal(buf[3], L'\0');
}

ZTEST_USER(posix_c_lang_wide_char, test_wcscat)
{
	wchar_t buf[16] = L"hello";

	zassert_equal(wcscat(buf, L", world"), buf);
	zassert_equal(wcscmp(buf, L"hello, world"), 0);
	zassert_equal(wcscat(buf, L""), buf);
	zassert_equal(wcscmp(buf, L"hello, world"), 0);
}

ZTEST_USER(posix_c_lang_wide_char, test_wcsncat)
{
	wchar_t buf[16] = L"hello";

	zassert_equal(wcsncat(buf, L", world", 2), buf);
	zassert_equal(wcscmp(buf, L"hello, "), 0);
	zassert_equal(wcsncat(buf, L"world", 16), buf);
	zassert_equal(wcscmp(buf, L"hello, world"), 0);
}

ZTEST_USER(posix_c_lang_wide_char, test_wcscmp)
{
	zassert_equal(wcscmp(L"abc", L"abc"), 0);
	zassert_true(wcscmp(L"abc", L"abd") < 0);
	zassert_true(wcscmp(L"abd", L"abc") > 0);
	zassert_true(wcscmp(L"ab", L"abc") < 0);
}

ZTEST_USER(posix_c_lang_wide_char, test_wcsncmp)
{
	zassert_equal(wcsncmp(L"abc", L"abd", 2), 0);
	zassert_true(wcsncmp(L"abc", L"abd", 3) < 0);
	zassert_equal(wcsncmp(L"abc", L"xyz", 0), 0);
}

ZTEST_USER(posix_c_lang_wide_char, test_wcscoll)
{
	/* the C locale collates by code point */
	zassert_equal(wcscoll(L"abc", L"abc"), 0);
	zassert_true(wcscoll(L"abc", L"abd") < 0);
	zassert_true(wcscoll(L"b", L"a") > 0);
}

ZTEST_USER(posix_c_lang_wide_char, test_wcsxfrm)
{
	wchar_t a[8];
	wchar_t b[8];

	zassert_equal(wcsxfrm(NULL, L"abc", 0), 3);
	zassert_equal(wcsxfrm(a, L"abc", ARRAY_SIZE(a)), 3);
	zassert_equal(wcsxfrm(b, L"abd", ARRAY_SIZE(b)), 3);
	zassert_true(wcscmp(a, b) < 0);
}

ZTEST_USER(posix_c_lang_wide_char, test_wcschr)
{
	const wchar_t *s = L"hello";

	zassert_equal(wcschr(s, L'l'), &s[2]);
	zassert_equal(wcschr(s, L'\0'), &s[5]);
	zassert_is_null(wcschr(s, L'z'));
}

ZTEST_USER(posix_c_lang_wide_char, test_wcsrchr)
{
	const wchar_t *s = L"hello";

	zassert_equal(wcsrchr(s, L'l'), &s[3]);
	zassert_equal(wcsrchr(s, L'\0'), &s[5]);
	zassert_is_null(wcsrchr(s, L'z'));
}

ZTEST_USER(posix_c_lang_wide_char, test_wcsstr)
{
	const wchar_t *s = L"hello, world";

	zassert_equal(wcsstr(s, L"world"), &s[7]);
	zassert_equal(wcsstr(s, L""), s);
	zassert_is_null(wcsstr(s, L"word"));
}

ZTEST_USER(posix_c_lang_wide_char, test_wcspbrk)
{
	const wchar_t *s = L"hello, world";

	zassert_equal(wcspbrk(s, L",!"), &s[5]);
	zassert_is_null(wcspbrk(s, L"xyz"));
}

ZTEST_USER(posix_c_lang_wide_char, test_wcsspn)
{
	zassert_equal(wcsspn(L"hello", L"hel"), 4);
	zassert_equal(wcsspn(L"hello", L"xyz"), 0);
}

ZTEST_USER(posix_c_lang_wide_char, test_wcscspn)
{
	zassert_equal(wcscspn(L"hello", L"lo"), 2);
	zassert_equal(wcscspn(L"hello", L"xyz"), 5);
}

ZTEST_USER(posix_c_lang_wide_char, test_wcstok)
{
	wchar_t buf[] = L"a,b,,c";
	wchar_t *state;

	zassert_equal(wcscmp(wcstok(buf, L",", &state), L"a"), 0);
	zassert_equal(wcscmp(wcstok(NULL, L",", &state), L"b"), 0);
	zassert_equal(wcscmp(wcstok(NULL, L",", &state), L"c"), 0);
	zassert_is_null(wcstok(NULL, L",", &state));
}

ZTEST_USER(posix_c_lang_wide_char, test_wmemchr)
{
	const wchar_t s[] = L"hel\0lo";

	zassert_equal(wmemchr(s, L'l', 6), &s[2]);
	zassert_equal(wmemchr(s, L'o', 6), &s[5]);
	zassert_is_null(wmemchr(s, L'o', 5));
}

ZTEST_USER(posix_c_lang_wide_char, test_wmemcmp)
{
	zassert_equal(wmemcmp(L"abc", L"abd", 2), 0);
	zassert_true(wmemcmp(L"abc", L"abd", 3) < 0);
	zassert_true(wmemcmp(L"abd", L"abc", 3) > 0);
}

ZTEST_USER(posix_c_lang_wide_char, test_wmemcpy)
{
	wchar_t buf[4] = L"xxxx";

	zassert_equal(wmemcpy(buf, L"ab", 2), buf);
	zassert_equal(wmemcmp(buf, L"abxx", 4), 0);
}

ZTEST_USER(posix_c_lang_wide_char, test_wmemmove)
{
	wchar_t buf[] = L"abcdef";

	/* overlapping in both directions */
	zassert_equal(wmemmove(&buf[2], &buf[0], 4), &buf[2]);
	zassert_equal(wcscmp(buf, L"ababcd"), 0);
	zassert_equal(wmemmove(&buf[0], &buf[2], 4), &buf[0]);
	zassert_equal(wcscmp(buf, L"abcdcd"), 0);
}

ZTEST_USER(posix_c_lang_wide_char, test_wmemset)
{
	wchar_t buf[4] = L"xxxx";

	zassert_equal(wmemset(buf, L'a', 3), buf);
	zassert_equal(wmemcmp(buf, L"aaax", 4), 0);
}
```

## src/wcsto.c
```c
/*
 * SPDX-FileCopyrightText: Copyright The Zephyr Project Contributors
 * SPDX-License-Identifier: Apache-2.0
 */

#include <errno.h>
#include <inttypes.h>
#include <limits.h>
#include <math.h>
#include <wchar.h>

#include <zephyr/ztest.h>

#define INT_TEST(fn, type, base_ok, big, big_val)                                                  \
	ZTEST_USER(posix_c_lang_wide_char, test_##fn)                                              \
	{                                                                                          \
		const wchar_t *s = L"  42xyz";                                                     \
		const wchar_t *none = L"zzz";                                                      \
		wchar_t *end;                                                                      \
                                                                                                   \
		zassert_equal(fn(s, &end, 10), (type)42);                                          \
		zassert_equal(end, &s[4]);                                                         \
		zassert_equal(fn(L"0x1f", &end, 16), (type)31);                                    \
		zassert_equal(fn(L"0x1f", &end, 0), (type)31);                                     \
		zassert_equal(fn(L"017", NULL, 0), (type)15);                                      \
		zassert_equal(fn(base_ok, &end, 10), (type)-7);                                    \
		zassert_equal(fn(none, &end, 10), (type)0);                                        \
		zassert_equal(end, none);                                                          \
		errno = 0;                                                                         \
		zassert_equal(fn(big, NULL, 10), big_val);                                         \
		zassert_equal(errno, ERANGE);                                                      \
	}

INT_TEST(wcstol, long, L"-7", L"99999999999999999999999", LONG_MAX)
INT_TEST(wcstoll, long long, L"-7", L"99999999999999999999999", LLONG_MAX)
INT_TEST(wcstoimax, intmax_t, L"-7", L"99999999999999999999999", INTMAX_MAX)
INT_TEST(wcstoul, unsigned long, L"-7", L"99999999999999999999999", ULONG_MAX)
INT_TEST(wcstoull, unsigned long long, L"-7", L"99999999999999999999999", ULLONG_MAX)
INT_TEST(wcstoumax, uintmax_t, L"-7", L"99999999999999999999999", UINTMAX_MAX)

/* compared as double: the 32-bit targets ship no long double comparison helpers */
#define FLOAT_TEST(fn, big)                                                                        \
	ZTEST_USER(posix_c_lang_wide_char, test_##fn)                                              \
	{                                                                                          \
		const wchar_t *s = L"  1.5e1xyz";                                                  \
		const wchar_t *none = L"xyz";                                                      \
		wchar_t *end;                                                                      \
                                                                                                   \
		zassert_equal((double)fn(s, &end), 15.0);                                          \
		zassert_equal(end, &s[7]);                                                         \
		zassert_equal((double)fn(L"-0.25", NULL), -0.25);                                  \
		zassert_equal((double)fn(L"0x10", NULL), 16.0);                                    \
		zassert_true(isinf((double)fn(L"inf", NULL)));                                     \
		zassert_true(isnan((double)fn(L"nan", NULL)));                                     \
		zassert_equal((double)fn(none, &end), 0.0);                                        \
		zassert_equal(end, none);                                                          \
		errno = 0;                                                                         \
		zassert_true(isinf((double)fn(big, NULL)));                                        \
		zassert_equal(errno, ERANGE);                                                      \
	}

FLOAT_TEST(wcstod, L"1e999")
FLOAT_TEST(wcstof, L"1e99")

ZTEST_USER(posix_c_lang_wide_char, test_wcstold)
{
	const wchar_t *s = L"  1.5e1xyz";
	const wchar_t *none = L"xyz";
	wchar_t *end;

	if (IS_ENABLED(CONFIG_X86) && !IS_ENABLED(CONFIG_X86_64)) {
		/* the IA-32 soft-float stubs oops on long double arithmetic */
		ztest_test_skip();
	}

	zassert_equal((double)wcstold(s, &end), 15.0);
	zassert_equal(end, &s[7]);
	zassert_equal((double)wcstold(L"-0.25", NULL), -0.25);
	zassert_equal((double)wcstold(L"0x10", NULL), 16.0);
	zassert_true(isinf((double)wcstold(L"inf", NULL)));
	zassert_true(isnan((double)wcstold(L"nan", NULL)));
	zassert_equal((double)wcstold(none, &end), 0.0);
	zassert_equal(end, none);
	errno = 0;
	zassert_true(isinf((double)wcstold(L"1e99999", NULL)));
	zassert_equal(errno, ERANGE);
}
```

## src/wctype.c
```c
/*
 * SPDX-FileCopyrightText: Copyright The Zephyr Project Contributors
 * SPDX-License-Identifier: Apache-2.0
 */

#include <wchar.h>
#include <wctype.h>

#include <zephyr/ztest.h>

/* the C locale: only the ASCII classes are known */
#define CLASS_TEST(fn, yes, no)                                                                    \
	ZTEST_USER(posix_c_lang_wide_char, test_##fn)                                              \
	{                                                                                          \
		zassert_true(fn(yes) != 0);                                                        \
		zassert_true(fn(no) == 0);                                                         \
		zassert_true(fn(WEOF) == 0);                                                       \
	}

CLASS_TEST(iswalnum, L'7', L' ')
CLASS_TEST(iswalpha, L'q', L'7')
CLASS_TEST(iswblank, L'\t', L'\n')
CLASS_TEST(iswcntrl, L'\n', L'a')
CLASS_TEST(iswdigit, L'0', L'a')
CLASS_TEST(iswgraph, L'!', L' ')
CLASS_TEST(iswlower, L'a', L'A')
CLASS_TEST(iswprint, L' ', L'\n')
CLASS_TEST(iswpunct, L'.', L'a')
CLASS_TEST(iswspace, L' ', L'a')
CLASS_TEST(iswupper, L'A', L'a')
CLASS_TEST(iswxdigit, L'f', L'g')

ZTEST_USER(posix_c_lang_wide_char, test_iswctype)
{
	zassert_true(iswctype(L'a', wctype("alpha")) != 0);
	zassert_true(iswctype(L'1', wctype("alpha")) == 0);
	zassert_true(iswctype(L'1', wctype("digit")) != 0);
	zassert_true(iswctype(WEOF, wctype("digit")) == 0);
}

ZTEST_USER(posix_c_lang_wide_char, test_wctype)
{
	zassert_true(wctype("alpha") != 0);
	zassert_true(wctype("space") != 0);
	zassert_equal(wctype("no such class"), 0);
}

ZTEST_USER(posix_c_lang_wide_char, test_towlower)
{
	zassert_equal(towlower(L'A'), L'a');
	zassert_equal(towlower(L'a'), L'a');
	zassert_equal(towlower(L'1'), L'1');
	zassert_equal(towlower(WEOF), WEOF);
}

ZTEST_USER(posix_c_lang_wide_char, test_towupper)
{
	zassert_equal(towupper(L'a'), L'A');
	zassert_equal(towupper(L'A'), L'A');
	zassert_equal(towupper(L'1'), L'1');
	zassert_equal(towupper(WEOF), WEOF);
}

ZTEST_USER(posix_c_lang_wide_char, test_wctrans)
{
	zassert_true(wctrans("tolower") != 0);
	zassert_true(wctrans("toupper") != 0);
	zassert_equal(wctrans("no such mapping"), 0);
}

ZTEST_USER(posix_c_lang_wide_char, test_towctrans)
{
	zassert_equal(towctrans(L'a', wctrans("toupper")), L'A');
	zassert_equal(towctrans(L'A', wctrans("tolower")), L'a');
	zassert_equal(towctrans(L'1', wctrans("toupper")), L'1');
}
```
