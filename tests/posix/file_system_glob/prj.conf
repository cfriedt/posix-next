## CMakeLists.txt
```
# SPDX-License-Identifier: Apache-2.0

cmake_minimum_required(VERSION 3.20.0)
find_package(Zephyr REQUIRED HINTS $ENV{ZEPHYR_BASE})
project(posix_file_system_glob)

FILE(GLOB app_sources src/*.c)
target_sources(app PRIVATE ${app_sources})

target_compile_options(app PRIVATE -U_POSIX_C_SOURCE -D_POSIX_C_SOURCE=200809L)
target_compile_options(app PRIVATE -U_XOPEN_SOURCE -D_XOPEN_SOURCE=700)
```

## prj.conf
```kconfig
CONFIG_ZTEST=y

CONFIG_POSIX_AEP_CHOICE_PSE52=y
CONFIG_POSIX_FILE_SYSTEM_GLOB=y
# XSI provides the S_IF* constants and the XSI struct stat members
CONFIG_XSI=y

CONFIG_FILE_SYSTEM=y
CONFIG_FAT_FILESYSTEM_ELM=y
# preserve filename case for the name-comparing tests
CONFIG_FS_FATFS_LFN=y

CONFIG_EVENTFD=n

# stdio (3) + one directory stream per pattern segment + scratch
CONFIG_ZVFS_OPEN_IGNORE_MIN=y
CONFIG_ZVFS_OPEN_MAX=12
CONFIG_ZVFS_DIR_MAX=4

CONFIG_MAIN_STACK_SIZE=4096
# glob() recurses once per pattern segment over LFN-enabled FATFS frames
CONFIG_ZTEST_STACK_SIZE=8192
CONFIG_TEST_EXTRA_STACK_SIZE=4096

CONFIG_HEAP_MEM_POOL_SIZE=16384
CONFIG_COMMON_LIBC_MALLOC_ARENA_SIZE=16384
```

## src/main.c
```c
/*
 * SPDX-FileCopyrightText: Copyright The Zephyr Project Contributors
 * SPDX-License-Identifier: Apache-2.0
 */

#include "file_system_glob_tests.h"

#include <errno.h>
#include <fcntl.h>
#include <stdio.h>
#include <string.h>
#include <sys/stat.h>
#include <unistd.h>

#include <zephyr/kernel.h>
#ifndef CONFIG_NATIVE_LIBC
#include <ff.h>
#include <zephyr/fs/fs.h>
#endif
#ifdef CONFIG_USERSPACE
#include <zephyr/sys/fdtable.h>
extern struct k_mem_partition zvfs_dir_partition;
#endif

#ifndef CONFIG_NATIVE_LIBC
static FATFS fat_fs;
static struct fs_mount_t fs_mnt = {
	.type = FS_FATFS,
	.mnt_point = "/",
	.fs_data = &fat_fs,
};
#endif

/*
 * Remove a whole subtree. The Zephyr path uses the fs_* API directly: POSIX
 * <dirent.h> and the FATFS ff.h both define a DIR type, so they cannot share
 * a translation unit. Under the host libc, plain POSIX calls are used.
 */
#ifdef CONFIG_NATIVE_LIBC
#include <dirent.h>
static void rmtree(const char *path)
{
	DIR *d = opendir(path);
	struct dirent *e;
	char child[300];

	if (d != NULL) {
		while ((e = readdir(d)) != NULL) {
			if (strcmp(e->d_name, ".") == 0 || strcmp(e->d_name, "..") == 0) {
				continue;
			}
			if (snprintf(child, sizeof(child), "%s/%s", path, e->d_name) >=
			    (int)sizeof(child)) {
				continue;
			}
			rmtree(child);
		}
		closedir(d);
		rmdir(path);
		return;
	}

	(void)unlink(path);
}
#else
static void rmtree(const char *path)
{
	struct fs_dir_t dir;
	struct fs_dirent ent;
	char child[300];

	fs_dir_t_init(&dir);

	if (fs_opendir(&dir, path) == 0) {
		while (fs_readdir(&dir, &ent) == 0 && ent.name[0] != '\0') {
			if (snprintf(child, sizeof(child), "%s/%s", path, ent.name) >=
			    (int)sizeof(child)) {
				continue;
			}
			rmtree(child);
		}
		fs_closedir(&dir);
	}

	(void)fs_unlink(path);
}
#endif

static void write_file(const char *path, const char *content)
{
	int fd = open(path, O_WRONLY | O_CREAT | O_TRUNC, 0600);

	zassert_true(fd >= 0, "open(%s) failed: %d", path, errno);
	zassert_equal(write(fd, content, strlen(content)), strlen(content));
	zassert_ok(close(fd));
}

static void before(void *arg)
{
	ARG_UNUSED(arg);

	rmtree(TEST_ROOT);

	zassert_ok(mkdir(TEST_ROOT, 0777));

	write_file(TEST_ROOT "/a.txt", "a");
	write_file(TEST_ROOT "/b.txt", "b");
	write_file(TEST_ROOT "/c.dat", "c");
	write_file(TEST_BRACKET, "[]");
	write_file(TEST_HIDDEN, ".");

	zassert_ok(mkdir(TEST_SUB, 0777));
	write_file(TEST_SUB "/x.txt", "x");
	write_file(TEST_SUB "/y.txt", "y");
}

static void after(void *arg)
{
	ARG_UNUSED(arg);

	{ int rc = chdir("/"); ARG_UNUSED(rc); }
}

static void *setup(void)
{
#ifndef CONFIG_NATIVE_LIBC
	memset(&fat_fs, 0, sizeof(fat_fs));
	zassert_ok(fs_mount(&fs_mnt));
#endif
	(void)mkdir(FS_TMPDIR, 0777);
#ifdef CONFIG_USERSPACE
	zassert_ok(k_mem_domain_add_partition(&k_mem_domain_default, &zvfs_dir_partition));
#endif
	return NULL;
}

static void teardown(void *arg)
{
	ARG_UNUSED(arg);
#ifndef CONFIG_NATIVE_LIBC
	rmtree(TEST_ROOT);
	(void)fs_unmount(&fs_mnt);
#endif
}

ZTEST_SUITE(posix_file_system_glob, NULL, setup, before, after, teardown);
```

## src/file_system_glob_tests.h
```c
/*
 * SPDX-FileCopyrightText: Copyright The Zephyr Project Contributors
 * SPDX-License-Identifier: Apache-2.0
 */

#ifndef POSIX_TESTS_FILE_SYSTEM_GLOB_TESTS_H_
#define POSIX_TESTS_FILE_SYSTEM_GLOB_TESTS_H_

#include <glob.h>

#include <zephyr/ztest.h>

#include "../../shared/linux_compat_test.h"

/*
 * The file system is mounted at "/", and /tmp exists in both worlds (the FAT
 * RAM disk under Zephyr, the host filesystem under CONFIG_NATIVE_LIBC), so
 * every path constant is identical for the linux_compat variant.
 *
 * TEST_ROOT holds a.txt, b.txt, c.dat, [ab].txt, .hidden, and the directory
 * sub with x.txt and y.txt.
 */
#define FS_TMPDIR    "/tmp"
#define TEST_ROOT    FS_TMPDIR "/pglob"
#define TEST_SUB     TEST_ROOT "/sub"
#define TEST_BRACKET TEST_ROOT "/[ab].txt"
#define TEST_HIDDEN  TEST_ROOT "/.hidden"
#define TEST_NODIR   TEST_ROOT "/nope"

#endif /* POSIX_TESTS_FILE_SYSTEM_GLOB_TESTS_H_ */
```

## src/glob.c
```c
/*
 * SPDX-FileCopyrightText: Copyright The Zephyr Project Contributors
 * SPDX-License-Identifier: Apache-2.0
 */

#include "file_system_glob_tests.h"

#include <errno.h>
#include <string.h>
#include <unistd.h>

static void expect_paths(const glob_t *g, const char *const *paths, size_t n, size_t offs)
{
	zassert_equal((size_t)g->gl_pathc, n, "gl_pathc: %d, want %zu (first %s)", g->gl_pathc, n,
		      (g->gl_pathc > 0) ? g->gl_pathv[offs] : "");
	for (size_t i = 0; i < offs; i++) {
		zassert_is_null(g->gl_pathv[i]);
	}
	for (size_t i = 0; i < n; i++) {
		zassert_str_equal(g->gl_pathv[offs + i], paths[i], "[%zu]: %s, want %s", i,
				  g->gl_pathv[offs + i], paths[i]);
	}
	zassert_is_null(g->gl_pathv[offs + n]);
}

#define EXPECT_PATHS(g, ...)                                                                       \
	do {                                                                                       \
		const char *const paths_[] = {__VA_ARGS__};                                        \
		expect_paths((g), paths_, ARRAY_SIZE(paths_), 0);                                  \
	} while (0)

static void glob_matches(void)
{
	glob_t g;

	/* sorted, dot files excluded, a bracket expression in the pattern */
	zassert_ok(glob(TEST_ROOT "/*.txt", 0, NULL, &g));
	EXPECT_PATHS(&g, TEST_ROOT "/[ab].txt", TEST_ROOT "/a.txt", TEST_ROOT "/b.txt");
	globfree(&g);

	zassert_ok(glob(TEST_ROOT "/?.*", 0, NULL, &g));
	EXPECT_PATHS(&g, TEST_ROOT "/a.txt", TEST_ROOT "/b.txt", TEST_ROOT "/c.dat");
	globfree(&g);

	zassert_ok(glob(TEST_ROOT "/[ab].txt", 0, NULL, &g));
	EXPECT_PATHS(&g, TEST_ROOT "/a.txt", TEST_ROOT "/b.txt");
	globfree(&g);

	/* a leading period only matches explicitly */
	zassert_ok(glob(TEST_ROOT "/.h*", 0, NULL, &g));
	EXPECT_PATHS(&g, TEST_HIDDEN);
	globfree(&g);

	/* a literal pattern names one existing path */
	zassert_ok(glob(TEST_ROOT "/a.txt", 0, NULL, &g));
	EXPECT_PATHS(&g, TEST_ROOT "/a.txt");
	globfree(&g);

	/* a pattern segment in the middle of the path */
	zassert_ok(glob(TEST_ROOT "/*/?.txt", 0, NULL, &g));
	EXPECT_PATHS(&g, TEST_SUB "/x.txt", TEST_SUB "/y.txt");
	globfree(&g);

	zassert_ok(glob(TEST_SUB "/*", 0, NULL, &g));
	EXPECT_PATHS(&g, TEST_SUB "/x.txt", TEST_SUB "/y.txt");
	globfree(&g);
}

static void glob_relative(void)
{
	glob_t g;

	zassert_ok(chdir(TEST_ROOT));
	zassert_ok(glob("?.dat", 0, NULL, &g));
	EXPECT_PATHS(&g, "c.dat");
	globfree(&g);

	zassert_ok(glob("sub/*.txt", 0, NULL, &g));
	EXPECT_PATHS(&g, "sub/x.txt", "sub/y.txt");
	globfree(&g);
	zassert_ok(chdir("/"));
}

static void glob_nomatch(void)
{
	glob_t g;

	memset(&g, 0xff, sizeof(g));
	zassert_equal(glob(TEST_ROOT "/*.none", 0, NULL, &g), GLOB_NOMATCH);
	zassert_equal(g.gl_pathc, 0);
	globfree(&g);

	zassert_equal(glob(TEST_ROOT "/a.txt/*", 0, NULL, &g), GLOB_NOMATCH);
	globfree(&g);

	/* the pattern itself stands in for a missing match */
	zassert_ok(glob(TEST_ROOT "/*.none", GLOB_NOCHECK, NULL, &g));
	EXPECT_PATHS(&g, TEST_ROOT "/*.none");
	globfree(&g);
}

static void glob_mark(void)
{
	glob_t g;

	zassert_ok(glob(TEST_ROOT "/*", GLOB_MARK, NULL, &g));
	EXPECT_PATHS(&g, TEST_BRACKET, TEST_ROOT "/a.txt", TEST_ROOT "/b.txt", TEST_ROOT "/c.dat",
		     TEST_SUB "/");
	globfree(&g);

	zassert_ok(glob(TEST_SUB, GLOB_MARK, NULL, &g));
	EXPECT_PATHS(&g, TEST_SUB "/");
	globfree(&g);

	zassert_ok(glob(TEST_ROOT "/a.txt", GLOB_MARK, NULL, &g));
	EXPECT_PATHS(&g, TEST_ROOT "/a.txt");
	globfree(&g);

	/* a trailing slash matches directories only, and stays in the result */
	zassert_ok(glob(TEST_ROOT "/*/", 0, NULL, &g));
	EXPECT_PATHS(&g, TEST_SUB "/");
	globfree(&g);
}

static void glob_nosort(void)
{
	glob_t g;

	zassert_ok(glob(TEST_ROOT "/*.txt", GLOB_NOSORT, NULL, &g));
	zassert_equal(g.gl_pathc, 3);
	zassert_is_null(g.gl_pathv[3]);
	globfree(&g);
}

static void glob_escape(void)
{
	glob_t g;

	zassert_ok(glob(TEST_ROOT "/\\[ab\\].txt", 0, NULL, &g));
	EXPECT_PATHS(&g, TEST_BRACKET);
	globfree(&g);

	zassert_equal(glob(TEST_ROOT "/\\[ab\\].txt", GLOB_NOESCAPE, NULL, &g), GLOB_NOMATCH);
	globfree(&g);
}

static void glob_append(void)
{
	glob_t g;

	zassert_ok(glob(TEST_ROOT "/a.txt", 0, NULL, &g));
	zassert_ok(glob(TEST_ROOT "/*.dat", GLOB_APPEND, NULL, &g));
	zassert_ok(glob(TEST_SUB "/*", GLOB_APPEND, NULL, &g));
	EXPECT_PATHS(&g, TEST_ROOT "/a.txt", TEST_ROOT "/c.dat", TEST_SUB "/x.txt",
		     TEST_SUB "/y.txt");
	globfree(&g);

	/* an appended miss keeps what came before */
	zassert_ok(glob(TEST_ROOT "/a.txt", 0, NULL, &g));
	zassert_equal(glob(TEST_ROOT "/*.none", GLOB_APPEND, NULL, &g), GLOB_NOMATCH);
	EXPECT_PATHS(&g, TEST_ROOT "/a.txt");
	globfree(&g);
}

static void glob_doofs(void)
{
	static const char *const paths[] = {TEST_ROOT "/c.dat", TEST_SUB "/x.txt",
					    TEST_SUB "/y.txt"};
	glob_t g;

	memset(&g, 0, sizeof(g));
	g.gl_offs = 2;
	zassert_ok(glob(TEST_ROOT "/*.dat", GLOB_DOOFFS, NULL, &g));
	expect_paths(&g, paths, 1, 2);
	zassert_ok(glob(TEST_SUB "/*", GLOB_DOOFFS | GLOB_APPEND, NULL, &g));
	expect_paths(&g, paths, 3, 2);
	globfree(&g);
}

static ZTEST_BMEM int err_calls;
static ZTEST_BMEM int err_errno;
static ZTEST_BMEM char err_path[64];
static ZTEST_BMEM int err_ret;

static int errfunc(const char *epath, int eerrno)
{
	err_calls++;
	err_errno = eerrno;
	strncpy(err_path, epath, sizeof(err_path) - 1);
	return err_ret;
}

static void glob_err(void)
{
	glob_t g;

	/* an unreadable directory is skipped unless GLOB_ERR or errfunc says otherwise */
	zassert_equal(glob(TEST_NODIR "/*", 0, NULL, &g), GLOB_NOMATCH);
	globfree(&g);

	zassert_equal(glob(TEST_NODIR "/*", GLOB_ERR, NULL, &g), GLOB_ABORTED);
	globfree(&g);

	err_calls = 0;
	err_ret = 0;
	zassert_equal(glob(TEST_NODIR "/*", 0, errfunc, &g), GLOB_NOMATCH);
	zassert_equal(err_calls, 1);
	zassert_equal(err_errno, ENOENT);
	zassert_str_equal(err_path, TEST_NODIR);
	globfree(&g);

	err_calls = 0;
	err_ret = 1;
	zassert_equal(glob(TEST_NODIR "/*", 0, errfunc, &g), GLOB_ABORTED);
	zassert_equal(err_calls, 1);
	globfree(&g);
}

ZTEST_USER(posix_file_system_glob, test_glob)
{
	glob_matches();
	glob_relative();
	glob_nomatch();
	glob_mark();
	glob_nosort();
	glob_escape();
	glob_append();
	glob_doofs();
	glob_err();
}
```

## src/globfree.c
```c
/*
 * SPDX-FileCopyrightText: Copyright The Zephyr Project Contributors
 * SPDX-License-Identifier: Apache-2.0
 */

#include "file_system_glob_tests.h"

#include <string.h>

ZTEST_USER(posix_file_system_glob, test_globfree)
{
	glob_t g;

	/* nothing to free */
	memset(&g, 0, sizeof(g));
	globfree(&g);

	zassert_ok(glob(TEST_ROOT "/*.txt", 0, NULL, &g));
	zassert_equal(g.gl_pathc, 3);
	globfree(&g);
	zassert_is_null(g.gl_pathv);
	/* already freed */
	globfree(&g);

	/* reserved slots are released with the matches */
	memset(&g, 0, sizeof(g));
	g.gl_offs = 2;
	zassert_ok(glob(TEST_ROOT "/*.txt", GLOB_DOOFFS, NULL, &g));
	zassert_ok(glob(TEST_ROOT "/*.dat", GLOB_DOOFFS | GLOB_APPEND, NULL, &g));
	zassert_equal(g.gl_pathc, 4);
	globfree(&g);
	zassert_is_null(g.gl_pathv);
}
```
