## lib/posix/options/priority_scheduling/Kconfig
```kconfig
# Copyright (c) 2023 Intel Corporation
#
# SPDX-License-Identifier: Apache-2.0

menu "POSIX scheduler options"

config POSIX_PRIORITY_SCHEDULING
	bool "POSIX priority-based process scheduling"
	help
	  This enables POSIX scheduling APIs (_POSIX_PRIORITY_SCHEDULING).

	  Since Zephyr does not yet support processes, the process-scoped functions operate on the
	  calling thread: a pid of 0 and the value returned by getpid() both designate the current
	  thread (as on Linux); any other pid fails with ESRCH.

endmenu
```

## lib/posix/options/shared_memory_objects/Kconfig
```kconfig
# SPDX-FileCopyrightText: Copyright The Zephyr Project Contributors
# SPDX-License-Identifier: Apache-2.0

config POSIX_SHARED_MEMORY_OBJECTS
	bool "POSIX shared memory objects"
	select ZVFS
	select ZVFS_FDTABLE
	select ZVFS_SHM
	select POSIX_MAPPED_FILES
	help
	  Select 'y' here and Zephyr will provide implementations of shm_open() and shm_unlink().
```

## lib/posix/options/spawn/Kconfig
```kconfig
# SPDX-FileCopyrightText: Copyright The Zephyr Project Contributors
# SPDX-License-Identifier: Apache-2.0

menuconfig POSIX_SPAWN
	bool "POSIX spawn support"
	select POSIX_MULTI_PROCESS
	select POSIX_SIGNALS
	select POSIX_DEVICE_IO
	select POSIX_FD_MGMT
	select SYS_THREAD
	select COMMON_LIBC_MALLOC
	help
	  Support for the POSIX_SPAWN Option Group: posix_spawn(),
	  posix_spawnp(), spawn attributes, and spawn file actions.

	  Before exec exists, a spawn path names a prelinked executable
	  image resolved through posix_spawn_image_lookup(); the default
	  implementation resolves nothing, and applications or test suites
	  override it with their own registry.

if POSIX_SPAWN

endif # POSIX_SPAWN
```

## lib/posix/options/thread_cputime/Kconfig
```kconfig
# SPDX-FileCopyrightText: Copyright The Zephyr Project Contributors
# SPDX-License-Identifier: Apache-2.0

config POSIX_THREAD_CPUTIME
	bool "POSIX per-thread CPU-time clocks"
	default y
	help
	  This enables CLOCK_THREAD_CPUTIME_ID and the _POSIX_THREAD_CPUTIME option.

	  May be enabled directly or via
	  :kconfig:option:`CONFIG_XSI_ADVANCED_REALTIME_THREADS`.
```

## lib/posix/options/thread_sporadic_server/Kconfig
```kconfig
# Copyright (c) The Zephyr Project Contributors
#
# SPDX-License-Identifier: Apache-2.0

config POSIX_THREAD_SPORADIC_SERVER
	bool "Accept the SCHED_SPORADIC policy in POSIX scheduling interfaces"
	depends on POSIX_THREAD_PRIORITY_SCHEDULING
	help
	  Select 'y' here to enable the Thread Sporadic Server option
	  (_POSIX_THREAD_SPORADIC_SERVER), making the SCHED_SPORADIC scheduling
	  policy and the sched_ss_* members of struct sched_param available.

	  Zephyr accepts SCHED_SPORADIC and validates the sporadic server
	  scheduling parameters, but does not enforce execution-time budgets: a
	  thread scheduled under SCHED_SPORADIC executes as if scheduled under
	  SCHED_RR at sched_priority. See the "Sporadic Server Scheduling"
	  section of the Implementation Details documentation for the rationale.

	  For more information, please see
	  https://pubs.opengroup.org/onlinepubs/9699919799/basedefs/V1_chap02.html
```

## lib/posix/options/xsi_realtime/Kconfig
```kconfig
# Copyright (c) The Zephyr Project Contributors
#
# SPDX-License-Identifier: Apache-2.0

config XSI_REALTIME
	bool "X/Open Realtime"
	depends on XSI
	imply POSIX_FSYNC
	imply POSIX_MEMLOCK
	imply POSIX_MEMLOCK_RANGE
	imply POSIX_MESSAGE_PASSING
	# Not yet implemented, but optional
	# imply POSIX_PRIORITIZED_IO
	imply POSIX_PRIORITY_SCHEDULING
	imply POSIX_SHARED_MEMORY_OBJECTS
	imply POSIX_SYNCHRONIZED_IO
	help
	  Select 'y' here to enable the XSI Realtime option group.

	  This option group consists of the following options:

	  _POSIX_FSYNC, _POSIX_MEMLOCK, _POSIX_MEMLOCK_RANGE, _POSIX_MESSAGE_PASSING,
	  _POSIX_PRIORITIZED_IO (optional), _POSIX_PRIORITY_SCHEDULING,
	  _POSIX_SHARED_MEMORY_OBJECTS, and _POSIX_SYNCHRONIZED_IO.

	  The functionality associated with _POSIX_FSYNC shall always be supported on
	  XSI-conformant systems (:kconfig:option:`CONFIG_XSI`).

	  Support of _POSIX_PRIORITIZED_IO on XSI-conformant systems is optional.

	  When this option group is enabled, the _XOPEN_REALTIME feature test macro
	  will be defined to a value other than -1.

	  For more information, please see
	  https://pubs.opengroup.org/onlinepubs/9699919799/basedefs/V1_chap02.html
```

## lib/posix/pipe/Kconfig
```kconfig
# Copyright (c) The Zephyr Project Contributors
#
# SPDX-License-Identifier: Apache-2.0

config POSIX_PIPE
	bool "POSIX pipe support"
	select ZVFS if !TC_PROVIDES_POSIX_PIPE
	select ZVFS_PIPE if !TC_PROVIDES_POSIX_PIPE
	help
	  Select 'y' here to enable the POSIX_PIPE Option Group; Zephyr will
	  provide an implementation of pipe().

	  The number of concurrently open pipes and the pipe buffer capacity
	  (which is also PIPE_BUF, the atomic write limit) are configured with
	  CONFIG_ZVFS_PIPE_MAX and CONFIG_ZVFS_PIPE_BUF_SIZE.

	  For more information, please see
	  https://pubs.opengroup.org/onlinepubs/9699919799/xrat/V4_subprofiles.html
```

## lib/posix/regexp/Kconfig
```kconfig
# Copyright (c) The Zephyr Project Contributors
#
# SPDX-License-Identifier: Apache-2.0

config POSIX_REGEXP
	bool "POSIX regular expressions"
	help
	  Select 'y' here to enable the POSIX_REGEXP Option Group: regcomp(),
	  regerror(), regexec(), and regfree(), implemented with Henry
	  Spencer's regex engine (the same engine Newlib and Picolibc ship).

	  For more information, please see
	  https://pubs.opengroup.org/onlinepubs/9699919799/xrat/V4_subprofiles.html
```

## lib/posix/rw_locks/Kconfig
```kconfig
# SPDX-FileCopyrightText: Copyright The Zephyr Project Contributors
# SPDX-License-Identifier: Apache-2.0

menuconfig POSIX_RW_LOCKS
	bool "POSIX reader-writer locks"
	# timed waits arm absolute deadlines as absolute 64-bit kernel timeouts
	select TIMEOUT_64BIT
	help
	  Select 'y' here to enable POSIX reader-writer locks.

if POSIX_RW_LOCKS

config MAX_PTHREAD_RWLOCK_COUNT
	int "Maximum number of POSIX reader-writer locks"
	default 5
	help
	  Maximum simultaneously active reader-writer locks in a POSIX application.

	  Note: this is a non-standard option.

module = PTHREAD_RWLOCK
module-str = POSIX Reader-Writer Locks
source "subsys/logging/Kconfig.template.log_config"

endif # POSIX_RW_LOCKS
```

## lib/posix/shell_func/Kconfig
```kconfig
# SPDX-FileCopyrightText: Copyright The Zephyr Project Contributors
# SPDX-License-Identifier: Apache-2.0

config POSIX_SHELL_FUNC
	bool "POSIX shell and utilities"
	depends on ZVFS_FS && LLEXT && FILE_SYSTEM
	select PROCESS if !TC_PROVIDES_POSIX_SHELL_FUNC
	select SYS_PROCESS if !TC_PROVIDES_POSIX_SHELL_FUNC
	select SYS_PROCESS_EXEC if !TC_PROVIDES_POSIX_SHELL_FUNC
	select ZVFS_PIPE if !TC_PROVIDES_POSIX_SHELL_FUNC
	select COMMON_LIBC_MALLOC if !TC_PROVIDES_POSIX_SHELL_FUNC
	help
	  Select 'y' here and Zephyr will provide implementations of the
	  POSIX_SHELL_FUNC Option Group: system(), popen(), pclose(),
	  wordexp(), and wordfree(). The shell is whatever the application
	  installs at /bin/sh (the toybox sample's, for instance), run as a
	  process: each call spawns "sh -c" with the caller's environment.
	  With nothing installed there, system() reports the status of a
	  shell that exited with 127 and popen() fails with ENOENT.

if POSIX_SHELL_FUNC

config POSIX_SHELL_FUNC_POPEN_MAX
	int "Maximum number of streams open through popen()"
	default 4
	range 1 64
	help
	  The number of concurrently open popen() streams, each of which
	  remembers the process pclose() will wait for.

endif # POSIX_SHELL_FUNC
```

## lib/posix/signal_jump/Kconfig
```kconfig
# Copyright (c) The Zephyr Project Contributors
#
# SPDX-License-Identifier: Apache-2.0

config POSIX_SIGNAL_JUMP
	bool "POSIX signal jump support"
	depends on POSIX_SIGNALS
	depends on !NATIVE_BUILD || NATIVE_LIBC
	help
	  Select 'y' here to enable the POSIX_SIGNAL_JUMP Option Group; Zephyr
	  will provide implementations of sigsetjmp() and siglongjmp() on top
	  of the C library's setjmp() and longjmp().

	  Native builds support this option group only with the host C
	  library: with any other C library, setjmp() and longjmp() resolve
	  to the host's symbols, whose jmp_buf is larger than the configured
	  C library's, so setjmp() writes beyond the buffer.

	  For more information, please see
	  https://pubs.opengroup.org/onlinepubs/9699919799/xrat/V4_subprofiles.html
```

## lib/posix/sporadic_server/Kconfig
```kconfig
# Copyright (c) The Zephyr Project Contributors
#
# SPDX-License-Identifier: Apache-2.0

config POSIX_SPORADIC_SERVER
	bool "Accept the SCHED_SPORADIC policy in POSIX process scheduling interfaces"
	depends on POSIX_PRIORITY_SCHEDULING
	help
	  Select 'y' here to enable the Sporadic Server option
	  (_POSIX_SPORADIC_SERVER), making the SCHED_SPORADIC scheduling policy
	  and the sched_ss_* members of struct sched_param available to the
	  process scheduling interfaces of _POSIX_PRIORITY_SCHEDULING.

	  Zephyr accepts SCHED_SPORADIC in sched_get_priority_min() and
	  sched_get_priority_max(), but does not enforce execution-time
	  budgets. The process-addressed scheduling functions (sched_setparam()
	  and sched_setscheduler()) are not yet wired to Zephyr's process
	  support and fail with ENOSYS. See the "Sporadic Server Scheduling"
	  section of the Implementation Details documentation for the rationale.

	  For more information, please see
	  https://pubs.opengroup.org/onlinepubs/9699919799/basedefs/V1_chap02.html
```

## lib/posix/symbolic_links/Kconfig
```kconfig
# SPDX-FileCopyrightText: Copyright The Zephyr Project Contributors
# SPDX-License-Identifier: Apache-2.0

config POSIX_SYMBOLIC_LINKS
	bool "POSIX symbolic links"
	depends on POSIX_FILE_SYSTEM
	help
	  Select 'y' here and Zephyr will provide implementations of the
	  POSIX_SYMBOLIC_LINKS Option Group: lchown(), lstat(), readlink(),
	  and symlink(). Symbolic links require support from the underlying
	  file system driver; on file systems without it, symlink() fails
	  and lstat() is equivalent to stat().
```

## lib/posix/symbolic_links_fd/Kconfig
```kconfig
# SPDX-FileCopyrightText: Copyright The Zephyr Project Contributors
# SPDX-License-Identifier: Apache-2.0

config POSIX_SYMBOLIC_LINKS_FD
	bool "POSIX symbolic links file descriptor routines"
	depends on POSIX_SYMBOLIC_LINKS
	help
	  Select 'y' here and Zephyr will provide implementations of the
	  POSIX_SYMBOLIC_LINKS_FD Option Group: readlinkat() and symlinkat().
```

## lib/posix/user_groups/Kconfig
```kconfig
# SPDX-FileCopyrightText: Copyright The Zephyr Project Contributors
# SPDX-License-Identifier: Apache-2.0

config POSIX_USER_GROUPS
	bool "POSIX user and group identity"
	help
	  Select 'y' here and Zephyr will provide implementations of the
	  POSIX_USER_GROUPS Option Group: getegid(), geteuid(), getgid(),
	  getgroups(), getlogin(), getuid(), and the corresponding setters,
	  modeling a single-user system whose only identity is the
	  privileged user (uid 0, gid 0).
```

## lib/posix/user_groups_r/Kconfig
```kconfig
# SPDX-FileCopyrightText: Copyright The Zephyr Project Contributors
# SPDX-License-Identifier: Apache-2.0

config POSIX_USER_GROUPS_R
	bool "POSIX user and group identity (thread-safe)"
	select POSIX_USER_GROUPS
	help
	  Select 'y' here and Zephyr will provide an implementation of the
	  POSIX_USER_GROUPS_R Option Group: getlogin_r().
```

## lib/posix/xsi_file_system/Kconfig
```kconfig
# Copyright The Zephyr Project Contributors
# SPDX-License-Identifier: Apache-2.0

config XSI_FILE_SYSTEM
	bool "X/Open file system"
	depends on XSI
	select FILE_SYSTEM
	select FS_DIRENT_EXT
	select ZVFS
	select ZVFS_FDTABLE
	select ZVFS_FS
	help
	  Select 'y' here to enable the XSI File System option group:
	  basename(), dirname(), ftw(), lockf(), mknod(), nftw(), realpath(),
	  seekdir(), sync(), telldir() and tempnam().

	  mknod() makes FIFOs and regular files; no device special file exists
	  to create, so any other type is refused with EINVAL.

	  For more information, please see
	  https://pubs.opengroup.org/onlinepubs/9699919799/xrat/V4_subprofiles.html
```

## lib/posix/xsi_signals/Kconfig
```kconfig
# Copyright The Zephyr Project Contributors
# SPDX-License-Identifier: Apache-2.0

config XSI_SIGNALS
	bool "X/Open signals"
	depends on XSI
	select SIGNAL
	help
	  Select 'y' here to enable the XSI Signals option group.

	  When this option is enabled, the following functions are available:
	  killpg(), sigaltstack(), sighold(), sigignore(), siginterrupt(),
	  sigpause(), sigrelse(), sigset().

	  sigaltstack() names a stack for user threads only, and only where the
	  kernel supports alternate signal stacks (CONFIG_SIGNAL_ALTSTACK);
	  otherwise it fails with ENOTSUP.

	  For more information, please see
	  https://pubs.opengroup.org/onlinepubs/9699919799/xrat/V4_subprofiles.html

if XSI_SIGNALS

config SIGNAL_SET_SIZE_MIN_XSI_SIGNALS
	def_int 32
	help
	  The number of signals the XSI signals option group names.

config SIGNAL_QUEUE_SIZE_ADD_XSI_SIGNALS
	def_int 4
	help
	  Number of signal queue entries for the signals killpg() generates.

config SIGNAL_ACTION_DB_SIZE_MIN_XSI_SIGNALS
	def_int 8
	depends on !PROCESS
	help
	  Number of signal action database entries, so that sigset() and sigignore() can
	  install dispositions without SIGNAL_ACTION_DB_SIZE having to be configured by hand.

endif # XSI_SIGNALS
```

## lib/xz/Kconfig
```kconfig
# SPDX-FileCopyrightText: Copyright The Zephyr Project Contributors
# SPDX-License-Identifier: Apache-2.0

menuconfig XZ_DEC
	bool "XZ decompression (XZ Embedded)"
	help
	  The XZ Embedded decoder (0BSD): .xz streams with LZMA2 data and no
	  branch/call/jump filter, CRC32-checked; streams with another check
	  decode unverified.

if XZ_DEC

config XZ_DEC_DICT_MAX
	int "Largest LZMA2 dictionary accepted (bytes)"
	default 4194304
	help
	  A stream's dictionary is allocated from the system heap while it is
	  decoded; one larger than this is refused. Compress with a dictionary
	  no larger than the data (xz --lzma2=preset=9e,dict=2MiB, say): a
	  larger one gains nothing on a file smaller than it.

config XZ_EXTRACT
	bool "Extract an .xz stream into a file"
	depends on FILE_SYSTEM
	default y
	help
	  xz_extract(): decode a stream held in memory, writing the data to a
	  file on a mounted file system, a page at a time.

endif # XZ_DEC
```

## subsys/kcl/Kconfig
```kconfig
# SPDX-FileCopyrightText: Copyright The Zephyr Project Contributors
# SPDX-License-Identifier: Apache-2.0

menuconfig KCL
	bool "Kernel compatibility layers"
	help
	  System call interfaces of other kernels, so that programs built for
	  them run on Zephyr unchanged.

if KCL

rsource "linux/Kconfig"

endif # KCL
```
