## CMakeLists.txt
```
# SPDX-License-Identifier: Apache-2.0

cmake_minimum_required(VERSION 3.20.0)
find_package(Zephyr REQUIRED HINTS $ENV{ZEPHYR_BASE})
project(posix_fifo)

FILE(GLOB app_sources src/*.c)
target_sources(app PRIVATE ${app_sources})

target_compile_options(app PRIVATE -U_POSIX_C_SOURCE -D_POSIX_C_SOURCE=200809L)
target_compile_options(app PRIVATE -U_XOPEN_SOURCE -D_XOPEN_SOURCE=700)
```

## prj.conf
```kconfig
CONFIG_ZTEST=y
CONFIG_POSIX_AEP_CHOICE_PSE52=y
CONFIG_POSIX_FIFO=y

# XSI provides the S_IF* constants and the XSI struct stat members
CONFIG_XSI=y

# FIFO nodes need ext2
CONFIG_FILE_SYSTEM=y
CONFIG_FILE_SYSTEM_EXT2=y
CONFIG_FILE_SYSTEM_MKFS=y
CONFIG_DISK_ACCESS=y
CONFIG_DISK_DRIVER_RAM=y
CONFIG_TEST_RANDOM_GENERATOR=y
CONFIG_EVENTFD=n

CONFIG_ZVFS_PIPE_MAX=2
CONFIG_ZVFS_FIFO_OPEN_MAX=4
CONFIG_ZVFS_OPEN_IGNORE_MIN=y
CONFIG_ZVFS_OPEN_MAX=12
CONFIG_ZVFS_DIR_MAX=4

CONFIG_MAIN_STACK_SIZE=4096
CONFIG_ZTEST_STACK_SIZE=4096
CONFIG_TEST_EXTRA_STACK_SIZE=4096
CONFIG_HEAP_MEM_POOL_SIZE=65536
CONFIG_COMMON_LIBC_MALLOC_ARENA_SIZE=16384

# static stacks/threads: heap-carved user stacks do not fit the fixed heap above;
# the writer's open() runs an ext2 lookup on its stack
CONFIG_SYS_THREAD_STACK_MIN_ADD_TEST=1
CONFIG_SYS_THREAD_THREAD_MIN_ADD_TEST=1
CONFIG_SYS_THREAD_STACK_SIZE=4096
```

## app.overlay
```dts
/*
 * SPDX-FileCopyrightText: Copyright The Zephyr Project Contributors
 *
 * SPDX-License-Identifier: Apache-2.0
 */

/ {
	ramdisk0 {
		compatible = "zephyr,ram-disk";
		disk-name = "RAM";
		sector-size = <512>;
		sector-count = <1024>;
	};
};
```

## src/main.c
```c
/*
 * SPDX-FileCopyrightText: Copyright The Zephyr Project Contributors
 * SPDX-License-Identifier: Apache-2.0
 */

#include "fifo_tests.h"

#include <fcntl.h>
#include <sys/stat.h>
#include <unistd.h>

#include <zephyr/kernel.h>

#ifndef CONFIG_NATIVE_LIBC
#include <zephyr/fs/fs.h>

static struct fs_mount_t fs_mnt = {
	.type = FS_EXT2,
	.mnt_point = "/",
	.storage_dev = (void *)"RAM",
};
#endif

static void before(void *arg)
{
	int fd;

	ARG_UNUSED(arg);

	(void)unlink(TEST_FIFO);
	(void)unlink(TEST_FILE);
	(void)rmdir(TEST_ROOT);
	zassert_ok(mkdir(TEST_ROOT, 0777));
	fd = open(TEST_FILE, O_WRONLY | O_CREAT | O_TRUNC, 0600);
	zassert_true(fd >= 0);
	zassert_ok(close(fd));
}

static void *setup(void)
{
#ifndef CONFIG_NATIVE_LIBC
	zassert_ok(fs_mkfs(FS_EXT2, (uintptr_t)"RAM", NULL, 0));
	zassert_ok(fs_mount(&fs_mnt));
#endif
	(void)mkdir(FS_TMPDIR, 0777);

	return NULL;
}

static void teardown(void *arg)
{
	ARG_UNUSED(arg);

	(void)unlink(TEST_FIFO);
	(void)unlink(TEST_FILE);
	(void)rmdir(TEST_ROOT);
#ifndef CONFIG_NATIVE_LIBC
	(void)fs_unmount(&fs_mnt);
#endif
}

ZTEST_SUITE(posix_fifo, NULL, setup, before, NULL, teardown);
```

## src/fifo_tests.h
```c
/*
 * SPDX-FileCopyrightText: Copyright The Zephyr Project Contributors
 * SPDX-License-Identifier: Apache-2.0
 */

#ifndef POSIX_TESTS_FIFO_TESTS_H_
#define POSIX_TESTS_FIFO_TESTS_H_

#include <zephyr/ztest.h>

#include "../../shared/linux_compat_test.h"

#define FS_TMPDIR    "/tmp"
#define TEST_ROOT    FS_TMPDIR "/pfifo"
#define TEST_FIFO    TEST_ROOT "/fifo"
#define TEST_FILE    TEST_ROOT "/file.txt"
#define TEST_NOENT   TEST_ROOT "/nope"
#define TEST_MESSAGE "through the fifo"

#endif /* POSIX_TESTS_FIFO_TESTS_H_ */
```

## src/mkfifo.c
```c
/*
 * SPDX-FileCopyrightText: Copyright The Zephyr Project Contributors
 * SPDX-License-Identifier: Apache-2.0
 */

#include "fifo_tests.h"

#include <errno.h>
#include <fcntl.h>
#include <pthread.h>
#include <string.h>
#include <sys/stat.h>
#include <unistd.h>

static void mkfifo_node(void)
{
	struct stat st;

	zassert_ok(mkfifo(TEST_FIFO, 0644));
	zassert_ok(stat(TEST_FIFO, &st));
	zassert_true(S_ISFIFO(st.st_mode));
	zassert_equal(st.st_size, 0);

	errno = 0;
	zassert_equal(mkfifo(TEST_FIFO, 0644), -1);
	zassert_equal(errno, EEXIST);
	errno = 0;
	zassert_equal(mkfifo(TEST_FILE, 0644), -1);
	zassert_equal(errno, EEXIST);
	errno = 0;
	zassert_equal(mkfifo(TEST_NOENT "/fifo", 0644), -1);
	zassert_equal(errno, ENOENT);
}

/* the other side of the exchange: opens for writing, sends the message, leaves */
static void *fifo_writer(void *arg)
{
	int fd = open(TEST_FIFO, O_WRONLY);

	ARG_UNUSED(arg);

	if (fd < 0) {
		return (void *)(intptr_t)errno;
	}
	if (write(fd, TEST_MESSAGE, strlen(TEST_MESSAGE)) != (ssize_t)strlen(TEST_MESSAGE)) {
		return (void *)(intptr_t)errno;
	}
	if (close(fd) < 0) {
		return (void *)(intptr_t)errno;
	}

	return NULL;
}

static void mkfifo_exchange(void)
{
	char buf[sizeof(TEST_MESSAGE)];
	pthread_t writer;
	void *status;
	int fd;

	/* the writer blocks in open() until a reader arrives */
	zassert_ok(pthread_create(&writer, NULL, fifo_writer, NULL));
	fd = open(TEST_FIFO, O_RDONLY);
	zassert_true(fd >= 0, "open(fifo) failed: %d", errno);

	zassert_equal(read(fd, buf, sizeof(buf)), strlen(TEST_MESSAGE));
	zassert_mem_equal(buf, TEST_MESSAGE, strlen(TEST_MESSAGE));
	zassert_ok(pthread_join(writer, &status));
	zassert_is_null(status, "writer failed: %d", (int)(intptr_t)status);

	/* the last writer gone and the pipe drained: end-of-file */
	zassert_equal(read(fd, buf, sizeof(buf)), 0);
	zassert_ok(close(fd));
}

static void mkfifo_nonblock(void)
{
	char buf[8];
	int rfd, wfd;

	/* a writer needs a reader; a reader proceeds alone */
	errno = 0;
	zassert_equal(open(TEST_FIFO, O_WRONLY | O_NONBLOCK), -1);
	zassert_equal(errno, ENXIO);

	rfd = open(TEST_FIFO, O_RDONLY | O_NONBLOCK);
	zassert_true(rfd >= 0, "open(fifo, nonblock) failed: %d", errno);
	/* nobody writing: end-of-file, not "try again" */
	zassert_equal(read(rfd, buf, sizeof(buf)), 0);

	wfd = open(TEST_FIFO, O_WRONLY | O_NONBLOCK);
	zassert_true(wfd >= 0, "open(fifo, nonblock) failed: %d", errno);
	/* a writer connected but silent: try again */
	errno = 0;
	zassert_equal(read(rfd, buf, sizeof(buf)), -1);
	zassert_equal(errno, EAGAIN);
	zassert_equal(write(wfd, "ab", 2), 2);
	zassert_equal(read(rfd, buf, sizeof(buf)), 2);
	zassert_mem_equal(buf, "ab", 2);
	zassert_ok(close(wfd));
	zassert_equal(read(rfd, buf, sizeof(buf)), 0);
	zassert_ok(close(rfd));

	/* the exchange can start over once everyone has left */
	rfd = open(TEST_FIFO, O_RDONLY | O_NONBLOCK);
	zassert_true(rfd >= 0);
	wfd = open(TEST_FIFO, O_WRONLY);
	zassert_true(wfd >= 0);
	zassert_ok(close(wfd));
	zassert_ok(close(rfd));

	/* opening for both directions is undefined; refused here, taken by the host */
	IF_NOT_NATIVE_LIBC({
		errno = 0;
		zassert_equal(open(TEST_FIFO, O_RDWR), -1);
		zassert_equal(errno, EINVAL);
	});
}

static void mkfifo_remove(void)
{
	struct stat st;

	zassert_ok(unlink(TEST_FIFO));
	errno = 0;
	zassert_equal(stat(TEST_FIFO, &st), -1);
	zassert_equal(errno, ENOENT);
}

ZTEST_USER(posix_fifo, test_mkfifo)
{
	mkfifo_node();
	mkfifo_exchange();
	mkfifo_nonblock();
	mkfifo_remove();
}
```
