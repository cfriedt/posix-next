## CMakeLists.txt
```
# SPDX-License-Identifier: Apache-2.0

cmake_minimum_required(VERSION 3.20.0)
find_package(Zephyr REQUIRED HINTS $ENV{ZEPHYR_BASE})
project(posix_file_attributes_fd)

FILE(GLOB app_sources src/*.c)
target_sources(app PRIVATE ${app_sources})

target_compile_options(app PRIVATE -U_POSIX_C_SOURCE -D_POSIX_C_SOURCE=200809L)
target_compile_options(app PRIVATE -U_XOPEN_SOURCE -D_XOPEN_SOURCE=700)
```

## prj.conf
```kconfig
CONFIG_ZTEST=y

CONFIG_POSIX_AEP_CHOICE_PSE52=y
CONFIG_POSIX_FILE_SYSTEM_FD=y
CONFIG_POSIX_FILE_ATTRIBUTES=y
CONFIG_POSIX_FILE_ATTRIBUTES_FD=y
# XSI provides the S_IF* constants and the XSI struct stat members
CONFIG_XSI=y

# a file system that records modes and owners
CONFIG_FILE_SYSTEM=y
CONFIG_FILE_SYSTEM_TMPFS=y

CONFIG_EVENTFD=n

# stdio (3) + fixture rw/ro (2) + directory streams + scratch
CONFIG_ZVFS_OPEN_IGNORE_MIN=y
CONFIG_ZVFS_OPEN_MAX=12
CONFIG_ZVFS_DIR_MAX=4

CONFIG_MAIN_STACK_SIZE=4096
CONFIG_ZTEST_STACK_SIZE=4096
CONFIG_TEST_EXTRA_STACK_SIZE=4096

CONFIG_HEAP_MEM_POOL_SIZE=16384
CONFIG_COMMON_LIBC_MALLOC_ARENA_SIZE=16384
```

## src/main.c
```c
/*
 * SPDX-FileCopyrightText: Copyright The Zephyr Project Contributors
 * SPDX-License-Identifier: Apache-2.0
 */

#include "file_attributes_fd_tests.h"

#include <fcntl.h>
#include <stdio.h>
#include <string.h>
#include <sys/stat.h>
#include <unistd.h>

#include <zephyr/kernel.h>
#ifndef CONFIG_NATIVE_LIBC
#include <zephyr/fs/fs.h>
#endif
#ifdef CONFIG_USERSPACE
#include <zephyr/sys/fdtable.h>
#include <zephyr/sys/internal/fdtable_priv.h>
extern struct k_mem_partition zvfs_dir_partition;
#endif

ZTEST_BMEM int fs_test_fd = -1;
ZTEST_BMEM int fs_test_rofd = -1;

#ifndef CONFIG_NATIVE_LIBC
static struct fs_mount_t fs_mnt = {
	.type = FS_TMPFS,
	.mnt_point = "/",
};
#endif

static void grant_fd(int fd)
{
#ifdef CONFIG_USERSPACE
	if (fd >= 0) {
		k_object_access_all_grant(zvfs_fd_entry_get(fd));
	}
#else
	ARG_UNUSED(fd);
#endif
}

/*
 * Remove a whole subtree. The Zephyr path uses the fs_* API directly, as
 * the rest of the fixture does; under the host libc, plain POSIX calls.
 */
#ifdef CONFIG_NATIVE_LIBC
#include <dirent.h>
static void rmtree(const char *path)
{
	DIR *d = opendir(path);
	struct dirent *e;
	char child[300];

	if (d != NULL) {
		while ((e = readdir(d)) != NULL) {
			if (strcmp(e->d_name, ".") == 0 || strcmp(e->d_name, "..") == 0) {
				continue;
			}
			if (snprintf(child, sizeof(child), "%s/%s", path, e->d_name) >=
			    (int)sizeof(child)) {
				continue;
			}
			rmtree(child);
		}
		closedir(d);
		rmdir(path);
		return;
	}

	(void)unlink(path);
}
#else
/* tmpfs skips an entry removed mid-iteration: take the first entry of a fresh stream each pass */
static void rmtree(const char *path)
{
	struct fs_dir_t dir;
	struct fs_dirent ent;
	char child[300];

	for (;;) {
		fs_dir_t_init(&dir);
		if (fs_opendir(&dir, path) != 0) {
			break;
		}
		if ((fs_readdir(&dir, &ent) != 0) || (ent.name[0] == '\0')) {
			fs_closedir(&dir);
			break;
		}
		fs_closedir(&dir);
		if (snprintf(child, sizeof(child), "%s/%s", path, ent.name) >= (int)sizeof(child)) {
			break;
		}
		rmtree(child);
	}

	(void)fs_unlink(path);
}
#endif

void fs_test_reset(void)
{
	int fd;

	rmtree(TEST_ROOT);

	zassert_ok(mkdir(TEST_ROOT, 0777));

	fd = open(TEST_FILE, O_WRONLY | O_CREAT | O_TRUNC, 0600);
	zassert_true(fd >= 0);
	zassert_equal(write(fd, TEST_CONTENT, strlen(TEST_CONTENT)), strlen(TEST_CONTENT));
	zassert_ok(close(fd));

	fd = open(TEST_EMPTY, O_WRONLY | O_CREAT | O_TRUNC, 0600);
	zassert_true(fd >= 0);
	zassert_ok(close(fd));

	zassert_ok(mkdir(TEST_DIR, 0777));
	fd = open(TEST_SUB, O_WRONLY | O_CREAT, 0600);
	zassert_true(fd >= 0);
	zassert_ok(close(fd));

	(void)unlink(TEST_NOENT);
}

static void before(void *arg)
{
	ARG_UNUSED(arg);

	fs_test_reset();

	fs_test_fd = open(TEST_FILE, O_RDWR);
	zassert_true(fs_test_fd >= 0);
	grant_fd(fs_test_fd);

	fs_test_rofd = open(TEST_FILE, O_RDONLY);
	zassert_true(fs_test_rofd >= 0);
	grant_fd(fs_test_rofd);

	{ int rc = chdir("/"); ARG_UNUSED(rc); }
}

static void after(void *arg)
{
	ARG_UNUSED(arg);

	if (fs_test_fd >= 0) {
		close(fs_test_fd);
		fs_test_fd = -1;
	}
	if (fs_test_rofd >= 0) {
		close(fs_test_rofd);
		fs_test_rofd = -1;
	}
	{ int rc = chdir("/"); ARG_UNUSED(rc); }
}

static void *setup(void)
{
#ifndef CONFIG_NATIVE_LIBC
	zassert_ok(fs_mount(&fs_mnt));
#endif
	(void)mkdir(FS_TMPDIR, 0777);
#ifdef CONFIG_USERSPACE
	zassert_ok(k_mem_domain_add_partition(&k_mem_domain_default, &zvfs_dir_partition));
#endif
	return NULL;
}

static void teardown(void *arg)
{
	ARG_UNUSED(arg);
#ifndef CONFIG_NATIVE_LIBC
	rmtree(TEST_ROOT);
	(void)fs_unmount(&fs_mnt);
#endif
}

ZTEST_SUITE(posix_file_attributes_fd, NULL, setup, before, after, teardown);
```

## src/fchmodat.c
```c
/*
 * SPDX-FileCopyrightText: Copyright The Zephyr Project Contributors
 * SPDX-License-Identifier: Apache-2.0
 */

#include "file_attributes_fd_tests.h"

#include <errno.h>
#include <fcntl.h>
#include <sys/stat.h>
#include <unistd.h>

static mode_t perm_of(const char *path)
{
	struct stat st;

	zassert_ok(stat(path, &st), "stat %s: %d", path, errno);

	return st.st_mode & 07777;
}

ZTEST_USER(posix_file_attributes_fd, test_fchmodat)
{
	int dirfd = open(TEST_ROOT, O_RDONLY | O_DIRECTORY);

	zassert_true(dirfd >= 0, "open(" TEST_ROOT ") failed: %d", errno);

	zassert_ok(fchmodat(dirfd, "file.txt", 0644, 0));
	zassert_equal(perm_of(TEST_FILE), 0644, "0%o", perm_of(TEST_FILE));
	/* the flag only matters for a symbolic link */
	zassert_ok(fchmodat(dirfd, "dir", 0755, AT_SYMLINK_NOFOLLOW));
	zassert_equal(perm_of(TEST_DIR), 0755, "0%o", perm_of(TEST_DIR));
	zassert_ok(fchmodat(AT_FDCWD, TEST_FILE, 0600, 0));
	zassert_equal(perm_of(TEST_FILE), 0600, "0%o", perm_of(TEST_FILE));

	errno = 0;
	zassert_equal(fchmodat(dirfd, "nope.txt", 0644, 0), -1);
	zassert_equal(errno, ENOENT);

	errno = 0;
	zassert_equal(fchmodat(fs_test_fd, "file.txt", 0644, 0), -1);
	zassert_equal(errno, ENOTDIR);

	errno = 0;
	zassert_equal(fchmodat(dirfd, "file.txt", 0644, AT_REMOVEDIR), -1);
	zassert_equal(errno, EINVAL);

	zassert_ok(close(dirfd));
}
```

## src/fchownat.c
```c
/*
 * SPDX-FileCopyrightText: Copyright The Zephyr Project Contributors
 * SPDX-License-Identifier: Apache-2.0
 */

#include "file_attributes_fd_tests.h"

#include <errno.h>
#include <fcntl.h>
#include <sys/stat.h>
#include <unistd.h>

ZTEST_USER(posix_file_attributes_fd, test_fchownat)
{
	int dirfd = open(TEST_ROOT, O_RDONLY | O_DIRECTORY);

	zassert_true(dirfd >= 0, "open(" TEST_ROOT ") failed: %d", errno);

	/* the owning identity (a host user cannot give files away), and "leave unchanged" */
	zassert_ok(fchownat(dirfd, "file.txt", IS_ENABLED(CONFIG_NATIVE_LIBC) ? (uid_t)-1 : 0,
			    IS_ENABLED(CONFIG_NATIVE_LIBC) ? (gid_t)-1 : 0, 0));
	zassert_ok(fchownat(dirfd, "file.txt", (uid_t)-1, (gid_t)-1, AT_SYMLINK_NOFOLLOW));
	zassert_ok(fchownat(AT_FDCWD, TEST_FILE, (uid_t)-1, (gid_t)-1, 0));

	errno = 0;
	zassert_equal(fchownat(dirfd, "nope.txt", (uid_t)-1, (gid_t)-1, 0), -1);
	zassert_equal(errno, ENOENT);

	errno = 0;
	zassert_equal(fchownat(fs_test_fd, "file.txt", (uid_t)-1, (gid_t)-1, 0), -1);
	zassert_equal(errno, ENOTDIR);

	errno = 0;
	zassert_equal(fchownat(dirfd, "file.txt", (uid_t)-1, (gid_t)-1, AT_REMOVEDIR), -1);
	zassert_equal(errno, EINVAL);

	/* the privileged identity may give a file to anyone; -1 keeps the other ID */
	IF_NOT_NATIVE_LIBC({
		struct stat st;

		zassert_ok(fchownat(dirfd, "file.txt", 1000, (gid_t)-1, 0));
		zassert_ok(fstatat(dirfd, "file.txt", &st, 0));
		zassert_equal(st.st_uid, 1000);
		zassert_equal(st.st_gid, 0);
		zassert_ok(fchownat(dirfd, "file.txt", (uid_t)-1, 100, 0));
		zassert_ok(stat(TEST_FILE, &st));
		zassert_equal(st.st_uid, 1000);
		zassert_equal(st.st_gid, 100);
	});

	zassert_ok(close(dirfd));
}
```

## src/file_attributes_fd_tests.h
```c
/*
 * SPDX-FileCopyrightText: Copyright The Zephyr Project Contributors
 * SPDX-License-Identifier: Apache-2.0
 */

#ifndef POSIX_TESTS_FILE_ATTRIBUTES_FD_TESTS_H_
#define POSIX_TESTS_FILE_ATTRIBUTES_FD_TESTS_H_

#include <zephyr/ztest.h>

#include "../../shared/linux_compat_test.h"

/*
 * The file system is mounted at "/", and /tmp exists in both worlds (the tmpfs
 * under Zephyr, the host filesystem under CONFIG_NATIVE_LIBC), so
 * every path constant is identical for the linux_compat variant.
 */
#define FS_TMPDIR   "/tmp"
#define TEST_ROOT   FS_TMPDIR "/pfafd"
#define TEST_FILE   TEST_ROOT "/file.txt"
#define TEST_EMPTY  TEST_ROOT "/empty.txt"
#define TEST_DIR    TEST_ROOT "/dir"
#define TEST_SUB    TEST_DIR "/sub.txt"
#define TEST_NOENT  TEST_ROOT "/nope.txt"
#define TEST_CONTENT "The quick brown fox jumps over the lazy dog!"

/* fixture descriptors, opened and granted per test */
extern int fs_test_fd;   /* TEST_FILE, O_RDWR */
extern int fs_test_rofd; /* TEST_FILE, O_RDONLY */

/* rebuild the baseline tree; kernel-mode machinery, used from before() */
void fs_test_reset(void);

#endif /* POSIX_TESTS_FILE_ATTRIBUTES_FD_TESTS_H_ */
```
