## CMakeLists.txt
```
# SPDX-License-Identifier: Apache-2.0

cmake_minimum_required(VERSION 3.20.0)
find_package(Zephyr REQUIRED HINTS $ENV{ZEPHYR_BASE})
project(posix_sporadic_server)

target_sources(app PRIVATE
  src/main.c
  src/sched_get_priority_max.c
  src/sched_get_priority_min.c
  src/sched_getparam.c
  src/sched_getscheduler.c
  src/sched_setparam.c
  src/sched_setscheduler.c
)

target_compile_options(app PRIVATE -U_POSIX_C_SOURCE -D_POSIX_C_SOURCE=200809L)
```

## prj.conf
```kconfig
CONFIG_ZTEST=y

CONFIG_POSIX_AEP_CHOICE_BASE=y
CONFIG_POSIX_PRIORITY_SCHEDULING=y
CONFIG_POSIX_SPORADIC_SERVER=y
```

## src/main.c
```c
/*
 * SPDX-FileCopyrightText: Copyright The Zephyr Project Contributors
 * SPDX-License-Identifier: Apache-2.0
 */

#include <limits.h>
#include <sched.h>
#include <unistd.h>

#include <zephyr/ztest.h>

BUILD_ASSERT(_POSIX_SPORADIC_SERVER == 200809L, "_POSIX_SPORADIC_SERVER is not defined to 200809L");
BUILD_ASSERT((SCHED_SPORADIC != SCHED_OTHER) && (SCHED_SPORADIC != SCHED_FIFO) &&
		     (SCHED_SPORADIC != SCHED_RR),
	     "SCHED_SPORADIC is not distinct from the other scheduling policies");
BUILD_ASSERT(_POSIX_SS_REPL_MAX >= 4, "_POSIX_SS_REPL_MAX is below the POSIX minimum");
#ifdef SS_REPL_MAX
BUILD_ASSERT(SS_REPL_MAX >= _POSIX_SS_REPL_MAX, "SS_REPL_MAX is below the POSIX minimum");
#endif

ZTEST_SUITE(posix_sporadic_server, NULL, NULL, NULL, NULL, NULL);
```

## src/sched_get_priority_max.c
```c
/*
 * SPDX-FileCopyrightText: Copyright The Zephyr Project Contributors
 * SPDX-License-Identifier: Apache-2.0
 */

#include <sched.h>

#include <zephyr/ztest.h>

ZTEST_USER(posix_sporadic_server, test_sched_get_priority_max)
{
	int min = sched_get_priority_min(SCHED_SPORADIC);
	int max = sched_get_priority_max(SCHED_SPORADIC);

	zassert_true(max >= 0, "sched_get_priority_max(SCHED_SPORADIC) returned %d", max);
	zassert_true(max >= min, "max (%d) < min (%d) for SCHED_SPORADIC", max, min);
}
```

## src/sched_get_priority_min.c
```c
/*
 * SPDX-FileCopyrightText: Copyright The Zephyr Project Contributors
 * SPDX-License-Identifier: Apache-2.0
 */

#include <sched.h>

#include <zephyr/ztest.h>

ZTEST_USER(posix_sporadic_server, test_sched_get_priority_min)
{
	int min = sched_get_priority_min(SCHED_SPORADIC);

	zassert_true(min >= 0, "sched_get_priority_min(SCHED_SPORADIC) returned %d", min);
}
```

## src/sched_getparam.c
```c
/*
 * SPDX-FileCopyrightText: Copyright The Zephyr Project Contributors
 * SPDX-License-Identifier: Apache-2.0
 */

#include <errno.h>
#include <sched.h>

#include <zephyr/ztest.h>

ZTEST_USER(posix_sporadic_server, test_sched_getparam)
{
	struct sched_param param = {0};
	int rc = sched_getparam(0, &param);
	int err = errno;

	/* process-addressed scheduling functions are documented ENOSYS stubs */
	zassert_true((rc == -1) && (err == ENOSYS), "rc: %d errno: %d", rc, err);
}
```

## src/sched_getscheduler.c
```c
/*
 * SPDX-FileCopyrightText: Copyright The Zephyr Project Contributors
 * SPDX-License-Identifier: Apache-2.0
 */

#include <errno.h>
#include <sched.h>

#include <zephyr/ztest.h>

ZTEST_USER(posix_sporadic_server, test_sched_getscheduler)
{
	int rc = sched_getscheduler(0);
	int err = errno;

	/* process-addressed scheduling functions are documented ENOSYS stubs */
	zassert_true((rc == -1) && (err == ENOSYS), "rc: %d errno: %d", rc, err);
}
```

## src/sched_setparam.c
```c
/*
 * SPDX-FileCopyrightText: Copyright The Zephyr Project Contributors
 * SPDX-License-Identifier: Apache-2.0
 */

#include <errno.h>
#include <sched.h>

#include <zephyr/ztest.h>

#include "sporadic_server_tests.h"

ZTEST_USER(posix_sporadic_server, test_sched_setparam)
{
	struct sched_param param = sporadic_param(sched_get_priority_min(SCHED_SPORADIC));
	int rc = sched_setparam(0, &param);
	int err = errno;

	/* process-addressed scheduling functions are documented ENOSYS stubs */
	zassert_true((rc == -1) && (err == ENOSYS), "rc: %d errno: %d", rc, err);
}
```

## src/sched_setscheduler.c
```c
/*
 * SPDX-FileCopyrightText: Copyright The Zephyr Project Contributors
 * SPDX-License-Identifier: Apache-2.0
 */

#include <errno.h>
#include <sched.h>

#include <zephyr/ztest.h>

#include "sporadic_server_tests.h"

ZTEST_USER(posix_sporadic_server, test_sched_setscheduler)
{
	struct sched_param param = sporadic_param(sched_get_priority_min(SCHED_SPORADIC));
	int rc = sched_setscheduler(0, SCHED_SPORADIC, &param);
	int err = errno;

	/* process-addressed scheduling functions are documented ENOSYS stubs */
	zassert_true((rc == -1) && (err == ENOSYS), "rc: %d errno: %d", rc, err);
}
```

## src/sporadic_server_tests.h
```c
/*
 * SPDX-FileCopyrightText: Copyright The Zephyr Project Contributors
 * SPDX-License-Identifier: Apache-2.0
 */

#ifndef TESTS_POSIX_SPORADIC_SERVER_SRC_SPORADIC_SERVER_TESTS_H_
#define TESTS_POSIX_SPORADIC_SERVER_SRC_SPORADIC_SERVER_TESTS_H_

#include <limits.h>
#include <sched.h>

static inline struct sched_param sporadic_param(int priority)
{
	return (struct sched_param){
		.sched_priority = priority,
		.sched_ss_low_priority = sched_get_priority_min(SCHED_SPORADIC),
		.sched_ss_repl_period = {.tv_sec = 1, .tv_nsec = 0},
		.sched_ss_init_budget = {.tv_sec = 0, .tv_nsec = 100000000},
		.sched_ss_max_repl = 1,
	};
}

#endif /* TESTS_POSIX_SPORADIC_SERVER_SRC_SPORADIC_SERVER_TESTS_H_ */
```
