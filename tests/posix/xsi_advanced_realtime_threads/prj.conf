## CMakeLists.txt
```
# SPDX-License-Identifier: Apache-2.0

cmake_minimum_required(VERSION 3.20.0)
find_package(Zephyr REQUIRED HINTS $ENV{ZEPHYR_BASE})
project(xsi_advanced_realtime_threads)

FILE(GLOB app_sources src/*.c)

target_sources(app PRIVATE ${app_sources})

target_compile_options(app PRIVATE -U_POSIX_C_SOURCE -D_POSIX_C_SOURCE=200809L)
target_compile_options(app PRIVATE -U_XOPEN_SOURCE -D_XOPEN_SOURCE=700)
```

## prj.conf
```kconfig
CONFIG_ZTEST=y

CONFIG_POSIX_AEP_CHOICE_BASE=y
CONFIG_XSI=y
CONFIG_XSI_ADVANCED_REALTIME_THREADS=y
CONFIG_HEAP_MEM_POOL_SIZE=16384
```

## src/getcpuclockid.c
```c
/*
 * Copyright (c) 2025 Friedt Professional Engineering Services, Inc.
 *
 * SPDX-License-Identifier: Apache-2.0
 */

#include <pthread.h>
#include <time.h>

#include <zephyr/ztest.h>

ZTEST(xsi_advanced_realtime_threads, test_pthread_getcpuclockid)
{
#if defined(_POSIX_THREAD_CPUTIME)
	clockid_t clock_id = (clockid_t)-1;

	zassert_equal(pthread_getcpuclockid(pthread_self(), NULL), EINVAL);
	zassert_ok(pthread_getcpuclockid(pthread_self(), &clock_id));
	zassert_equal(clock_id, CLOCK_THREAD_CPUTIME_ID);
#else
	ztest_test_skip();
#endif
}

ZTEST_SUITE(xsi_advanced_realtime_threads, NULL, NULL, NULL, NULL, NULL);
```
