## CMakeLists.txt
```
# SPDX-License-Identifier: Apache-2.0

cmake_minimum_required(VERSION 3.20.0)
find_package(Zephyr REQUIRED HINTS $ENV{ZEPHYR_BASE})
project(posix_c_lang_support_r)

set(ZEPHYR_C_LIB_COMMON ${ZEPHYR_BASE}/tests/lib/c_lib/common/src)

FILE(GLOB app_sources src/*.c)

target_sources(app PRIVATE ${app_sources})
target_sources(app PRIVATE
  ${ZEPHYR_C_LIB_COMMON}/strtok_test_data.c
  ${ZEPHYR_C_LIB_COMMON}/qsort_test_data.c
)
target_compile_options(app PRIVATE -U_POSIX_C_SOURCE -D_POSIX_C_SOURCE=200809L)
```

## Kconfig
```
# Copyright (c) 2025 Friedt Professional Engineering Services, Inc.
# SPDX-License-Identifier: Apache-2.0

rsource "../Kconfig.test_common"
source "Kconfig.zephyr"

config TEST_POSIX_LINUX_COMPAT
	bool "Test POSIX suites are compatible with Linux"
	help
	  This option is used to verify that the POSIX testsuites pass on Linux. It is for exclusive
	  use with native_sim, and CONFIG_TC_PROVIDES_<OPTION_GROUP>=y must be set for the testsuite
	  (option group). The "DUT" in this case becomes the testsuite itself. By transitive
	  property, we can say approximately that if Linux passes against the testsuite, and Zephyr
	  passes the testsuite, then Linux and Zephyr are approximately compatible, to the extent of
	  coverage provided by the testsuite.
```

## prj.conf
```kconfig
CONFIG_ZTEST=y

CONFIG_POSIX_C_LANG_SUPPORT_R=y
CONFIG_MINIMAL_LIBC_NON_REENTRANT_FUNCTIONS=y
CONFIG_MINIMAL_LIBC_TIME=y
```

## src/_main.c
```c
/*
 * Copyright (c) 2026 The Zephyr Project Contributors
 *
 * SPDX-License-Identifier: Apache-2.0
 */

#include <zephyr/ztest.h>

ZTEST_SUITE(posix_c_lang_support_r, NULL, NULL, NULL, NULL, NULL);
```

## src/asctime_r.c
```c
/*
 * Copyright (c) 2017 Intel Corporation
 *
 * SPDX-License-Identifier: Apache-2.0
 */

#include <string.h>
#include <time.h>

#include <zephyr/ztest.h>

ZTEST_USER(posix_c_lang_support_r, test_asctime_r)
{
	char buf[26] = { 0 };
	struct tm tp = {
		.tm_sec = 10,   /* Seconds */
		.tm_min = 30,   /* Minutes */
		.tm_hour = 14,  /* Hour (24-hour format) */
		.tm_wday = 5,   /* Day of the week (0-6, 0 = Sun) */
		.tm_mday = 1,   /* Day of the month */
		.tm_mon = 5,    /* Month (0-11, January = 0) */
		.tm_year = 124, /* Year (current year - 1900) */
	};

	zassert_not_null(asctime_r(&tp, buf));
	zassert_ok(strncmp("Fri Jun  1 14:30:10 2024\n", buf, sizeof(buf)));
}
```

## src/ctime_r.c
```c
/*
 * Copyright (c) 2017 Intel Corporation
 *
 * SPDX-License-Identifier: Apache-2.0
 */

#include <stdlib.h>
#include <string.h>
#include <time.h>

#include <zephyr/ztest.h>

ZTEST(posix_c_lang_support_r, test_ctime_r)
{
	char buf[26] = { 0 };
	time_t test1 = 1718260000;

#ifdef CONFIG_NATIVE_LIBC
	setenv("TZ", "UTC", 1);
#endif
	zassert_not_null(ctime_r(&test1, buf));
	zassert_ok(strncmp("Thu Jun 13 06:26:40 2024\n", buf, sizeof(buf)));
}
```

## src/gmtime_r.c
```c
/*
 * Copyright (c) 2017 Intel Corporation
 * Copyright (c) 2025 Friedt Professional Engineering Services, Inc.
 *
 * SPDX-License-Identifier: Apache-2.0
 */

#include <time.h>

#include <zephyr/sys/util.h>
#include <zephyr/ztest.h>

struct time_r_test_data {
	time_t ux;
	struct tm tm;
};

static void check_gmtime_r(const struct time_r_test_data *tp)
{
	struct tm result = { .tm_isdst = 1234 };
	struct tm *ret;
	long long ux = (long long)tp->ux;

	ret = gmtime_r(&tp->ux, &result);
	zassert_equal(&result, ret, "gmtime_r returned unexpected pointer");

	zassert_equal(tp->tm.tm_sec, result.tm_sec, "sec mismatch for ux %lld", ux);
	zassert_equal(tp->tm.tm_min, result.tm_min, "min mismatch for ux %lld", ux);
	zassert_equal(tp->tm.tm_hour, result.tm_hour, "hour mismatch for ux %lld", ux);
	zassert_equal(tp->tm.tm_mday, result.tm_mday, "mday mismatch for ux %lld", ux);
	zassert_equal(tp->tm.tm_mon, result.tm_mon, "mon mismatch for ux %lld", ux);
	zassert_equal(tp->tm.tm_year, result.tm_year, "year mismatch for ux %lld", ux);
	zassert_equal(tp->tm.tm_wday, result.tm_wday, "wday mismatch for ux %lld", ux);
	zassert_equal(tp->tm.tm_yday, result.tm_yday, "yday mismatch for ux %lld", ux);
}

ZTEST_USER(posix_c_lang_support_r, test_gmtime_r)
{
	static const struct time_r_test_data tests[] = {
		{
			.ux = 0,
			.tm = {
				.tm_sec = 0, .tm_min = 0, .tm_hour = 0, .tm_mday = 1,
				.tm_mon = 0, .tm_year = 70, .tm_wday = 4, .tm_yday = 0,
			},
		},
		{
			.ux = -1,
			.tm = {
				.tm_sec = 59, .tm_min = 59, .tm_hour = 23, .tm_mday = 31,
				.tm_mon = 11, .tm_year = 69, .tm_wday = 3, .tm_yday = 364,
			},
		},
		{
			.ux = 1561994005,
			.tm = {
				.tm_sec = 25, .tm_min = 13, .tm_hour = 15, .tm_mday = 1,
				.tm_mon = 6, .tm_year = 119, .tm_wday = 1, .tm_yday = 181,
			},
		},
		{
			.ux = 951868800,
			.tm = {
				.tm_sec = 0, .tm_min = 0, .tm_hour = 0, .tm_mday = 1,
				.tm_mon = 2, .tm_year = 100, .tm_wday = 3, .tm_yday = 60,
			},
		},
	};

	time_t tests3 = (time_t)-214748364800;
	time_t tests4 = 951868800;
	struct tm tp;

	tp.tm_wday = -5;
	zassert_not_null(gmtime_r(&tests3, &tp), "gmtime_r failed");
	zassert_not_null(gmtime_r(&tests4, &tp), "gmtime_r failed");

	for (size_t i = 0; i < ARRAY_SIZE(tests); ++i) {
		check_gmtime_r(&tests[i]);
	}
}
```

## src/localtime_r.c
```c
/*
 * Copyright (c) 2017 Intel Corporation
 *
 * SPDX-License-Identifier: Apache-2.0
 */

#include <stdlib.h>
#include <time.h>

#include <zephyr/ztest.h>

ZTEST(posix_c_lang_support_r, test_localtime_r)
{
	time_t tests3 = (time_t)-214748364800;
	time_t tests4 = 951868800;
	time_t ux = 1718260000;
	struct tm tp;
	struct tm gm = { 0 };
	struct tm local = { 0 };

	tp.tm_wday = -5;
	zassert_not_null(localtime_r(&tests3, &tp), "localtime_r failed");
	zassert_not_null(localtime_r(&tests4, &tp), "localtime_r failed");

	zassert_not_null(gmtime_r(&ux, &gm), "gmtime_r failed");
#ifdef CONFIG_NATIVE_LIBC
	setenv("TZ", "UTC", 1);
#endif
	zassert_not_null(localtime_r(&ux, &local), "localtime_r failed");
	zassert_equal(gm.tm_sec, local.tm_sec, "sec mismatch");
	zassert_equal(gm.tm_min, local.tm_min, "min mismatch");
	zassert_equal(gm.tm_hour, local.tm_hour, "hour mismatch");
	zassert_equal(gm.tm_mday, local.tm_mday, "mday mismatch");
	zassert_equal(gm.tm_mon, local.tm_mon, "mon mismatch");
	zassert_equal(gm.tm_year, local.tm_year, "year mismatch");
	zassert_equal(gm.tm_wday, local.tm_wday, "wday mismatch");
	zassert_equal(gm.tm_yday, local.tm_yday, "yday mismatch");
	zassert_equal(gm.tm_isdst, local.tm_isdst, "isdst mismatch");
}
```

## src/qsort_r.c
```c
/*
 * Copyright (c) 2021 Friedt Professional Engineering Services, Inc.
 *
 * SPDX-License-Identifier: Apache-2.0
 */

/* qsort_r() is part of the 2024 POSIX standard (Issue 8) */
#undef _POSIX_C_SOURCE
#define _POSIX_C_SOURCE 202405L

#include <stdbool.h>
#include <stdlib.h>
#include <string.h>

#include <zephyr/posix/posix_stdlib.h>
#include <zephyr/ztest.h>

struct test_qsort_case {
	const char *name;
	size_t len;
	const int *input;
	const int *expect;
	size_t base_index;
	size_t nmemb;
};

extern const struct test_qsort_case test_qsort_input[];
extern const size_t test_qsort_input_len;

static int compare_ints_with_boolp_arg(const void *a, const void *b, void *argp)
{
	int aa = *(const int *)a;
	int bb = *(const int *)b;

	*(bool *)argp = true;

	return (aa > bb) - (aa < bb);
}

ZTEST_USER(posix_c_lang_support_r, test_qsort_r)
{
	static ZTEST_BMEM int actual_int[93];
	bool arg;

	for (size_t i = 0; i < test_qsort_input_len; i++) {
		const struct test_qsort_case *tc = &test_qsort_input[i];

		memcpy(actual_int, tc->input, tc->len * sizeof(int));
		arg = false;
		qsort_r(&actual_int[tc->base_index], tc->nmemb, sizeof(int),
			compare_ints_with_boolp_arg, &arg);
		zassert_mem_equal(actual_int, tc->expect, tc->len * sizeof(int), "%s", tc->name);
		if (tc->nmemb >= 2) {
			zassert_true(arg, "case %s arg not modified", tc->name);
		}
	}
}
```

## src/rand_r.c
```c
/*
 * Copyright (c) 2021 Space Cubics, LLC.
 * Copyright (c) 2025 Friedt Professional Engineering Services, Inc.
 *
 * SPDX-License-Identifier: Apache-2.0
 */

#include <stdlib.h>

#include <zephyr/ztest.h>

ZTEST_USER(posix_c_lang_support_r, test_rand_r)
{
	unsigned int seed;
	unsigned int value;

	struct rand_r_test_data {
		const unsigned int seed;
		/* populated once at the beginning of the test */
		int expected_value;
	} data[] = {
		{ .seed = 0, },
		{ .seed = 1729, },
		{ .seed = 0x02000000, },
		{ .seed = 0x9E3779B9, },
		{ .seed = 0xFFFFFFFB, },
		{ .seed = UINT_MAX, },
	};

	/* populate the expectations exactly once */
	ARRAY_FOR_EACH(data, i) {
		seed = data[i].seed;
		data[i].expected_value = rand_r(&seed);
	}

	/* Different seeds produce different values (mostly) - this varies by implementation */
	ARRAY_FOR_EACH(data, i) {
		ARRAY_FOR_EACH(data, j) {
			if (i == j) {
				continue;
			}
			zassert_not_equal(data[i].expected_value, data[j].expected_value,
					  "rand_r(%u) == rand_r(%u)", data[i].seed, data[j].seed);
		}
	}

	/* reproducibility tests */
	for (int i = 0; i < ARRAY_SIZE(data); i++) {
		for (int j = 0; j < 3; j++) {
			seed = data[i].seed;
			value = rand_r(&seed);
			zassert_equal(data[i].expected_value, value, "rand_r(%u) %u != %u",
				      data[i].seed, value, data[i].expected_value);
		}
	}

	/* ensure that seed is updated by calls to rand_r() */
	seed = 42;
	for (int i = 0; i < 10; ++i) {
		/* hijack 'value' to preserve previous seed */
		value = seed;

		(void)rand_r(&seed);
		zassert_not_equal(value, seed, "iter[%d] seed not updated (was %u, is %u)",
				  i, value, seed);
	}
}
```

## src/strerror_r.c
```c
/*
 * Copyright (c) 2025 Friedt Professional Engineering Services, Inc.
 *
 * SPDX-License-Identifier: Apache-2.0
 */

#include <errno.h>
#include <string.h>

#include <zephyr/ztest.h>

ZTEST_USER(posix_c_lang_support_r, test_strerror_r)
{
	char buf[64];
	int ret;

	if (!IS_ENABLED(CONFIG_MINIMAL_LIBC_STRING_ERROR_TABLE)) {
		ztest_test_skip();
		return;
	}

	errno = 4242;
	ret = strerror_r(EINVAL, buf, sizeof(buf));
	zassert_ok(ret, "strerror_r(EINVAL) returned %d", ret);
	zassert_ok(strcmp("Invalid argument", buf), "unexpected message: '%s'", buf);
	zassert_equal(4242, errno, "errno changed on success");

	ret = strerror_r(0, buf, sizeof(buf));
	zassert_ok(ret, "strerror_r(0) returned %d", ret);
	zassert_ok(strcmp("Success", buf), "unexpected message: '%s'", buf);
	zassert_equal(4242, errno, "errno changed on success");

	ret = strerror_r(-42, buf, sizeof(buf));
	zassert_equal(EINVAL, ret, "strerror_r(-42) returned %d", ret);

	ret = strerror_r(4242, buf, sizeof(buf));
	zassert_equal(EINVAL, ret, "strerror_r(4242) returned %d", ret);

	ret = strerror_r(EINVAL, buf, 1);
	zassert_equal(ERANGE, ret, "strerror_r(EINVAL) with small buf returned %d", ret);
}

ZTEST_USER(posix_c_lang_support_r, test_strerror_r_no_table)
{
	char buf[64];
	int ret;

	if (IS_ENABLED(CONFIG_MINIMAL_LIBC_STRING_ERROR_TABLE)) {
		ztest_test_skip();
		return;
	}

	errno = 4242;
	ret = strerror_r(EINVAL, buf, sizeof(buf));
	zassert_ok(ret, "strerror_r(EINVAL) returned %d", ret);
	zassert_ok(strcmp("", buf), "unexpected message: '%s'", buf);
	zassert_equal(4242, errno, "errno changed on success");

	ret = strerror_r(-42, buf, sizeof(buf));
	zassert_equal(EINVAL, ret, "strerror_r(-42) returned %d", ret);

	ret = strerror_r(4242, buf, sizeof(buf));
	zassert_equal(EINVAL, ret, "strerror_r(4242) returned %d", ret);
}
```

## src/strtok_r.c
```c
/*
 * Copyright (c) 2017 Intel Corporation
 * Copyright (c) 2025 Friedt Professional Engineering Services, Inc.
 *
 * SPDX-License-Identifier: Apache-2.0
 */

#include <stdbool.h>
#include <string.h>

#include <zephyr/ztest.h>

struct strtok_test_case {
	const char *input;
	const char *sep;
	int tlen;
	const char *const *toks;
	bool expect;
};

extern const struct strtok_test_case strtok_test_cases[];
extern const size_t strtok_test_cases_len;

static void run_strtok_r_case(const struct strtok_test_case *tc)
{
	int len = 0;
	char *state, *tok, buf[64 + 1] = { 0 };

	strncpy(buf, tc->input, 64);

	tok = strtok_r(buf, tc->sep, &state);
	while (tok && len < tc->tlen) {
		if (strcmp(tok, tc->toks[len]) != 0) {
			break;
		}
		tok = strtok_r(NULL, tc->sep, &state);
		len++;
	}
	if (tc->expect) {
		zassert_equal(len, tc->tlen, "strtok_r error '%s' / '%s'", tc->input, tc->sep);
	} else {
		zassert_not_equal(len, tc->tlen, "strtok_r error '%s' / '%s'", tc->input, tc->sep);
	}
}

ZTEST_USER(posix_c_lang_support_r, test_strtok_r)
{
	for (size_t i = 0; i < strtok_test_cases_len; i++) {
		run_strtok_r_case(&strtok_test_cases[i]);
	}
}
```
