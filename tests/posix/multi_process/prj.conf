## CMakeLists.txt
```
# SPDX-License-Identifier: Apache-2.0

cmake_minimum_required(VERSION 3.20.0)
find_package(Zephyr REQUIRED HINTS $ENV{ZEPHYR_BASE})
project(posix_multi_process)

FILE(GLOB app_sources src/*.c)
target_sources(app PRIVATE ${app_sources} ../shared/msleep.c ../spawn/src/image_registry.c)
target_include_directories(app PRIVATE
  ${CMAKE_CURRENT_SOURCE_DIR}/../spawn/src
  ${CMAKE_CURRENT_SOURCE_DIR}/../../../lib/posix/shared
)
zephyr_linker_sources(ROM_SECTIONS ${CMAKE_CURRENT_SOURCE_DIR}/../spawn/iterables.ld)

target_compile_options(app PRIVATE -U_POSIX_C_SOURCE -D_POSIX_C_SOURCE=200809L -U_XOPEN_SOURCE -D_XOPEN_SOURCE=700)
```

## prj.conf
```kconfig
CONFIG_ZTEST=y

CONFIG_POSIX_AEP_CHOICE_BASE=y
CONFIG_POSIX_MULTI_PROCESS=y
CONFIG_POSIX_SIGNALS=y

# test_execve asserts FD_CLOEXEC semantics across an eventfd
CONFIG_POSIX_DEVICE_IO=y
CONFIG_POSIX_FD_MGMT=y
CONFIG_EVENTFD=y
CONFIG_ZVFS_EVENTFD_MAX=2
```

## src/_exit.c
```c
/*
 * Copyright The Zephyr Project Contributors
 *
 * SPDX-License-Identifier: Apache-2.0
 */

#include <unistd.h>

#include <zephyr/ztest.h>

/*
 * _exit() cannot be called from a ztest binary without terminating the test
 * runner; the exit-status observation tests live in the exit/ console-harness
 * application and, once processes exist, in child-process assertions.
 */
ZTEST_USER(posix_multi_process, test__exit)
{
	void (*fn)(int) = _exit;

	zexpect_not_null(fn);
}
```

## src/assert.c
```c
/*
 * SPDX-FileCopyrightText: Copyright The Zephyr Project Contributors
 *
 * SPDX-License-Identifier: Apache-2.0
 */

#include <assert.h>

#include <zephyr/ztest.h>

ZTEST_USER(posix_multi_process, test_assert)
{
	assert(1 == 1);
}
```

## src/atexit.c
```c
/*
 * SPDX-FileCopyrightText: Copyright The Zephyr Project Contributors
 *
 * SPDX-License-Identifier: Apache-2.0
 */

#include <stdlib.h>

#include <zephyr/ztest.h>

static void atexit_handler(void)
{
}

ZTEST(posix_multi_process, test_atexit)
{
	zassert_ok(atexit(atexit_handler), "atexit() failed");
}
```

## src/clock.c
```c
/*
 * SPDX-FileCopyrightText: Copyright The Zephyr Project Contributors
 *
 * SPDX-License-Identifier: Apache-2.0
 */

#include <time.h>

#include <zephyr/kernel.h>
#include <zephyr/ztest.h>

ZTEST(posix_multi_process, test_clock)
{
	clock_t before;
	clock_t after;

	before = clock();
	k_busy_wait(USEC_PER_MSEC);
	after = clock();

	/* clock() returns (clock_t)-1 when processor time is unavailable */
	zassert_true(after >= before, "clock() went backwards: %ld -> %ld", (long)before,
		     (long)after);
}
```

## src/execl.c
```c
/*
 * Copyright The Zephyr Project Contributors
 *
 * SPDX-License-Identifier: Apache-2.0
 */

#include <errno.h>
#include <unistd.h>

#include <zephyr/ztest.h>

ZTEST_USER(posix_multi_process, test_execl)
{
	if (IS_ENABLED(CONFIG_NATIVE_LIBC)) {
		/* host libc actually execs/forks; the prelinked-image resolution is Zephyr-only */
		ztest_test_skip();
		return;
	}


	errno = 0;
	zexpect_equal(execl("/bin/true", "true", NULL), -1);
	zexpect_equal(errno, ENOENT);
}
```

## src/execle.c
```c
/*
 * Copyright The Zephyr Project Contributors
 *
 * SPDX-License-Identifier: Apache-2.0
 */

#include <errno.h>
#include <unistd.h>

#include <zephyr/ztest.h>

ZTEST_USER(posix_multi_process, test_execle)
{
	if (IS_ENABLED(CONFIG_NATIVE_LIBC)) {
		/* host libc actually execs/forks; the prelinked-image resolution is Zephyr-only */
		ztest_test_skip();
		return;
	}


	errno = 0;
	zexpect_equal(execle("/bin/true", "true", NULL, NULL), -1);
	zexpect_equal(errno, ENOENT);
}
```

## src/execlp.c
```c
/*
 * Copyright The Zephyr Project Contributors
 *
 * SPDX-License-Identifier: Apache-2.0
 */

#include <errno.h>
#include <unistd.h>

#include <zephyr/ztest.h>

ZTEST_USER(posix_multi_process, test_execlp)
{
	if (IS_ENABLED(CONFIG_NATIVE_LIBC)) {
		/* host libc actually execs/forks; the prelinked-image resolution is Zephyr-only */
		ztest_test_skip();
		return;
	}


	errno = 0;
	zexpect_equal(execlp("true", "true", NULL), -1);
	zexpect_equal(errno, ENOENT);
}
```

## src/execv.c
```c
/*
 * Copyright The Zephyr Project Contributors
 *
 * SPDX-License-Identifier: Apache-2.0
 */

#include <errno.h>
#include <unistd.h>

#include <zephyr/ztest.h>

ZTEST_USER(posix_multi_process, test_execv)
{
	if (IS_ENABLED(CONFIG_NATIVE_LIBC)) {
		/* host libc actually execs/forks; the ENOSYS fallback is Zephyr-only */
		ztest_test_skip();
		return;
	}

	char *const argv[] = {"true", NULL};
	char *const envp[] = {NULL};

	ARG_UNUSED(envp);

	errno = 0;
	zexpect_equal(execv("/bin/true", argv), -1);
	zexpect_equal(errno, ENOSYS);
}
```

## src/execve.c
```c
/*
 * Copyright The Zephyr Project Contributors
 *
 * SPDX-License-Identifier: Apache-2.0
 */

#include <errno.h>
#include <fcntl.h>
#include <stdlib.h>
#include <string.h>
#include <sys/eventfd.h>
#include <sys/wait.h>
#include <unistd.h>

#include <zephyr/kernel.h>
#include <zephyr/sys/process.h>
#include <zephyr/ztest.h>

/*
 * Prelinked-image resolution walks a registry in kernel memory, so it only
 * works from supervisor mode until an exec loader exists (M3). The in-place
 * exec round trip below is therefore supervisor-only; a user-mode execve()
 * resolves nothing and returns ENOENT.
 */
#ifndef CONFIG_USERSPACE
#include "image_registry.h"

static char *const exec_argv[] = {"execme", NULL};
static volatile int exec_keep_fd = -1;
static volatile int exec_close_fd = -1;

static void execme_entry(void *p1, void *p2, void *p3)
{
	char *const *argv = p1;
	bool argv_ok;

	ARG_UNUSED(p2);
	ARG_UNUSED(p3);

	/* the previous image's argv arrives by value: exec copies the vectors */
	argv_ok = (argv != NULL) && (argv[0] != NULL) && (strcmp(argv[0], "execme") == 0) &&
		  (argv[1] == NULL);
	if (!argv_ok) {
		_exit(43);
	}
	/* FD_CLOEXEC closed across exec; the plain descriptor survived */
	if ((fcntl(exec_close_fd, F_GETFD) != -1) || (errno != EBADF)) {
		_exit(44);
	}
	if (eventfd_write(exec_keep_fd, 1) != 0) {
		_exit(45);
	}
	_exit(42);
}

IMAGE_REGISTRY_ENTRY_DEFINE(img_execme, "/bin/execme", execme_entry);

static K_THREAD_STACK_DEFINE(exec_child_stack, 2048);
static struct k_thread exec_child_thread;

static void exec_child_entry(void *p1, void *p2, void *p3)
{
	ARG_UNUSED(p1);
	ARG_UNUSED(p2);
	ARG_UNUSED(p3);

	exec_keep_fd = eventfd(0, 0);
	exec_close_fd = eventfd(0, 0);
	if ((exec_keep_fd < 0) || (exec_close_fd < 0) ||
	    (fcntl(exec_close_fd, F_SETFD, FD_CLOEXEC) != 0)) {
		_exit(98);
	}

	(void)execve("/bin/execme", exec_argv, NULL);
	_exit(99);
}
#endif /* !CONFIG_USERSPACE */

ZTEST_USER(posix_multi_process, test_execve)
{
	if (IS_ENABLED(CONFIG_NATIVE_LIBC)) {
		/* host libc actually execs/forks; the prelinked-image resolution is Zephyr-only */
		ztest_test_skip();
		return;
	}

	char *const argv[] = {"true", NULL};
	char *const envp[] = {NULL};

	ARG_UNUSED(envp);

	errno = 0;
	zexpect_equal(execve("/bin/true", argv, envp), -1);
	zexpect_equal(errno, ENOENT);

#ifndef CONFIG_USERSPACE
	if (!k_is_user_context()) {
		/* a child execs a registry image in place: same pid, new image */
		int status = -1;
		k_pid_t child = NULL;
		struct sys_clone_args args = {
			.entry = exec_child_entry,
			.thread = &exec_child_thread,
			.stack = exec_child_stack,
			.stack_size = 2048,
			.prio = k_thread_priority_get(k_current_get()),
		};

		zassert_ok(sys_clone(&args, &child));

		pid_t pid = (pid_t)sys_process_id(child);

		zassert_true(pid > 0);
		zassert_equal(waitpid(pid, &status, 0), pid);
		zassert_true(WIFEXITED(status));
		zassert_equal(WEXITSTATUS(status), 42, "exec image status %d", WEXITSTATUS(status));
	}
#endif /* !CONFIG_USERSPACE */
}
```

## src/execvp.c
```c
/*
 * Copyright The Zephyr Project Contributors
 *
 * SPDX-License-Identifier: Apache-2.0
 */

#include <errno.h>
#include <unistd.h>

#include <zephyr/ztest.h>

ZTEST_USER(posix_multi_process, test_execvp)
{
	if (IS_ENABLED(CONFIG_NATIVE_LIBC)) {
		/* host libc actually execs/forks; the ENOSYS fallback is Zephyr-only */
		ztest_test_skip();
		return;
	}

	char *const argv[] = {"true", NULL};
	char *const envp[] = {NULL};

	ARG_UNUSED(envp);

	errno = 0;
	zexpect_equal(execvp("true", argv), -1);
	zexpect_equal(errno, ENOSYS);
}
```

## src/exit.c
```c
/*
 * Copyright The Zephyr Project Contributors
 *
 * SPDX-License-Identifier: Apache-2.0
 */

#include <stdlib.h>

#include <zephyr/ztest.h>

/*
 * exit() cannot be called from a ztest binary without terminating the test
 * runner; the exit-status observation tests live in the exit/ console-harness
 * application and, once processes exist, in child-process assertions.
 */
ZTEST_USER(posix_multi_process, test_exit)
{
	void (*fn)(int) = exit;

	zexpect_not_null(fn);
}
```

## src/fork.c
```c
/*
 * Copyright The Zephyr Project Contributors
 *
 * SPDX-License-Identifier: Apache-2.0
 */

#include <errno.h>
#include <unistd.h>

#include <zephyr/ztest.h>

ZTEST_USER(posix_multi_process, test_fork)
{
	if (IS_ENABLED(CONFIG_NATIVE_LIBC) || IS_ENABLED(CONFIG_PROCESS_VM)) {
		/* the fork round-trip is exercised by tests/posix/fork */
		ztest_test_skip();
		return;
	}

	errno = 0;
	zexpect_equal(fork(), -1);
	zexpect_equal(errno, ENOTSUP);
}
```
