## CMakeLists.txt
```
# SPDX-License-Identifier: Apache-2.0

cmake_minimum_required(VERSION 3.20.0)
find_package(Zephyr REQUIRED HINTS $ENV{ZEPHYR_BASE})
project(xsi_realtime_threads)

FILE(GLOB app_sources src/*.c)

target_sources(app PRIVATE ${app_sources})

target_compile_options(app PRIVATE -U_POSIX_C_SOURCE -D_POSIX_C_SOURCE=200809L)
target_compile_options(app PRIVATE -U_XOPEN_SOURCE -D_XOPEN_SOURCE=700)
```

## prj.conf
```kconfig
CONFIG_ZTEST=y

CONFIG_POSIX_AEP_CHOICE_BASE=y
CONFIG_XSI=y
CONFIG_XSI_REALTIME_THREADS=y
CONFIG_TEST_EXTRA_STACK_SIZE=4096
CONFIG_HEAP_MEM_POOL_SIZE=16384
CONFIG_COMMON_LIBC_MALLOC_ARENA_SIZE=16384
```

## src/main.c
```c
/*
 * Copyright (c) 2024, Meta
 * Copyright (c) 2024, Marvin Ouma <pancakesdeath@protonmail.com>
 *
 * SPDX-License-Identifier: Apache-2.0
 */

#include <pthread.h>
#include <sched.h>

#include <zephyr/ztest.h>

bool attr_valid;
pthread_attr_t attr;
#ifndef CONFIG_NATIVE_LIBC
const pthread_attr_t uninit_attr;
#endif

static bool detached_thread_has_finished;

static void *thread_entry(void *arg)
{
	bool joinable = (bool)POINTER_TO_UINT(arg);

	if (!joinable) {
		detached_thread_has_finished = true;
	}

	return NULL;
}

void create_thread_common_entry(const pthread_attr_t *attrp, bool expect_success, bool joinable,
				void *(*entry)(void *arg), void *arg)
{
	pthread_t th;

	if (!joinable) {
		detached_thread_has_finished = false;
	}

	if (expect_success) {
		zassert_ok(pthread_create(&th, attrp, entry, arg));
	} else {
		zassert_not_ok(pthread_create(&th, attrp, entry, arg));
		return;
	}

	if (joinable) {
		zassert_ok(pthread_join(th, NULL), "failed to join joinable thread");
		return;
	}

	zassert_not_ok(pthread_join(th, NULL));

	for (size_t i = 0; i < 10; ++i) {
		k_msleep(2 * CONFIG_PTHREAD_RECYCLER_DELAY_MS);
		if (detached_thread_has_finished) {
			break;
		}
	}

	zassert_true(detached_thread_has_finished, "detached thread did not seem to finish");
}

void can_create_thread(const pthread_attr_t *attrp)
{
	create_thread_common_entry(attrp, true, true, thread_entry, UINT_TO_POINTER(true));
}

static void before(void *arg)
{
	ARG_UNUSED(arg);

	zassert_ok(pthread_attr_init(&attr));
	attr_valid = true;
}

static void after(void *arg)
{
	ARG_UNUSED(arg);

	if (attr_valid) {
		(void)pthread_attr_destroy(&attr);
		attr_valid = false;
	}
}

ZTEST_SUITE(xsi_realtime_threads, NULL, NULL, before, after, NULL);
```

## src/mutex_prioceiling.c
```c
/*
 * Copyright (c) 2025 Friedt Professional Engineering Services, Inc.
 *
 * SPDX-License-Identifier: Apache-2.0
 */

#include <pthread.h>

#include <zephyr/ztest.h>

ZTEST(xsi_realtime_threads, test_pthread_mutex_getprioceiling)
{
#if defined(_POSIX_THREAD_PRIO_PROTECT)
	zassert_equal(pthread_mutex_getprioceiling(NULL, NULL), ENOSYS);
#else
	ztest_test_skip();
#endif
}

ZTEST(xsi_realtime_threads, test_pthread_mutex_setprioceiling)
{
#if defined(_POSIX_THREAD_PRIO_PROTECT)
	zassert_equal(pthread_mutex_setprioceiling(NULL, 0, NULL), ENOSYS);
#else
	ztest_test_skip();
#endif
}

ZTEST(xsi_realtime_threads, test_pthread_mutexattr_getprioceiling)
{
#if defined(_POSIX_THREAD_PRIO_INHERIT) || defined(_POSIX_THREAD_PRIO_PROTECT)
	zassert_equal(pthread_mutexattr_getprioceiling(NULL, NULL), ENOSYS);
#else
	ztest_test_skip();
#endif
}

ZTEST(xsi_realtime_threads, test_pthread_mutexattr_setprioceiling)
{
#if defined(_POSIX_THREAD_PRIO_INHERIT) || defined(_POSIX_THREAD_PRIO_PROTECT)
	zassert_equal(pthread_mutexattr_setprioceiling(NULL, 0), ENOSYS);
#else
	ztest_test_skip();
#endif
}
```

## src/mutexattr_protocol.c
```c
/*
 * SPDX-FileCopyrightText: Copyright The Zephyr Project Contributors
 * SPDX-License-Identifier: Apache-2.0
 */

#include <errno.h>
#include <pthread.h>

#include <zephyr/ztest.h>

#include "../../shared/linux_compat_test.h"

ZTEST_USER(xsi_realtime_threads, test_pthread_mutexattr_getprotocol)
{
#if defined(_POSIX_THREAD_PRIO_INHERIT) || defined(_POSIX_THREAD_PRIO_PROTECT)
	int protocol = -1;
	pthread_mutexattr_t attr;

	IF_NOT_NATIVE_LIBC({
		zassert_equal(pthread_mutexattr_getprotocol(NULL, &protocol), EINVAL);
		zassert_equal(pthread_mutexattr_getprotocol(&attr, NULL), EINVAL);
		zassert_equal(pthread_mutexattr_getprotocol(NULL, NULL), EINVAL);
	})

	zassert_ok(pthread_mutexattr_init(&attr));
	zassert_ok(pthread_mutexattr_getprotocol(&attr, &protocol));
	zassert_equal(protocol, PTHREAD_PRIO_NONE);
	zassert_ok(pthread_mutexattr_destroy(&attr));
#else
	ztest_test_skip();
#endif
}

ZTEST_USER(xsi_realtime_threads, test_pthread_mutexattr_setprotocol)
{
#if defined(_POSIX_THREAD_PRIO_INHERIT) || defined(_POSIX_THREAD_PRIO_PROTECT)
	int protocol = -1;
	pthread_mutexattr_t attr;

	IF_NOT_NATIVE_LIBC({
		zassert_equal(pthread_mutexattr_setprotocol(NULL, PTHREAD_PRIO_NONE), EINVAL);
	})

	zassert_ok(pthread_mutexattr_init(&attr));
	zassert_ok(pthread_mutexattr_setprotocol(&attr, PTHREAD_PRIO_NONE));

	/* k_mutex implements priority inheritance, so PTHREAD_PRIO_INHERIT is accepted */
	zassert_ok(pthread_mutexattr_setprotocol(&attr, PTHREAD_PRIO_INHERIT));
	zassert_ok(pthread_mutexattr_getprotocol(&attr, &protocol));
	zassert_equal(protocol, PTHREAD_PRIO_INHERIT);

	if (!IS_ENABLED(CONFIG_NATIVE_LIBC)) {
		/* priority ceilings are not implemented */
		zassert_equal(pthread_mutexattr_setprotocol(&attr, PTHREAD_PRIO_PROTECT), ENOTSUP);
	}
	zassert_equal(pthread_mutexattr_setprotocol(&attr, 42), EINVAL);
	zassert_ok(pthread_mutexattr_destroy(&attr));
#else
	ztest_test_skip();
#endif
}
```

## src/pthread_sched.c
```c
/*
 * Copyright (c) 2024, Meta
 * Copyright (c) 2024, Marvin Ouma <pancakesdeath@protonmail.com>
 *
 * SPDX-License-Identifier: Apache-2.0
 */

#include <pthread.h>
#include <sched.h>

#include <zephyr/ztest.h>

#include "../../shared/linux_compat_test.h"

#define BIOS_FOOD     0xB105F00D
#define SCHED_INVALID 4242
#define PRIO_INVALID  -1

extern bool attr_valid;
extern pthread_attr_t attr;
extern const pthread_attr_t uninit_attr;

extern void can_create_thread(const pthread_attr_t *attrp);
extern void create_thread_common_entry(const pthread_attr_t *attrp, bool expect_success,
				       bool joinable, void *(*entry)(void *arg), void *arg);

int zephyr_to_posix_priority(int z_prio, int *policy);
int posix_to_zephyr_priority(int priority, int policy);

ZTEST_USER(xsi_realtime_threads, test_pthread_attr_getschedpolicy)
{
#if defined(_POSIX_THREAD_PRIORITY_SCHEDULING)
	int policy = BIOS_FOOD;

	IF_NOT_NATIVE_LIBC({
		if (false) {
			zassert_equal(pthread_attr_getschedpolicy(NULL, NULL), EINVAL);
			zassert_equal(pthread_attr_getschedpolicy(NULL, &policy), EINVAL);
			zassert_equal(pthread_attr_getschedpolicy(&uninit_attr, &policy), EINVAL);
		}
		zassert_equal(pthread_attr_getschedpolicy(&attr, NULL), EINVAL);
	})

	zassert_ok(pthread_attr_getschedpolicy(&attr, &policy));
	zassert_not_equal(BIOS_FOOD, policy);
#else
	ztest_test_skip();
#endif
}

ZTEST_USER(xsi_realtime_threads, test_pthread_attr_setschedpolicy)
{
#if defined(_POSIX_THREAD_PRIORITY_SCHEDULING)
	int policy = SCHED_OTHER;

	IF_NOT_NATIVE_LIBC({
		if (false) {
			zassert_equal(pthread_attr_setschedpolicy(NULL, SCHED_INVALID), EINVAL);
			zassert_equal(pthread_attr_setschedpolicy(NULL, policy), EINVAL);
			zassert_equal(
				pthread_attr_setschedpolicy((pthread_attr_t *)&uninit_attr, policy),
				EINVAL);
		}
	})
	zassert_equal(pthread_attr_setschedpolicy(&attr, SCHED_INVALID), EINVAL);

	zassert_ok(pthread_attr_setschedpolicy(&attr, SCHED_OTHER));
	policy = SCHED_INVALID;
	zassert_ok(pthread_attr_getschedpolicy(&attr, &policy));
	zassert_equal(policy, SCHED_OTHER);

	can_create_thread(&attr);
#else
	ztest_test_skip();
#endif
}

ZTEST_USER(xsi_realtime_threads, test_pthread_attr_getscope)
{
#if defined(_POSIX_THREAD_PRIORITY_SCHEDULING)
	int contentionscope = BIOS_FOOD;

	IF_NOT_NATIVE_LIBC({
		if (false) {
			zassert_equal(pthread_attr_getscope(NULL, NULL), EINVAL);
			zassert_equal(pthread_attr_getscope(NULL, &contentionscope), EINVAL);
			zassert_equal(pthread_attr_getscope(&uninit_attr, &contentionscope),
				      EINVAL);
		}
		zassert_equal(pthread_attr_getscope(&attr, NULL), EINVAL);
	})

	zassert_ok(pthread_attr_getscope(&attr, &contentionscope));
	zassert_equal(contentionscope, PTHREAD_SCOPE_SYSTEM);
#else
	ztest_test_skip();
#endif
}

ZTEST_USER(xsi_realtime_threads, test_pthread_attr_setscope)
{
#if defined(_POSIX_THREAD_PRIORITY_SCHEDULING)
	int contentionscope = BIOS_FOOD;

	IF_NOT_NATIVE_LIBC({
		if (false) {
			zassert_equal(pthread_attr_setscope(NULL, PTHREAD_SCOPE_SYSTEM), EINVAL);
			zassert_equal(pthread_attr_setscope(NULL, contentionscope), EINVAL);
			zassert_equal(pthread_attr_setscope((pthread_attr_t *)&uninit_attr,
							    contentionscope),
				      EINVAL);
		}
	})
	zassert_equal(pthread_attr_setscope(&attr, 3), EINVAL);

	zassert_equal(pthread_attr_setscope(&attr, PTHREAD_SCOPE_PROCESS), ENOTSUP);
	zassert_ok(pthread_attr_setscope(&attr, PTHREAD_SCOPE_SYSTEM));
	zassert_ok(pthread_attr_getscope(&attr, &contentionscope));
	zassert_equal(contentionscope, PTHREAD_SCOPE_SYSTEM);
#else
	ztest_test_skip();
#endif
}

ZTEST_USER(xsi_realtime_threads, test_pthread_attr_getinheritsched)
{
#if defined(_POSIX_THREAD_PRIORITY_SCHEDULING)
	int inheritsched = BIOS_FOOD;

	IF_NOT_NATIVE_LIBC({
		if (false) {
			zassert_equal(pthread_attr_getinheritsched(NULL, NULL), EINVAL);
			zassert_equal(pthread_attr_getinheritsched(NULL, &inheritsched), EINVAL);
			zassert_equal(pthread_attr_getinheritsched(&uninit_attr, &inheritsched),
				      EINVAL);
		}
		zassert_equal(pthread_attr_getinheritsched(&attr, NULL), EINVAL);
	})

	zassert_ok(pthread_attr_getinheritsched(&attr, &inheritsched));
	zassert_equal(inheritsched, PTHREAD_INHERIT_SCHED);
#else
	ztest_test_skip();
#endif
}

#ifndef CONFIG_NATIVE_LIBC
static void *inheritsched_entry(void *arg)
{
	int prio;
	int inheritsched;
	int pprio = POINTER_TO_INT(arg);

	zassert_ok(pthread_attr_getinheritsched(&attr, &inheritsched));

	prio = k_thread_priority_get(k_current_get());

	if (inheritsched == PTHREAD_INHERIT_SCHED) {
		zassert_equal(prio, pprio, "actual priority: %d, expected priority: %d", prio,
			      pprio);
		return NULL;
	}

	int act_prio;
	int exp_prio;
	int act_policy;
	int exp_policy;
	struct sched_param param;

	zassert_ok(pthread_getschedparam(pthread_self(), &act_policy, &param));
	act_prio = param.sched_priority;

	zassert_ok(pthread_attr_getschedpolicy(&attr, &exp_policy));
	zassert_ok(pthread_attr_getschedparam(&attr, &param));
	exp_prio = param.sched_priority;

	zassert_equal(act_policy, exp_policy, "actual policy: %d, expected policy: %d", act_policy,
		      exp_policy);
	zassert_equal(act_prio, exp_prio, "actual priority: %d, expected priority: %d", act_prio,
		      exp_prio);

	return NULL;
}

static void test_pthread_attr_setinheritsched_common(bool inheritsched)
{
	int prio;
	int policy;
	struct sched_param param;

	prio = k_thread_priority_get(k_current_get());
	zassert_not_equal(prio, K_LOWEST_APPLICATION_THREAD_PRIO);

	prio = K_LOWEST_APPLICATION_THREAD_PRIO;
	param.sched_priority = zephyr_to_posix_priority(prio, &policy);

	zassert_ok(pthread_attr_setschedpolicy(&attr, policy));
	zassert_ok(pthread_attr_setschedparam(&attr, &param));
	zassert_ok(pthread_attr_setinheritsched(&attr, inheritsched));
	create_thread_common_entry(&attr, true, true, inheritsched_entry,
				   UINT_TO_POINTER(k_thread_priority_get(k_current_get())));
}
#endif /* CONFIG_NATIVE_LIBC */

ZTEST_USER(xsi_realtime_threads, test_pthread_attr_setinheritsched)
{
#if defined(_POSIX_THREAD_PRIORITY_SCHEDULING)
	IF_NOT_NATIVE_LIBC({
		if (false) {
			zassert_equal(pthread_attr_setinheritsched(NULL, PTHREAD_EXPLICIT_SCHED),
				      EINVAL);
			zassert_equal(pthread_attr_setinheritsched(NULL, PTHREAD_INHERIT_SCHED),
				      EINVAL);
			zassert_equal(pthread_attr_setinheritsched((pthread_attr_t *)&uninit_attr,
								   PTHREAD_INHERIT_SCHED),
				      EINVAL);
		}
	})
	zassert_equal(pthread_attr_setinheritsched(&attr, 3), EINVAL);

	IF_NOT_NATIVE_LIBC({
		/* the remainder rides on the internal Zephyr <-> POSIX priority mapping */
		test_pthread_attr_setinheritsched_common(PTHREAD_INHERIT_SCHED);
		test_pthread_attr_setinheritsched_common(PTHREAD_EXPLICIT_SCHED);
	})
#else
	ztest_test_skip();
#endif
}

ZTEST_USER(xsi_realtime_threads, test_pthread_setschedprio)
{
#if defined(_POSIX_THREAD_PRIORITY_SCHEDULING)
	int policy;
	int prio = 0;
	struct sched_param param;
	pthread_t self = pthread_self();

	zassert_equal(pthread_setschedprio(self, PRIO_INVALID), EINVAL, "EINVAL was expected");

	zassert_ok(pthread_setschedprio(self, prio));
	param.sched_priority = ~prio;
	zassert_ok(pthread_getschedparam(self, &policy, &param));
	zassert_equal(param.sched_priority, prio, "Priority unchanged");
#else
	ztest_test_skip();
#endif
}

ZTEST_USER(xsi_realtime_threads, test_pthread_priority_conversion)
{
#if defined(_POSIX_THREAD_PRIORITY_SCHEDULING) && !defined(CONFIG_NATIVE_LIBC)
	/* the mapping is internal to the Zephyr implementation */
	for (int z_prio = -CONFIG_NUM_COOP_PRIORITIES, prio = CONFIG_NUM_COOP_PRIORITIES - 1,
		 p_prio, policy;
	     z_prio <= -1; z_prio++, prio--) {
		p_prio = zephyr_to_posix_priority(z_prio, &policy);
		zassert_equal(policy, SCHED_FIFO);
		zassert_equal(p_prio, prio, "%d %d\n", p_prio, prio);
		zassert_equal(z_prio, posix_to_zephyr_priority(p_prio, SCHED_FIFO));
	}

	for (int z_prio = 0, prio = CONFIG_NUM_PREEMPT_PRIORITIES - 1, p_prio, policy;
	     z_prio < CONFIG_NUM_PREEMPT_PRIORITIES; z_prio++, prio--) {
		p_prio = zephyr_to_posix_priority(z_prio, &policy);
		zassert_equal(policy, SCHED_RR);
		zassert_equal(p_prio, prio, "%d %d\n", p_prio, prio);
		zassert_equal(z_prio, posix_to_zephyr_priority(p_prio, SCHED_RR));
	}
#else
	ztest_test_skip();
#endif
}
```
