## prj.conf
```kconfig
CONFIG_ZTEST=y
CONFIG_NET_TEST=y
CONFIG_TEST_RANDOM_GENERATOR=y

CONFIG_POSIX_AEP_CHOICE_PSE53=y
CONFIG_POSIX_NETWORKING=y
CONFIG_NETWORKING=y

CONFIG_NET_DRIVERS=y
CONFIG_NET_LOOPBACK=y
CONFIG_NET_IPV4=y
CONFIG_NET_IPV6=y
CONFIG_NET_TCP=y
CONFIG_NET_UDP=y
CONFIG_NET_SOCKETS=y
CONFIG_NET_MAX_CONTEXTS=32
CONFIG_NET_MAX_CONN=32

CONFIG_FILE_SYSTEM=y
CONFIG_FAT_FILESYSTEM_ELM=y
CONFIG_FS_FATFS_LFN=y
CONFIG_DISK_DRIVERS=y
CONFIG_DISK_DRIVER_RAM=y

CONFIG_HEAP_MEM_POOL_SIZE=4096
CONFIG_COMMON_LIBC_MALLOC_ARENA_SIZE=4096
CONFIG_MAIN_STACK_SIZE=4096
CONFIG_ZTEST_STACK_SIZE=4096

CONFIG_NET_PKT_RX_COUNT=8
CONFIG_NET_PKT_TX_COUNT=8
CONFIG_NET_BUF_RX_COUNT=16
CONFIG_NET_BUF_TX_COUNT=16
```

## app.overlay
```dts
/*
 * Copyright (c) 2024 Friedt Professional Engineering Services, Inc.
 *
 * SPDX-License-Identifier: Apache-2.0
 */

/ {
	ramdisk0 {
		compatible = "zephyr,ram-disk";
		disk-name = "RAM";
		sector-size = <512>;
		sector-count = <160>;
	};
};
```

## src/main.c
```c
/*
 * Copyright (c) 2024, Friedt Professional Engineering Services, Inc
 *
 * SPDX-License-Identifier: Apache-2.0
 */

#include <zephyr/ztest.h>

void *test_fs_setup(void);
void test_fs_teardown(void *arg);
void test_netdb_cleanup(void *arg);

ZTEST_SUITE(posix_networking, NULL, test_fs_setup, NULL, test_netdb_cleanup, test_fs_teardown);
```

## src/byteorder.c
```c
/*
 * SPDX-FileCopyrightText: Copyright The Zephyr Project Contributors
 * SPDX-License-Identifier: Apache-2.0
 */

#include <arpa/inet.h>
#include <netinet/in.h>

#include <zephyr/ztest.h>

ZTEST_USER(posix_networking, test_htonl)
{
	zassert_equal(htonl(0x01020304U), 0x04030201U);
	zassert_equal(htonl(0U), 0U);
	zassert_equal(htonl(0xffffffffU), 0xffffffffU);
}

ZTEST_USER(posix_networking, test_htons)
{
	zassert_equal(htons(0x1234), 0x3412);
	zassert_equal(htons(0), 0);
	zassert_equal(htons(0xffff), 0xffff);
}

ZTEST_USER(posix_networking, test_ntohl)
{
	zassert_equal(ntohl(0x04030201U), 0x01020304U);
	zassert_equal(ntohl(0U), 0U);
}

ZTEST_USER(posix_networking, test_ntohs)
{
	zassert_equal(ntohs(0x3412), 0x1234);
	zassert_equal(ntohs(0), 0);
}
```

## src/fs.c
```c
/*
 * Copyright (c) 2024 Friedt Professional Engineering Services, Inc.
 *
 * SPDX-License-Identifier: Apache-2.0
 */

#include <string.h>
#include <netdb.h>

#include <ff.h>
#include <zephyr/fs/fs.h>
#include <zephyr/sys/util.h>
#include <zephyr/ztest.h>

static FATFS _fs;

static struct fs_mount_t _mnt = {
	.type = FS_FATFS,
	.mnt_point = "/",
	.fs_data = &_fs,
};

struct _entry {
	const char *const name;
	const char *const data;
};

static const struct _entry _data[] = {
	{.name = "/etc/hosts", .data = "127.0.0.1 localhost\n"},
	{.name = "/etc/protocols", .data = "tcp 6 TCP\nudp 17 UDP\n"},
	{.name = "/etc/services", .data = "http 80/tcp\n"},
	{.name = "/etc/networks", .data = "link 0\n"},
};

void *test_fs_setup(void)
{
	int ret;

	memset(&_fs, 0, sizeof(_fs));

	ret = fs_mount(&_mnt);
	zassert_ok(ret, "mount failed: %d", ret);

	ret = fs_mkdir("/etc");
	zassert_ok(ret, "mkdir failed: %d", ret);

	ARRAY_FOR_EACH_PTR(_data, entry) {
		int len;
		struct fs_file_t zfp;

		fs_file_t_init(&zfp);

		ret = fs_open(&zfp, entry->name, FS_O_CREATE | FS_O_RDWR | FS_O_TRUNC);
		zassert_true(ret >= 0, "open %s failed: %d", entry->name, ret);

		len = strlen(entry->data);
		ret = fs_write(&zfp, entry->data, len);
		zassert_equal(ret, len, "write %s returned %d", entry->name, ret);

		ret = fs_close(&zfp);
		zassert_ok(ret, "close %s returned %d", entry->name, ret);
	}

	return &_mnt;
}

void test_fs_teardown(void *arg)
{
	struct fs_mount_t *const mnt = arg;

	(void)fs_unmount(mnt);
}

void test_netdb_cleanup(void *arg)
{
	ARG_UNUSED(arg);

	endhostent();
	endnetent();
	endprotoent();
	endservent();
}
```

## src/getaddrinfo.c
```c
/*
 * SPDX-FileCopyrightText: Copyright The Zephyr Project Contributors
 * SPDX-License-Identifier: Apache-2.0
 */

#include <netdb.h>
#include <sys/socket.h>

#include <zephyr/ztest.h>

ZTEST_USER(posix_networking, test_getaddrinfo)
{
	struct addrinfo hints = {
		.ai_family = AF_INET,
		.ai_socktype = SOCK_STREAM,
	};
	struct addrinfo *res = NULL;
	int ret;

	ret = getaddrinfo("127.0.0.1", "4242", &hints, &res);
	zassert_ok(ret, "getaddrinfo failed: %d", ret);
	zassert_not_null(res);
	zassert_equal(res->ai_family, AF_INET);

	freeaddrinfo(res);
	res = NULL;
}

ZTEST_USER(posix_networking, test_freeaddrinfo)
{
	struct addrinfo *res = NULL;

	zassert_ok(getaddrinfo("127.0.0.1", "80", NULL, &res));
	zassert_not_null(res);
	freeaddrinfo(res);
	freeaddrinfo(NULL);
}

ZTEST(posix_networking, test_gai_strerror)
{
	zassert_not_null(gai_strerror(EAI_NONAME));
	zassert_not_null(gai_strerror(EAI_SERVICE));
}
```

## src/gethostname.c
```c
/*
 * SPDX-FileCopyrightText: Copyright The Zephyr Project Contributors
 * SPDX-License-Identifier: Apache-2.0
 */

#include <string.h>
#include <unistd.h>

#include <zephyr/ztest.h>

#include "../../shared/linux_compat_test.h"

ZTEST(posix_networking, test_gethostname)
{
	char hostname[CONFIG_NET_HOSTNAME_MAX_LEN + 1];
	int ret;

	ret = gethostname(hostname, sizeof(hostname));
	zassert_equal(ret, 0, "gethostname() failed: %d", ret);

	IF_NOT_NATIVE_LIBC({
		if (IS_ENABLED(CONFIG_NET_HOSTNAME_UNIQUE)) {
			/* CONFIG_NET_HOSTNAME followed by the link address */
			zassert_equal(strncmp(hostname, CONFIG_NET_HOSTNAME,
					      strlen(CONFIG_NET_HOSTNAME)),
				      0, "unexpected hostname: %s", hostname);
			zassert_true(strlen(hostname) > strlen(CONFIG_NET_HOSTNAME),
				     "hostname not made unique: %s", hostname);
		} else {
			zassert_equal(strcmp(hostname, CONFIG_NET_HOSTNAME), 0,
				      "unexpected hostname: %s", hostname);
		}
	});

	if (IS_ENABLED(CONFIG_NATIVE_LIBC)) {
		zassert_true(strlen(hostname) > 0, "empty hostname");
	}
}
```

## src/getnameinfo.c
```c
/*
 * SPDX-FileCopyrightText: Copyright The Zephyr Project Contributors
 * SPDX-License-Identifier: Apache-2.0
 */

#include <netdb.h>
#include <netinet/in.h>
#include <sys/socket.h>

#include <zephyr/ztest.h>

#include "test_net.h"

ZTEST(posix_networking, test_getnameinfo)
{
	struct sockaddr_in addr;
	char host[NI_MAXHOST];
	char serv[NI_MAXSERV];
	socklen_t addrlen = sizeof(addr);
	uint16_t port;
	int lsock;

	lsock = tcp_listen_socket(&port);
	zassert_ok(getsockname(lsock, (struct sockaddr *)&addr, &addrlen));
	close(lsock);

	zassert_ok(getnameinfo((struct sockaddr *)&addr, addrlen, host, sizeof(host), serv,
			       sizeof(serv), NI_NUMERICHOST | NI_NUMERICSERV));
	zassert_mem_equal(host, TEST_LOOPBACK, strlen(TEST_LOOPBACK) + 1);
}

ZTEST(posix_networking, test_getnameinfo_ipv6)
{
	struct sockaddr_in6 addr;
	char host[NI_MAXHOST];
	socklen_t addrlen = sizeof(addr);

	memset(&addr, 0, sizeof(addr));
	addr.sin6_family = AF_INET6;
	zassert_equal(1, inet_pton(AF_INET6, TEST_LOOPBACK_V6, &addr.sin6_addr));

	zassert_ok(getnameinfo((struct sockaddr *)&addr, addrlen, host, sizeof(host), NULL, 0,
			       NI_NUMERICHOST));
	zassert_true(strcmp(host, "::1") == 0 || strcmp(host, "0:0:0:0:0:0:0:1") == 0);
}
```

## src/if.c
```c
/*
 * Copyright (c) 2024, Friedt Professional Engineering Services, Inc
 *
 * SPDX-License-Identifier: Apache-2.0
 */

#include <errno.h>
#include <string.h>

#include <net/if.h>
#include <zephyr/ztest.h>

#include "../../shared/linux_compat_test.h"

#if !defined(CONFIG_NATIVE_LIBC)
#include <zephyr/net/net_if.h>
#endif

ZTEST(posix_networking, test_if_indextoname)
{
	struct if_nameindex *ni = if_nameindex();

	zassert_not_null(ni, "if_nameindex failed: %d", errno);

	for (size_t i = 0; ni[i].if_index != 0; i++) {
		char buf[IF_NAMESIZE];
		char *name = if_indextoname(ni[i].if_index, buf);

		zassert_not_null(name, "if_indextoname(%u) failed: %d", ni[i].if_index, errno);
		zassert_equal(name, buf);
		zassert_str_equal(buf, ni[i].if_name);

		IF_NOT_NATIVE_LIBC({
			struct net_if *iface = net_if_get_by_index(ni[i].if_index);
			char zname[IF_NAMESIZE];

			zassert_not_null(iface);
			memset(zname, 0, sizeof(zname));
			zassert_true(net_if_get_name(iface, zname, IF_NAMESIZE) >= 0);
			zassert_str_equal(buf, zname);
		});
		TC_PRINT("interface %u: %s\n", ni[i].if_index, buf);
	}

	if_freenameindex(ni);
}

ZTEST(posix_networking, test_if_freenameindex)
{
	struct if_nameindex *ni;

	/* POSIX: NULL is a no-op. Host glibc crashes on NULL (linux_compat). */
	IF_NOT_NATIVE_LIBC({
		if_freenameindex(NULL);
	});

	ni = if_nameindex();
	if (ni != NULL) {
		if_freenameindex(ni);
	}
}

ZTEST(posix_networking, test_if_nameindex)
{
	size_t i;
	struct if_nameindex *ni;

	ni = if_nameindex();
	if (ni == NULL) {
		zassert_equal(errno, ENOBUFS);
		return;
	}

	for (i = 0; ni[i].if_index != 0; i++) {
		zassert_true(ni[i].if_index > 0);
		zassert_not_null(ni[i].if_name);
	}

	zassert_equal(0, ni[i].if_index);
	zassert_is_null(ni[i].if_name);

	if_freenameindex(ni);
}

ZTEST(posix_networking, test_if_nametoindex)
{
	struct if_nameindex *ni = if_nameindex();

	zassert_not_null(ni, "if_nameindex failed: %d", errno);

	for (size_t i = 0; ni[i].if_index != 0; i++) {
		zassert_equal(ni[i].if_index, if_nametoindex(ni[i].if_name));
		TC_PRINT("interface %u: %s\n", ni[i].if_index, ni[i].if_name);
	}

	if_freenameindex(ni);
}

ZTEST(posix_networking, test_if_indextoname_invalid)
{
	char buf[IF_NAMESIZE];

	errno = 0;
	zassert_is_null(if_indextoname(9999, buf));
	zassert_equal(errno, ENXIO);
}
```

## src/inet_addr.c
```c
/*
 * Copyright (c) 2024, Friedt Professional Engineering Services, Inc
 *
 * SPDX-License-Identifier: Apache-2.0
 */

#include <stdint.h>

#include <arpa/inet.h>
#include <netinet/in.h>
#include <sys/socket.h>
#include <zephyr/sys/util.h>
#include <zephyr/ztest.h>

ZTEST_USER(posix_networking, test_inet_addr)
{
	in_addr_t ret;
	static const struct parm_fail {
		const char *in;
	} fail_parms[] = {
#ifndef CONFIG_ARCH_POSIX
		{NULL},
#endif
		{"."},
		{".."},
		{"..."},
		{"-1.-2.-3.-4"},
		{"256.65536.4294967296.18446744073709551616"},
		{"a.b.c.d"},
		{"0.0.0.1234"},
		{"0.0.0.12a"},
		{" 1.2.3.4"},
	};
	static const struct parm_ok {
		const char *in;
		const char *canonical;
	} ok_parms[] = {
		{"0.0.0.0", "0.0.0.0"},
		{"000.00.0.0", "0.0.0.0"},
		{"127.0.0.1", "127.0.0.1"},
		{"1.2.3.4", "1.2.3.4"},
		{"1.2.3.4    ", "1.2.3.4"},
		{"0.0.0.123 a", "0.0.0.123"},
		{"255.255.255.255", "255.255.255.255"},
	};

	ARRAY_FOR_EACH_PTR(fail_parms, p) {
		ret = inet_addr(p->in);
		zexpect_equal(ret, (in_addr_t)-1, "inet_addr(%s) should fail", p->in);
	}

	ARRAY_FOR_EACH_PTR(ok_parms, p) {
		struct in_addr expected;

		zassert_equal(1, inet_pton(AF_INET, p->canonical, &expected));
		ret = inet_addr(p->in);
		zexpect_equal(ret, expected.s_addr, "inet_addr(%s) failed", p->in);
	}
}
```

## src/inet_ntoa.c
```c
/*
 * Copyright (c) 2024, Friedt Professional Engineering Services, Inc
 *
 * SPDX-License-Identifier: Apache-2.0
 */

#include <arpa/inet.h>
#include <netinet/in.h>

#include <zephyr/ztest.h>

ZTEST(posix_networking, test_inet_ntoa)
{
	struct in_addr in;

	in.s_addr = htonl(0x7f000001);
	zassert_mem_equal(inet_ntoa(in), "127.0.0.1", strlen("127.0.0.1") + 1);

	in.s_addr = htonl(0);
	zassert_mem_equal(inet_ntoa(in), "0.0.0.0", strlen("0.0.0.0") + 1);

	in.s_addr = htonl(0xffffffffU);
	zassert_mem_equal(inet_ntoa(in), "255.255.255.255", strlen("255.255.255.255") + 1);
}
```

## src/inet_ntop.c
```c
/*
 * SPDX-FileCopyrightText: Copyright The Zephyr Project Contributors
 * SPDX-License-Identifier: Apache-2.0
 */

#include <errno.h>
#include <arpa/inet.h>
#include <netinet/in.h>
#include <string.h>
#include <sys/socket.h>

#include <zephyr/ztest.h>

ZTEST_USER(posix_networking, test_inet_ntop)
{
	struct in_addr in4;
	char buf[INET_ADDRSTRLEN];

	zassert_equal(1, inet_pton(AF_INET, "127.0.0.1", &in4));
	zassert_not_null(inet_ntop(AF_INET, &in4, buf, sizeof(buf)));
	zassert_mem_equal(buf, "127.0.0.1", strlen("127.0.0.1") + 1);

	zassert_is_null(inet_ntop(AF_INET, &in4, buf, 2));

	zassert_is_null(inet_ntop(AF_UNSPEC, &in4, buf, sizeof(buf)));
}

ZTEST_USER(posix_networking, test_inet_pton)
{
	struct in_addr in4;
	struct in6_addr in6;

	zassert_equal(1, inet_pton(AF_INET, "127.0.0.1", &in4));
	zassert_equal(in4.s_addr, htonl(0x7f000001));

	zassert_equal(0, inet_pton(AF_INET, "not-an-address", &in4));
	zassert_equal(1, inet_pton(AF_INET6, "::1", &in6));
}
```

## src/netdb_hosts.c
```c
/*
 * SPDX-FileCopyrightText: Copyright The Zephyr Project Contributors
 * SPDX-License-Identifier: Apache-2.0
 */

#include <netdb.h>

#include <zephyr/ztest.h>

ZTEST(posix_networking, test_gethostent)
{
	struct hostent *he;

	sethostent(1);
	he = gethostent();
	zassert_not_null(he);
	zassert_str_equal(he->h_name, "localhost");
	endhostent();
}

ZTEST(posix_networking, test_sethostent)
{
	sethostent(0);
	zassert_not_null(gethostent());
	endhostent();
}

ZTEST(posix_networking, test_endhostent)
{
	sethostent(1);
	zassert_not_null(gethostent());
	endhostent();
	endhostent();
}
```

## src/netdb_networks.c
```c
/*
 * SPDX-FileCopyrightText: Copyright The Zephyr Project Contributors
 * SPDX-License-Identifier: Apache-2.0
 */

#include <netdb.h>
#include <sys/socket.h>

#include <zephyr/ztest.h>

ZTEST(posix_networking, test_getnetbyname)
{
	struct netent *ne;
	struct netent *ref;

	setnetent(1);
	ref = getnetent();
	zassume_not_null(ref, "no networks in /etc/networks");
	endnetent();

	ne = getnetbyname(ref->n_name);
	zassert_not_null(ne);
	zassert_str_equal(ne->n_name, ref->n_name);
	zassert_equal(ne->n_net, ref->n_net);
}

ZTEST(posix_networking, test_getnetbyaddr)
{
	struct netent *ne;
	struct netent *ref;

	setnetent(1);
	ref = getnetent();
	zassume_not_null(ref, "no networks in /etc/networks");
	endnetent();

	ne = getnetbyaddr(ref->n_net, AF_INET);
	zassert_not_null(ne);
	zassert_str_equal(ne->n_name, ref->n_name);
}

ZTEST(posix_networking, test_getnetent)
{
	struct netent *ne;

	setnetent(1);
	ne = getnetent();
	zassert_not_null(ne);
	endnetent();
}

ZTEST(posix_networking, test_setnetent)
{
	setnetent(0);
	zassert_not_null(getnetent());
	endnetent();
}

ZTEST(posix_networking, test_endnetent)
{
	setnetent(1);
	zassert_not_null(getnetent());
	endnetent();
}

#if !defined(CONFIG_NATIVE_LIBC)
ZTEST(posix_networking, test_getnetbyname_loopback_fallback)
{
	struct netent *ne;

	/*
	 * /etc/networks omits loopback; scan_networks() uses the built-in
	 * fallback table in netdb_ent.c.
	 */
	ne = getnetbyname("loopback");
	zassert_not_null(ne);
	zassert_str_equal(ne->n_name, "loopback");
	zassert_equal(ne->n_net, 127U);
}
#endif /* !CONFIG_NATIVE_LIBC */
```

## src/netdb_protocols.c
```c
/*
 * SPDX-FileCopyrightText: Copyright The Zephyr Project Contributors
 * SPDX-License-Identifier: Apache-2.0
 */

#include <netdb.h>

#include <zephyr/ztest.h>

ZTEST(posix_networking, test_getprotobyname)
{
	struct protoent *pe;

	pe = getprotobyname("tcp");
	zassert_not_null(pe);
	zassert_equal(pe->p_proto, 6);
}

ZTEST(posix_networking, test_getprotobynumber)
{
	struct protoent *pe;

	pe = getprotobynumber(17);
	zassert_not_null(pe);
	zassert_str_equal(pe->p_name, "udp");
}

ZTEST(posix_networking, test_getprotoent)
{
	struct protoent *pe;

	setprotoent(1);
	pe = getprotoent();
	zassert_not_null(pe);
	endprotoent();
}

ZTEST(posix_networking, test_setprotoent)
{
	setprotoent(0);
	zassert_not_null(getprotoent());
	endprotoent();
}

ZTEST(posix_networking, test_endprotoent)
{
	setprotoent(1);
	zassert_not_null(getprotoent());
	endprotoent();
}
```
