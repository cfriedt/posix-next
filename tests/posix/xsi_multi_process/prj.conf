## CMakeLists.txt
```
# SPDX-License-Identifier: Apache-2.0

cmake_minimum_required(VERSION 3.20.0)
find_package(Zephyr REQUIRED HINTS $ENV{ZEPHYR_BASE})
project(xsi_multi_process)

FILE(GLOB app_sources src/*.c)
target_sources(app PRIVATE ${app_sources})

target_compile_options(app PRIVATE -U_POSIX_C_SOURCE -D_POSIX_C_SOURCE=200809L)
target_compile_options(app PRIVATE -U_XOPEN_SOURCE -D_XOPEN_SOURCE=700)
```

## prj.conf
```kconfig
CONFIG_ZTEST=y

CONFIG_POSIX_AEP_CHOICE_BASE=y
CONFIG_POSIX_MULTI_PROCESS=y
CONFIG_XSI=y
CONFIG_XSI_MULTI_PROCESS=y

CONFIG_HEAP_MEM_POOL_SIZE=16384
CONFIG_MAIN_STACK_SIZE=2048
```

## src/main.c
```c
/*
 * SPDX-FileCopyrightText: Copyright The Zephyr Project Contributors
 * SPDX-License-Identifier: Apache-2.0
 */

#include <zephyr/ztest.h>

ZTEST_SUITE(xsi_multi_process, NULL, NULL, NULL, NULL, NULL);
```

## src/getrlimit.c
```c
/*
 * SPDX-FileCopyrightText: Copyright The Zephyr Project Contributors
 * SPDX-License-Identifier: Apache-2.0
 */

#include <errno.h>
#include <sys/resource.h>

#include <zephyr/ztest.h>

ZTEST_USER(xsi_multi_process, test_getrlimit)
{
	static const int resources[] = {
		RLIMIT_CORE, RLIMIT_CPU, RLIMIT_DATA, RLIMIT_FSIZE, RLIMIT_NOFILE, RLIMIT_STACK, RLIMIT_AS,
	};
	struct rlimit rl;

	/* every resource POSIX names has a pair of limits, soft within hard */
	ARRAY_FOR_EACH(resources, i) {
		zassert_ok(getrlimit(resources[i], &rl), "resource %d: %d", resources[i], errno);
		zassert_true(rl.rlim_cur <= rl.rlim_max, "resource %d: soft limit above the hard one",
			     resources[i]);
	}

	zassert_ok(getrlimit(RLIMIT_NOFILE, &rl));
	zassert_true(rl.rlim_cur > 0);
	if (!IS_ENABLED(CONFIG_NATIVE_LIBC)) {
		/* the build's limits, hard equal to soft */
		zassert_equal(rl.rlim_cur, ZVFS_OPEN_SIZE);
		zassert_equal(rl.rlim_max, ZVFS_OPEN_SIZE);
		zassert_ok(getrlimit(RLIMIT_CORE, &rl));
		zassert_equal(rl.rlim_cur, 0, "a core file is never written");
		zassert_ok(getrlimit(RLIMIT_CPU, &rl));
		zassert_equal(rl.rlim_cur, RLIM_INFINITY);
	}

	errno = 0;
	zassert_equal(getrlimit(-1, &rl), -1);
	zassert_equal(errno, EINVAL);
	errno = 0;
	zassert_equal(getrlimit(1000, &rl), -1);
	zassert_equal(errno, EINVAL);
}
```

## src/getrusage.c
```c
/*
 * SPDX-FileCopyrightText: Copyright The Zephyr Project Contributors
 * SPDX-License-Identifier: Apache-2.0
 */

#include <errno.h>
#include <sys/resource.h>

#include <zephyr/kernel.h>
#include <zephyr/ztest.h>

static uint64_t cpu_us(const struct rusage *ru)
{
	return ((uint64_t)ru->ru_utime.tv_sec * USEC_PER_SEC + ru->ru_utime.tv_usec) +
	       ((uint64_t)ru->ru_stime.tv_sec * USEC_PER_SEC + ru->ru_stime.tv_usec);
}

ZTEST_USER(xsi_multi_process, test_getrusage)
{
	struct rusage before;
	struct rusage after;

	errno = 0;
	zassert_equal(getrusage(42, &after), -1);
	zassert_equal(errno, EINVAL);

	/* the calling process's CPU time moves while it computes */
	zassert_ok(getrusage(RUSAGE_SELF, &before));
	k_busy_wait(50 * USEC_PER_MSEC);
	zassert_ok(getrusage(RUSAGE_SELF, &after));
	zassert_true(cpu_us(&after) > cpu_us(&before), "CPU time did not advance: %llu -> %llu",
		     cpu_us(&before), cpu_us(&after));
	zassert_true(after.ru_utime.tv_usec >= 0 && after.ru_utime.tv_usec < USEC_PER_SEC);

	/* nothing has been waited for: the children's time is nil */
	zassert_ok(getrusage(RUSAGE_CHILDREN, &after));
	zassert_equal(cpu_us(&after), 0);
	zassert_equal(after.ru_maxrss, 0);
}
```

## src/setrlimit.c
```c
/*
 * SPDX-FileCopyrightText: Copyright The Zephyr Project Contributors
 * SPDX-License-Identifier: Apache-2.0
 */

#include <errno.h>
#include <sys/resource.h>

#include <zephyr/ztest.h>

ZTEST_USER(xsi_multi_process, test_setrlimit)
{
	struct rlimit rl;
	struct rlimit bad;

	zassert_ok(getrlimit(RLIMIT_NOFILE, &rl));

	/* the current limits are accepted as they are */
	zassert_ok(setrlimit(RLIMIT_NOFILE, &rl));

	/* a soft limit above the hard limit is no limit */
	if (rl.rlim_max != RLIM_INFINITY) {
		bad = rl;
		bad.rlim_cur = bad.rlim_max + 1;
		errno = 0;
		zassert_equal(setrlimit(RLIMIT_NOFILE, &bad), -1);
		zassert_equal(errno, EINVAL);
	}

	errno = 0;
	zassert_equal(setrlimit(-1, &rl), -1);
	zassert_equal(errno, EINVAL);

	if (!IS_ENABLED(CONFIG_NATIVE_LIBC)) {
		/* the limits are the build's: a change, up or down, is refused */
		bad = rl;
		bad.rlim_cur = rl.rlim_cur - 1;
		errno = 0;
		zassert_equal(setrlimit(RLIMIT_NOFILE, &bad), -1);
		zassert_equal(errno, EPERM);
		bad = rl;
		bad.rlim_max = rl.rlim_max + 1;
		bad.rlim_cur = bad.rlim_max;
		errno = 0;
		zassert_equal(setrlimit(RLIMIT_NOFILE, &bad), -1);
		zassert_equal(errno, EPERM);
		/* and what it refused is still in force */
		zassert_ok(getrlimit(RLIMIT_NOFILE, &bad));
		zassert_equal(bad.rlim_cur, rl.rlim_cur);
		zassert_equal(bad.rlim_max, rl.rlim_max);
	}
}
```
