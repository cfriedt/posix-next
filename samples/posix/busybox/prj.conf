## CMakeLists.txt
```
# SPDX-License-Identifier: Apache-2.0

cmake_minimum_required(VERSION 3.20.0)
find_package(Zephyr REQUIRED HINTS $ENV{ZEPHYR_BASE})
project(posix_busybox)

target_sources(app PRIVATE src/main.c src/compat.c)

target_compile_options(app PRIVATE
  -U_POSIX_C_SOURCE -D_POSIX_C_SOURCE=200809L
  -U_XOPEN_SOURCE -D_XOPEN_SOURCE=700
)

# the busybox module builds busybox.llext; embed it for installation into ext2
add_dependencies(app busybox_llext)
generate_inc_file_for_target(app ${BUSYBOX_LLEXT_FILE}
  ${ZEPHYR_BINARY_DIR}/include/generated/busybox.inc
)
```

## sample.yaml
```
sample:
  description: run busybox applets as processes exec'd from an ext2 file system
  name: posix busybox
common:
  tags:
    - posix
    - exec
    - llext
  build_only: false
  harness: console
  harness_config:
    type: multi_line
    ordered: true
    regex:
      - "hello world"
      - "Hello from busybox on Zephyr!"
      - "motd"
      - "bytes from 127[.]0[.]0[.]1"
      - "bytes from ::1"
      - "hello from hush"
      - "saw /etc/motd"
      - "hex of 42 is 2a"
      - "case matched zephyr"
      - "busybox sample complete"
  timeout: 180
tests:
  sample.posix.busybox:
    # 32-bit targets need an off_t story for busybox's CONFIG_LFS first
    platform_allow:
      - qemu_cortex_a53
      - qemu_riscv64
    integration_platforms:
      - qemu_riscv64
  sample.posix.busybox.gateway:
    # qemu user-mode networking: e1000 to the SLIRP virtual gateway, no
    # host-side TAP or privileges needed
    platform_allow:
      - qemu_cortex_a53
    extra_configs:
      - CONFIG_NET_TEST=n
      - CONFIG_NET_SLIP_TAP=n
      - CONFIG_NET_QEMU_USER=y
      - CONFIG_NET_L2_ETHERNET=y
      - CONFIG_ETH_DRIVER=y
      - CONFIG_NET_DEFAULT_IF_ETHERNET=y
      - CONFIG_NET_CONFIG_SETTINGS=y
      - CONFIG_NET_CONFIG_NEED_IPV4=y
      - CONFIG_NET_CONFIG_MY_IPV4_ADDR="10.0.2.15"
      - CONFIG_NET_CONFIG_MY_IPV4_NETMASK="255.255.255.0"
      - CONFIG_NET_CONFIG_MY_IPV4_GW="10.0.2.2"
      # the PCIe ECAM window alone is 256 MB of kernel VM
      - CONFIG_KERNEL_VM_SIZE=0x30000000
      - CONFIG_MAX_XLAT_TABLES=128
      # name resolution: Zephyr's resolver with Google's public servers (SLIRP
      # NATs the queries). The resolver's socket service handles replies on its
      # own thread, whose default 1200-byte stack overflows on 64-bit targets,
      # one network context is taken per server, and the service polls them.
      - CONFIG_NET_IPV6=y
      - CONFIG_NET_CONFIG_NEED_IPV6=y
      - CONFIG_NET_CONFIG_MY_IPV6_ADDR="fec0::15"
      - CONFIG_DNS_RESOLVER=y
      - CONFIG_DNS_SERVER_IP_ADDRESSES=y
      - CONFIG_DNS_RESOLVER_MAX_SERVERS=4
      - CONFIG_DNS_SERVER1="8.8.8.8"
      - CONFIG_DNS_SERVER2="8.8.4.4"
      - CONFIG_DNS_SERVER3="2001:4860:4860::8888"
      - CONFIG_DNS_SERVER4="2001:4860:4860::8844"
      - CONFIG_NET_SOCKETS_SERVICE_STACK_SIZE=4096
      - CONFIG_NET_MAX_CONTEXTS=16
      - CONFIG_ZVFS_POLL_MAX=16
    harness_config:
      type: multi_line
      ordered: true
      regex:
        - "hello world"
        - "Hello from busybox on Zephyr!"
        - "motd"
        - "bytes from 127[.]0[.]0[.]1"
        - "bytes from ::1"
        - "bytes from 10[.]0[.]2[.]2"
        - "bytes from fec0::2"
        - "dns[.]google"
        - "busybox sample complete"
```

## prj.conf
```kconfig
# SPDX-License-Identifier: Apache-2.0

CONFIG_BUSYBOX=y

CONFIG_POSIX_AEP_CHOICE_PSE53=y
# PSE53 without the queues, shared memory and packet sockets the shell never uses
CONFIG_POSIX_MESSAGE_PASSING=n
CONFIG_POSIX_SHARED_MEMORY_OBJECTS=n
CONFIG_POSIX_RAW_SOCKETS=n
CONFIG_POSIX_JOB_CONTROL=y
CONFIG_POSIX_EXEC_LLEXT=y
CONFIG_POSIX_DEVICE_SPECIFIC=y
CONFIG_POSIX_DEVICE_SPECIFIC_R=y
CONFIG_POSIX_FILE_SYSTEM_GLOB=y
CONFIG_POSIX_FILE_ATTRIBUTES=y
CONFIG_POSIX_REGEXP=y
CONFIG_POSIX_SYMBOLIC_LINKS=y
CONFIG_POSIX_SYSTEM_DATABASE=y
CONFIG_POSIX_USER_GROUPS=y
CONFIG_POSIX_USER_GROUPS_R=y

CONFIG_POSIX_NETWORKING=y

# loopback networking so ping can reach 127.0.0.1. NET_TEST keeps the qemu
# boards off their host-backed NICs (SLIP over uart_pipe, e1000 over a host
# TAP), which hang or fail without host-side setup; loopback needs neither.
CONFIG_NETWORKING=y
CONFIG_NET_TEST=y
CONFIG_NET_DRIVERS=y
CONFIG_NET_LOOPBACK=y
CONFIG_NET_IPV4=y
CONFIG_NET_SOCKETS=y
CONFIG_NET_SOCKETS_INET_RAW=y
CONFIG_NET_PKT_RX_COUNT=8
CONFIG_NET_PKT_TX_COUNT=8
CONFIG_NET_BUF_RX_COUNT=16
CONFIG_NET_BUF_TX_COUNT=16
# loopback nests tx -> rx -> icmp reply -> rx in one thread
CONFIG_NET_TX_STACK_SIZE=8192
CONFIG_NET_RX_STACK_SIZE=8192
# interface bring-up transmits from the system workqueue (NET_TC_TX_COUNT=0)
CONFIG_SYSTEM_WORKQUEUE_STACK_SIZE=4096

CONFIG_XSI=y
CONFIG_XSI_SINGLE_PROCESS=y
CONFIG_XSI_STREAMS=y

CONFIG_LLEXT=y
CONFIG_POSIX_LLEXT_SYMBOLS=y
CONFIG_LLEXT_TYPE_ELF_RELOCATABLE=y
CONFIG_LLEXT_HEAP_SIZE=2048

CONFIG_FILE_SYSTEM=y
CONFIG_FILE_SYSTEM_EXT2=y
CONFIG_FILE_SYSTEM_MKFS=y
CONFIG_DISK_ACCESS=y
CONFIG_DISK_DRIVER_RAM=y
CONFIG_TEST_RANDOM_GENERATOR=y
CONFIG_ZVFS_STDIN_CONSOLE=y

CONFIG_SYS_PROCESS_MAX=8
CONFIG_SYS_THREAD_STACK_SIZE=8192
CONFIG_SYS_PROCESS_ARG_BYTES=1024
CONFIG_POSIX_EXEC_ARGS_MAX=32
CONFIG_HEAP_MEM_POOL_SIZE=524288
CONFIG_COMMON_LIBC_MALLOC_ARENA_SIZE=131072

# room for multi-stage pipelines: several simultaneous pipes plus the
# shell's stdio, ext2, and cwd descriptors
CONFIG_ZVFS_OPEN_MAX=32
CONFIG_ZVFS_PROC_OPEN_MAX=16
CONFIG_ZVFS_PIPE_MAX=8
CONFIG_ZVFS_OPEN_ADD_SIZE_PIPE=16
CONFIG_MAIN_STACK_SIZE=16384
```

## boards/qemu_cortex_a53.conf
```kconfig
# SPDX-License-Identifier: Apache-2.0

# room for the RAM disk, the llext heap, and the per-process stacks
CONFIG_MAX_XLAT_TABLES=64
CONFIG_KERNEL_VM_SIZE=0x8000000
CONFIG_HEAP_MEM_POOL_SIZE=2097152
```

## boards/qemu_riscv64_qemu_virt_riscv64.conf
```kconfig
# SPDX-FileCopyrightText: Copyright The Zephyr Project Contributors
# SPDX-License-Identifier: Apache-2.0

# the image outgrows the 8 MiB default kernel virtual region, and its kernel
# mappings plus every process's domain tables outgrow the page-table pool
CONFIG_KERNEL_VM_SIZE=0x2000000
CONFIG_MAX_XLAT_TABLES=64

# busybox ping6 gives up before the loopback reply when idle time warps
# under icount; the M-mode variant this sample grew up on has icount off
CONFIG_QEMU_ICOUNT=n
```

## app.overlay
```dts
/*
 * SPDX-FileCopyrightText: Copyright The Zephyr Project Contributors
 *
 * SPDX-License-Identifier: Apache-2.0
 */

/ {
	ramdisk0 {
		compatible = "zephyr,ram-disk";
		disk-name = "RAM";
		sector-size = <512>;
		sector-count = <8192>;
	};
};
```

## src/main.c
```c
/*
 * Copyright (c) 2026, Friedt Professional Engineering Services, Inc.
 *
 * SPDX-License-Identifier: Apache-2.0
 */

#include <errno.h>
#include <signal.h>
#include <spawn.h>
#include <stdio.h>
#include <string.h>
#include <sys/wait.h>
#include <unistd.h>

#include <zephyr/app_memory/app_memdomain.h>
#include <zephyr/fs/fs.h>
#include <zephyr/kernel.h>

#define BUSYBOX_PATH "/bin/busybox"

static struct fs_mount_t root_mnt = {
	.type = FS_EXT2,
	.mnt_point = "/",
	.storage_dev = (void *)"RAM",
};

static const uint8_t busybox_image[] __aligned(8) = {
#include "busybox.inc"
};

extern char **environ;

static int write_file(const char *path, const void *data, size_t len)
{
	struct fs_file_t f;
	int ret;

	fs_file_t_init(&f);
	ret = fs_open(&f, path, FS_O_CREATE | FS_O_WRITE);
	if (ret < 0) {
		printf("creating %s failed: %d\n", path, ret);
		return ret;
	}
	/* one fs block at a time: a single 100 KiB+ fs_write() to ext2 has
	 * been seen to corrupt the file's first blocks
	 */
	for (size_t off = 0; off < len;) {
		ssize_t n = fs_write(&f, (const uint8_t *)data + off, MIN(1024, len - off));

		if (n <= 0) {
			printf("writing %s at %zu failed: %zd\n", path, off, n);
			ret = -1;
			break;
		}
		off += n;
	}
	(void)fs_close(&f);

	return (ret < 0) ? ret : 0;
}

static int run(const char *path, char *const argv[])
{
	pid_t pid;
	int status = 0;
	int ret;

	printf("\n$ %s", argv[0]);
	for (int i = 1; argv[i] != NULL; i++) {
		printf(" %s", argv[i]);
	}
	printf("\n");

	ret = posix_spawn(&pid, path, NULL, NULL, argv, environ);
	if (ret != 0) {
		printf("posix_spawn() failed: %d\n", ret);
		return -1;
	}

	if (waitpid(pid, &status, 0) < 0) {
		printf("waitpid() failed: %d\n", errno);
		return -1;
	}

	if (WIFEXITED(status) && (WEXITSTATUS(status) != 0)) {
		printf("exit status: %d\n", WEXITSTATUS(status));
	}

	return status;
}

#define RUN(...) run(BUSYBOX_PATH, (char *const[]){"busybox", __VA_ARGS__, NULL})
#define RUN_AS(name, ...) run("/bin/" name, (char *const[]){name, __VA_ARGS__, NULL})

int main(void)
{
#ifdef CONFIG_USERSPACE
	/* what busybox's processes touch of the system's shared state: directory streams
	 * and the user and group databases
	 */
	extern struct k_mem_partition zvfs_dir_partition;
	extern struct k_mem_partition posix_system_database_partition;

	(void)k_mem_domain_add_partition(&k_mem_domain_default, &zvfs_dir_partition);
	(void)k_mem_domain_add_partition(&k_mem_domain_default, &posix_system_database_partition);
#endif /* CONFIG_USERSPACE */
	static const char passwd[] = "root:x:0:0:root:/root:/bin/sh\n";
	static const char group[] = "root:x:0:\n";
	static const char motd[] = "Hello from busybox on Zephyr!\n";
	int ret;

	ret = fs_mkfs(FS_EXT2, (uintptr_t)"RAM", NULL, 0);
	if (ret < 0) {
		printf("mkfs failed: %d\n", ret);
		return ret;
	}

	ret = fs_mount(&root_mnt);
	if (ret < 0) {
		printf("mount failed: %d\n", ret);
		return ret;
	}

	(void)fs_mkdir("/bin");
	(void)fs_mkdir("/etc");
	(void)fs_mkdir("/root");

	if (write_file("/etc/passwd", passwd, strlen(passwd)) < 0 ||
	    write_file("/etc/group", group, strlen(group)) < 0 ||
	    write_file("/etc/motd", motd, strlen(motd)) < 0 ||
	    write_file("/bin/busybox", busybox_image, sizeof(busybox_image)) < 0) {
		return -1;
	}

	RUN("uname", "-a");
	RUN("echo", "hello", "world");
	RUN("cat", "/etc/motd");
	RUN("mkdir", "/tmp");
	RUN("pwd");
	RUN("ls", "-l", "/etc");

	/* symbolic links on ext2: create, read back, follow */
	RUN("ln", "-s", "motd", "/etc/motd.lnk");
	RUN("readlink", "/etc/motd.lnk");
	RUN("cat", "/etc/motd.lnk");

	/* the classic busybox install: every applet becomes a /bin symlink to
	 * the binary, exec follows the link, and busybox dispatches on argv[0]
	 */
	RUN("--install", "-s", "/bin");
	RUN("ping", "-c", "1", "127.0.0.1");
	RUN("ping6", "-c", "1", "::1");
#ifdef CONFIG_NET_CONFIG_SETTINGS
	/* a real interface is configured: reach past the loopback */
	RUN("ping", "-c", "1", CONFIG_NET_CONFIG_MY_IPV4_GW);
#ifdef CONFIG_NET_CONFIG_NEED_IPV6
	RUN("ping6", "-c", "1", "fec0::2");
#endif
#ifdef CONFIG_DNS_RESOLVER
	/* a name, through the resolver; the echo itself needs the host's internet */
	RUN("ping", "-c", "1", "dns.google");
#endif
#endif
	RUN_AS("ls", "-l", "/bin");

	/* hush: builtins, variables, globbing, and control flow run in the
	 * shell process itself; pipelines and external commands need fork()
	 * (user-mode processes with CONFIG_PROCESS_VM) and are not yet part
	 * of the demo
	 */
	static const char init_sh[] = "echo hush: hello from $0\n"
				      "uname -m\n"
				      "for f in /etc/*; do echo saw $f; done\n"
				      "ls /etc | cat\n"
				      "printf 'hex of 42 is %x\\n' 42\n"
				      "x=zephyr\n"
				      "case $x in z*) echo case matched $x ;; esac\n";

	if (write_file("/etc/init.sh", init_sh, strlen(init_sh)) == 0) {
		RUN("sh", "-c", "echo hello from hush | cat");
		RUN("sh", "/etc/init.sh");
	}

	printf("\nbusybox sample complete\n");

	/* and finally: a shell on the console. Ctrl-D or 'exit' leaves it. */
	printf("\nstarting an interactive shell\n");
	RUN("sh");
	printf("goodbye\n");

	return 0;
}
```

## src/compat.c
```c
/*
 * Copyright (c) 2026, Friedt Professional Engineering Services, Inc.
 *
 * SPDX-License-Identifier: Apache-2.0
 */

/*
 * Stand-ins for symbols busybox links against that Zephyr does not provide.
 * They sit on code paths the enabled applets never take at runtime; each
 * fails cleanly if ever reached.
 */

#include <errno.h>
#include <stddef.h>
#include <stdlib.h>
#include <string.h>
#include <sys/socket.h>
#include <sys/time.h>
#include <unistd.h>

#include <zephyr/llext/symbol.h>

char *realpath(const char *path, char *resolved)
{
	/* no dot-segment or symlink canonicalization: absolute paths pass through */
	if ((path == NULL) || (path[0] != '/')) {
		errno = (path == NULL) ? EINVAL : ENOENT;
		return NULL;
	}

	if (resolved == NULL) {
		return strdup(path);
	}

	(void)strcpy(resolved, path);

	return resolved;
}
EXPORT_SYMBOL(realpath);


/* busybox's disabled ulimit builtin still links these from a live object */
struct rlimit;

int getrlimit(int resource, struct rlimit *rlp)
{
	ARG_UNUSED(resource);
	ARG_UNUSED(rlp);
	errno = ENOSYS;
	return -1;
}
EXPORT_SYMBOL(getrlimit);

int setrlimit(int resource, const struct rlimit *rlp)
{
	ARG_UNUSED(resource);
	ARG_UNUSED(rlp);
	errno = ENOSYS;
	return -1;
}
EXPORT_SYMBOL(setrlimit);

int chroot(const char *path)
{
	ARG_UNUSED(path);
	errno = ENOSYS;
	return -1;
}
EXPORT_SYMBOL(chroot);

int mallopt(int param, int value)
{
	ARG_UNUSED(param);
	ARG_UNUSED(value);
	return 0;
}
EXPORT_SYMBOL(mallopt);

char *mktemp(char *tmpl)
{
	if (tmpl != NULL) {
		tmpl[0] = '\0';
	}
	errno = ENOSYS;
	return tmpl;
}
EXPORT_SYMBOL(mktemp);

int settimeofday(const struct timeval *tv, const void *tz)
{
	ARG_UNUSED(tv);
	ARG_UNUSED(tz);
	errno = ENOSYS;
	return -1;
}
EXPORT_SYMBOL(settimeofday);



char *dirname(char *path)
{
	char *slash;

	if ((path == NULL) || (*path == '\0')) {
		return ".";
	}

	slash = strrchr(path, '/');
	if (slash == NULL) {
		return ".";
	}
	if (slash == path) {
		return "/";
	}
	*slash = '\0';

	return path;
}
EXPORT_SYMBOL(dirname);

#ifndef CONFIG_POSIX_NETWORKING
int socket(int domain, int type, int protocol)
{
	ARG_UNUSED(domain);
	ARG_UNUSED(type);
	ARG_UNUSED(protocol);
	errno = EAFNOSUPPORT;
	return -1;
}
EXPORT_SYMBOL(socket);

int bind(int sock, const struct sockaddr *addr, socklen_t addrlen)
{
	ARG_UNUSED(sock);
	ARG_UNUSED(addr);
	ARG_UNUSED(addrlen);
	errno = EBADF;
	return -1;
}
EXPORT_SYMBOL(bind);

int listen(int sock, int backlog)
{
	ARG_UNUSED(sock);
	ARG_UNUSED(backlog);
	errno = EBADF;
	return -1;
}
EXPORT_SYMBOL(listen);

ssize_t sendto(int sock, const void *buf, size_t len, int flags,
	       const struct sockaddr *dest_addr, socklen_t addrlen)
{
	ARG_UNUSED(sock);
	ARG_UNUSED(buf);
	ARG_UNUSED(len);
	ARG_UNUSED(flags);
	ARG_UNUSED(dest_addr);
	ARG_UNUSED(addrlen);
	errno = EBADF;
	return -1;
}
EXPORT_SYMBOL(sendto);
#endif /* CONFIG_POSIX_NETWORKING */
```

## src/exports.c
```c
/*
 * Copyright (c) 2026, Friedt Professional Engineering Services, Inc.
 *
 * SPDX-License-Identifier: Apache-2.0
 */

/*
 * The symbol table the busybox extension links against at load time: every
 * libc and POSIX symbol busybox references must be exported by the image.
 */

#include <ctype.h>
#include <dirent.h>
#include <errno.h>
#include <fcntl.h>
#include <fnmatch.h>
#include <glob.h>
#include <poll.h>
#include <signal.h>
#include <grp.h>
#include <pwd.h>
#include <spawn.h>
#include <stdio.h>
#include <stdlib.h>
#include <string.h>
#include <strings.h>
#include <sys/ioctl.h>
#include <sys/mman.h>
#include <sys/socket.h>
#include <sys/stat.h>
#include <sys/time.h>
#include <sys/utsname.h>
#include <termios.h>
#include <sys/wait.h>
#include <time.h>
#include <unistd.h>

#include <zephyr/getopt.h>
#include <zephyr/llext/symbol.h>

/* errno may be thread-local; extensions resolve it per call through this */
int *__errno_location(void)
{
	return &errno;
}
EXPORT_SYMBOL(__errno_location);

EXPORT_SYMBOL(access);
EXPORT_SYMBOL(atoi);
EXPORT_SYMBOL(chdir);
EXPORT_SYMBOL(chmod);
EXPORT_SYMBOL(close);
EXPORT_SYMBOL(closedir);
EXPORT_SYMBOL(dup2);
EXPORT_SYMBOL(_exit);
EXPORT_SYMBOL(exit);
EXPORT_SYMBOL(fchdir);
EXPORT_SYMBOL(fclose);
EXPORT_SYMBOL(fcntl);
EXPORT_SYMBOL(fdopen);
EXPORT_SYMBOL(fflush);
EXPORT_SYMBOL(fgetc);
EXPORT_SYMBOL(fileno);
EXPORT_SYMBOL(fopen);
EXPORT_SYMBOL(fork);
EXPORT_SYMBOL(fprintf);
EXPORT_SYMBOL(fputc);
EXPORT_SYMBOL(fputs);
EXPORT_SYMBOL(free);
EXPORT_SYMBOL(fstat);
EXPORT_SYMBOL(getcwd);
EXPORT_SYMBOL(getegid);
EXPORT_SYMBOL(getenv);
EXPORT_SYMBOL(geteuid);
EXPORT_SYMBOL(getpid);
EXPORT_SYMBOL(gettimeofday);
EXPORT_SYMBOL(ioctl);
EXPORT_SYMBOL(link);
EXPORT_SYMBOL(localtime);
EXPORT_SYMBOL(lseek);
EXPORT_SYMBOL(lstat);
EXPORT_SYMBOL(malloc);
EXPORT_SYMBOL(memcpy);
EXPORT_SYMBOL(memmove);
EXPORT_SYMBOL(memset);
EXPORT_SYMBOL(mkdir);
EXPORT_SYMBOL(mkstemp);
EXPORT_SYMBOL(mktime);
EXPORT_SYMBOL(mmap);
EXPORT_SYMBOL(open);
EXPORT_SYMBOL(opendir);
EXPORT_SYMBOL(pipe);
EXPORT_SYMBOL(printf);
EXPORT_SYMBOL(puts);
EXPORT_SYMBOL(rand);
EXPORT_SYMBOL(read);
EXPORT_SYMBOL(readdir);
EXPORT_SYMBOL(readlink);
EXPORT_SYMBOL(realloc);
EXPORT_SYMBOL(rename);
EXPORT_SYMBOL(rmdir);
EXPORT_SYMBOL(setenv);
EXPORT_SYMBOL(sprintf);
EXPORT_SYMBOL(srand);
EXPORT_SYMBOL(sscanf);
EXPORT_SYMBOL(stat);
EXPORT_SYMBOL(stderr);
EXPORT_SYMBOL(stdin);
EXPORT_SYMBOL(stdout);
EXPORT_SYMBOL(strchr);
EXPORT_SYMBOL(strcmp);
EXPORT_SYMBOL(strcpy);
EXPORT_SYMBOL(strdup);
EXPORT_SYMBOL(strerror);
EXPORT_SYMBOL(strftime);
EXPORT_SYMBOL(strlen);
EXPORT_SYMBOL(strncasecmp);
EXPORT_SYMBOL(strncmp);
EXPORT_SYMBOL(strncpy);
EXPORT_SYMBOL(strndup);
EXPORT_SYMBOL(strpbrk);
EXPORT_SYMBOL(strrchr);
EXPORT_SYMBOL(strtol);
EXPORT_SYMBOL(strtoll);
EXPORT_SYMBOL(strtoul);
EXPORT_SYMBOL(strtoull);
EXPORT_SYMBOL(symlink);
EXPORT_SYMBOL(time);
EXPORT_SYMBOL(umask);
EXPORT_SYMBOL(uname);
EXPORT_SYMBOL(unlink);
EXPORT_SYMBOL(unsetenv);
EXPORT_SYMBOL(vsnprintf);
EXPORT_SYMBOL(waitpid);
EXPORT_SYMBOL(write);

/* getuid()/getgid() and friends come from POSIX_USER_GROUPS */
EXPORT_SYMBOL(getgid);
EXPORT_SYMBOL(getuid);
EXPORT_SYMBOL(setegid);
EXPORT_SYMBOL(seteuid);
EXPORT_SYMBOL(setgid);
EXPORT_SYMBOL(setuid);

/* busybox keeps its own option-parsing state via the reentrant getopt */
EXPORT_SYMBOL(zephyr_getopt);

/* the terminal: POSIX_DEVICE_SPECIFIC over the console */
EXPORT_SYMBOL(isatty);
EXPORT_SYMBOL(tcgetattr);
EXPORT_SYMBOL(tcsetattr);

/* the shell: pattern matching, signals, process control */
extern char **environ;
EXPORT_SYMBOL(environ);
EXPORT_SYMBOL(execvp);
EXPORT_SYMBOL(fnmatch);
EXPORT_SYMBOL(getc);
EXPORT_SYMBOL(getppid);
EXPORT_SYMBOL(glob);
EXPORT_SYMBOL(globfree);
EXPORT_SYMBOL(poll);
EXPORT_SYMBOL(putenv);
EXPORT_SYMBOL(raise);
EXPORT_SYMBOL(sigaction);
EXPORT_SYMBOL(sigaddset);
EXPORT_SYMBOL(sigdelset);
EXPORT_SYMBOL(sigismember);
EXPORT_SYMBOL(signal);
EXPORT_SYMBOL(sigprocmask);
EXPORT_SYMBOL(sigsuspend);
EXPORT_SYMBOL(strcspn);
EXPORT_SYMBOL(strspn);
EXPORT_SYMBOL(wait);
```
