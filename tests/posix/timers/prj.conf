## CMakeLists.txt
```
# SPDX-License-Identifier: Apache-2.0

cmake_minimum_required(VERSION 3.20.0)
find_package(Zephyr REQUIRED HINTS $ENV{ZEPHYR_BASE})
project(posix_timers)

FILE(GLOB app_sources src/*.c)

target_sources(app PRIVATE ${app_sources} ../common/nanosleep_common.c)

# FIXME: We should not rely on usleep() (which is was dropped in Issue 7, 200809L)
target_compile_options(app PRIVATE -U_POSIX_C_SOURCE -D_POSIX_C_SOURCE=200112L)
target_compile_options(app PRIVATE -U_XOPEN_SOURCE -D_XOPEN_SOURCE=600)
```

## Kconfig
```
# Copyright (c) 2023, Meta
# SPDX-License-Identifier: Apache-2.0

# Options specific to clock.c / test_realtime

config TEST_CLOCK_RT_ITERATIONS
	int "Number of iterations to check clock_gettime() reliability"
	range 10 100
	default 20
	help
	  This option is specific to posix_apis.test_realtime in clock.c

config TEST_CLOCK_RT_SLEEP_MS
	int "Time to sleep between iterations in milliseconds"
	range 50 1000
	default 100
	help
	  This option is specific to posix_apis.test_realtime in clock.c

config TEST_CLOCK_RT_ERROR_MS
	int "Maximum overshoot (error) in milliseconds"
	range 10 500
	default 10
	help
	  This option is specific to posix_apis.test_realtime in clock.c

rsource "../Kconfig.test_common"
source "Kconfig.zephyr"
```

## prj.conf
```kconfig
CONFIG_ZTEST=y

CONFIG_POSIX_AEP_CHOICE_PSE51=y
CONFIG_POSIX_TIMERS=y

CONFIG_SYS_TIMER_MIN_ADD_TEST=2
# SIGEV_THREAD: the singleton watcher plus up to two in-flight notification threads
CONFIG_SYS_THREAD_STACK_MIN_ADD_TEST=3
CONFIG_SYS_THREAD_THREAD_MIN_ADD_TEST=3
# the suite's after() hook drains signals with sigtimedwait() on this stack
CONFIG_MAIN_STACK_SIZE=2048
```

## prj_signal_less.conf
```kconfig
# The reduced mode: kernel timers without signal-based expiry notification
# (CONFIG_TIMER_SIGNAL=n). SIGEV_NONE timers remain fully functional; notifying
# sigevent types report ENOTSUP and timer_getoverrun() reports 0.
#
# Note: CONFIG_SIGNAL itself cannot be disabled in a POSIX configuration --
# POSIX_BASE_DEFINITIONS mandates POSIX_REALTIME_SIGNALS/POSIX_THREADS (Issue 8),
# which select it. CONFIG_TIMER_SIGNAL=n is the reachable reduced mode and
# subsumes the CONFIG_SIGNAL=n kernel behavior at this layer.
CONFIG_ZTEST=y

CONFIG_POSIX_AEP_CHOICE_PSE51=y
CONFIG_POSIX_TIMERS=y
CONFIG_TIMER_SIGNAL=n

CONFIG_SYS_TIMER_MIN_ADD_TEST=2
CONFIG_SYS_THREAD_STACK_MIN_ADD_TEST=3
CONFIG_SYS_THREAD_THREAD_MIN_ADD_TEST=3
```

## src/main.c
```c
/*
 * SPDX-FileCopyrightText: Copyright The Zephyr Project Contributors
 * SPDX-License-Identifier: Apache-2.0
 */

#include "timers_tests.h"
#include <zephyr/logging/log.h>

LOG_MODULE_REGISTER(timer_test);

ZTEST_DMEM timer_t timerid = INVALID_TIMERID;
ZTEST_BMEM volatile int exp_count;
ZTEST_BMEM volatile int fn_overrun;

#ifdef CONFIG_NATIVE_LIBC
/*
 * On the host, timer signals are process-directed and may be delivered to any native
 * simulator service thread, where the default action would kill the process; and a blocking
 * host sigtimedwait() would stall the whole simulator. Instead, a process-wide handler
 * captures deliveries and accept_sig() consumes them from a counter.
 */
static volatile int lc_count;
static int lc_taken;
static siginfo_t lc_info;

static void lc_capture(int signo, siginfo_t *info, void *ctx)
{
	ARG_UNUSED(signo);
	ARG_UNUSED(ctx);

	lc_info = *info;
	++lc_count;
}

void lc_install(int signo)
{
	struct sigaction act = {
		.sa_flags = SA_SIGINFO,
		.sa_sigaction = lc_capture,
	};

	zassert_ok(sigemptyset(&act.sa_mask));
	zassert_ok(sigaction(signo, &act, NULL));
}
#endif /* CONFIG_NATIVE_LIBC */

/* accept one instance of (blocked) signo, waiting up to timeout_ms */
int accept_sig(int signo, siginfo_t *info, int timeout_ms)
{
	sigset_t set;
	struct timespec timeout = {
		.tv_sec = timeout_ms / MSEC_PER_SEC,
		.tv_nsec = (timeout_ms % MSEC_PER_SEC) * NSEC_PER_MSEC,
	};

	zassert_ok(sigemptyset(&set));
	zassert_ok(sigaddset(&set, signo));

#ifdef CONFIG_NATIVE_LIBC
	/*
	 * Consume deliveries against a taken-counter rather than a per-call baseline: an
	 * immediately-expiring timer (e.g. a past TIMER_ABSTIME deadline) can run the handler
	 * on the arming call's syscall-exit path, i.e. before this function is entered, and a
	 * baseline snapshot would wait forever for a count change that already happened.
	 * Like sigtimedwait(), an already-pending delivery satisfies the call.
	 */
	for (int elapsed = 0;; elapsed += 5) {
		if (lc_count != lc_taken) {
			++lc_taken;
			if (info != NULL) {
				*info = lc_info;
			}
			return lc_info.si_signo;
		}
		if (elapsed >= timeout_ms) {
			break;
		}
		test_sleep_ms(5);
	}
	errno = EAGAIN;
	return -1;
#endif /* CONFIG_NATIVE_LIBC */

	return sigtimedwait(&set, info, &timeout);
}

static void before(void *arg)
{
	ARG_UNUSED(arg);

#ifdef CONFIG_NATIVE_LIBC
	lc_install(TEST_SIGNAL_VAL);
	lc_install(SIGALRM);
#else
	if (IS_ENABLED(CONFIG_TIMER_SIGNAL)) {
		/* sigtimedwait()-style acceptance requires the signals to be blocked */
		set_sig_blocked(TEST_SIGNAL_VAL, true);
		set_sig_blocked(SIGALRM, true);
	}
#endif
}

static void after(void *arg)
{
	ARG_UNUSED(arg);

	/* delete leftovers even when an assertion aborted the test mid-way */
	if (timerid != INVALID_TIMERID) {
		(void)timer_delete(timerid);
		timerid = INVALID_TIMERID;
	}

	if (IS_ENABLED(CONFIG_NATIVE_LIBC)) {
		/* let an in-flight delivery from the deleted timer land before consuming */
		test_sleep_ms(5);
		drain_sig(TEST_SIGNAL_VAL);
	} else if (IS_ENABLED(CONFIG_TIMER_SIGNAL)) {
		drain_sig(TEST_SIGNAL_VAL);
		drain_sig(SIGALRM);
	}

	if (!IS_ENABLED(CONFIG_NATIVE_LIBC)) {
		/* let detached notification threads exit before the pool is checked */
		k_msleep(10);
	}
}

ZTEST_SUITE(posix_timers, NULL, NULL, before, after, NULL);
```

## src/clock.c
```c
/*
 * Copyright (c) 2018 Intel Corporation
 * Copyright (c) 2023, Meta
 *
 * SPDX-License-Identifier: Apache-2.0
 */

#include <sys/time.h>
#include <time.h>
#include <unistd.h>

#include <zephyr/sys/timeutil.h>
#include <zephyr/ztest.h>
#include <zephyr/logging/log.h>

#include "../../common/linux_compat_test.h"

#define SLEEP_SECONDS 1
#define CLOCK_INVALID -1

LOG_MODULE_REGISTER(clock_test, LOG_LEVEL_DBG);

/* Set a particular time.  In this case, the output of: `date +%s -d 2018-01-01T15:45:01Z` */
static const struct timespec ref_ts = {1514821501, NSEC_PER_SEC / 2U};

static const clockid_t clocks[] = {
#if defined(_POSIX_MONOTONIC_CLOCK)
	CLOCK_MONOTONIC,
#endif
	CLOCK_REALTIME,
};

static const bool settable[] = {
	false,
	true,
};

ZTEST(posix_timers, test_clock_gettime)
{
	struct timespec ts;

	/* ensure argument validation is performed */
	errno = 0;
	zassert_equal(clock_gettime(CLOCK_INVALID, &ts), -1);
	zassert_equal(errno, EINVAL);

	IF_NOT_NATIVE_LIBC({
		if (false) {
			/* undefined behaviour */
			errno = 0;
			zassert_equal(clock_gettime(clocks[0], NULL), -1);
			zassert_equal(errno, EINVAL);
		}
	})

	/* verify that we can call clock_gettime() on supported clocks */
	ARRAY_FOR_EACH(clocks, i) {
		ts = (struct timespec){-1, -1};
		zassert_ok(clock_gettime(clocks[i], &ts));
		zassert_not_equal(ts.tv_sec, -1);
		zassert_not_equal(ts.tv_nsec, -1);
	}
}

ZTEST(posix_timers, test_clock_settime)
{
	struct timespec diff;
	struct timespec ts = {0};

	BUILD_ASSERT(ARRAY_SIZE(settable) == ARRAY_SIZE(clocks));

	/* setting CLOCK_REALTIME would modify the host clock (and requires privileges) */
	posix_test_skip_if_native_libc();

	/* ensure argument validation is performed */
	errno = 0;
	zassert_equal(clock_settime(CLOCK_INVALID, &ts), -1);
	zassert_equal(errno, EINVAL);

	IF_NOT_NATIVE_LIBC({
		if (false) {
			/* undefined behaviour */
			errno = 0;
			zassert_equal(clock_settime(CLOCK_REALTIME, NULL), -1);
			zassert_equal(errno, EINVAL);
		}
	})

	/* verify nanoseconds */
	errno = 0;
	ts = (struct timespec){0, NSEC_PER_SEC};
	zassert_equal(clock_settime(CLOCK_REALTIME, &ts), -1);
	zassert_equal(errno, EINVAL);
	errno = 0;
	ts = (struct timespec){0, -1};
	zassert_equal(clock_settime(CLOCK_REALTIME, &ts), -1);
	zassert_equal(errno, EINVAL);

	ARRAY_FOR_EACH(clocks, i) {
		if (!settable[i]) {
			/* should fail attempting to set unsettable clocks */
			errno = 0;
			zassert_equal(clock_settime(clocks[i], &ts), -1);
			zassert_equal(errno, EINVAL);
			continue;
		}

		zassert_ok(clock_settime(clocks[i], &ref_ts));

		/* read-back the time */
		zassert_ok(clock_gettime(clocks[i], &ts));
		/* dt should be >= 0, but definitely <= 1s */
		diff = ts;
		zassert_true(timespec_sub(&diff, &ref_ts));
		zassert_true(timespec_compare(&diff, &SYS_TIMESPEC(0, 0)) >= 0);
		zassert_true(timespec_compare(&diff, &SYS_TIMESPEC(1, 0)) <= 0);
	}
}

ZTEST(posix_timers, test_realtime)
{
	struct timespec diff;
	struct timespec then, now;
	/*
	 * For calculating cumulative moving average
	 * Note: we do not want to assert any individual samples due to scheduler noise.
	 * The CMA filters out the noise so we can make an assertion (on average).
	 * https://en.wikipedia.org/wiki/Moving_average#Cumulative_moving_average
	 */
	int64_t cma_prev = 0;
	int64_t cma;
	int64_t x_i;
	/* lower and uppoer boundary for assertion */
	int64_t lo = CONFIG_TEST_CLOCK_RT_SLEEP_MS;
	int64_t hi = CONFIG_TEST_CLOCK_RT_SLEEP_MS + CONFIG_TEST_CLOCK_RT_ERROR_MS;
	/* lower and upper watermark */
	int64_t lo_wm = INT64_MAX;
	int64_t hi_wm = INT64_MIN;

	/* Loop n times, sleeping a little bit for each */
	(void)clock_gettime(CLOCK_REALTIME, &then);
	for (int i = 0; i < CONFIG_TEST_CLOCK_RT_ITERATIONS; ++i) {

		if (IS_ENABLED(CONFIG_NATIVE_LIBC)) {
			/*
			 * Simulated time may lag real time, in which case k_usleep() would
			 * complete without any real time elapsing on the host clock.
			 */
			zassert_ok(usleep(USEC_PER_MSEC * CONFIG_TEST_CLOCK_RT_SLEEP_MS));
		} else {
			zassert_ok(k_usleep(USEC_PER_MSEC * CONFIG_TEST_CLOCK_RT_SLEEP_MS));
		}
		(void)clock_gettime(CLOCK_REALTIME, &now);

		/* Make the delta milliseconds. */
		diff = now;
		(void)timespec_sub(&diff, &then);
		x_i = (int64_t)diff.tv_sec * MSEC_PER_SEC + diff.tv_nsec / NSEC_PER_MSEC;
		then = now;

		if (x_i < lo_wm) {
			/* update low watermark */
			lo_wm = x_i;
		}

		if (x_i > hi_wm) {
			/* update high watermark */
			hi_wm = x_i;
		}

		/* compute cumulative running average */
		cma = (x_i + i * cma_prev) / (i + 1);
		cma_prev = cma;
	}

	LOG_INF("n: %d, sleep: %d, margin: %d, lo: %lld, avg: %lld, hi: %lld",
		CONFIG_TEST_CLOCK_RT_ITERATIONS, CONFIG_TEST_CLOCK_RT_SLEEP_MS,
		CONFIG_TEST_CLOCK_RT_ERROR_MS, lo_wm, cma, hi_wm);
	zassert_between_inclusive(cma, lo, hi);
}

ZTEST(posix_timers, test_clock_getres)
{
	int ret;
	struct timespec res;
	const struct timespec one_ns = {
		.tv_sec = 0,
		.tv_nsec = 1,
	};

	struct arg {
		clockid_t clock_id;
		struct timespec *res;
		int expect;
	};

	const struct arg args[] = {
		/* permuting over "invalid" inputs */
		{CLOCK_INVALID, NULL, -1},
		{CLOCK_INVALID, &res, -1},
		{CLOCK_REALTIME, NULL, 0},
		{CLOCK_MONOTONIC, NULL, 0},
		{CLOCK_PROCESS_CPUTIME_ID, NULL, 0},

		/* all valid inputs */
		{CLOCK_REALTIME, &res, 0},
		{CLOCK_MONOTONIC, &res, 0},
		{CLOCK_PROCESS_CPUTIME_ID, &res, 0},
	};

	ARRAY_FOR_EACH_PTR(args, arg) {
		errno = 0;
		res = (struct timespec){0};
		ret = clock_getres(arg->clock_id, arg->res);
		zassert_equal(ret, arg->expect);
		if (ret != 0) {
			zassert_equal(errno, EINVAL);
			continue;
		}
		if (arg->res != NULL) {
			zassert_true(timespec_compare(arg->res, &one_ns) >= 0);
		}
	}
}
```

## src/clock_getres.c
```c
/*
 * SPDX-FileCopyrightText: Copyright The Zephyr Project Contributors
 * SPDX-License-Identifier: Apache-2.0
 */

#include "timers_tests.h"

#include <zephyr/sys/timeutil.h>

#define CLOCK_INVALID -1

ZTEST(posix_timers, test_clock_getres)
{
	int ret;
	struct timespec res;
	const struct timespec one_ns = {
		.tv_sec = 0,
		.tv_nsec = 1,
	};

	struct arg {
		clockid_t clock_id;
		struct timespec *res;
		int expect;
	};

	const struct arg args[] = {
		/* permuting over "invalid" inputs */
		{CLOCK_INVALID, NULL, -1},
		{CLOCK_INVALID, &res, -1},
		{CLOCK_REALTIME, NULL, 0},
		{CLOCK_MONOTONIC, NULL, 0},
		{CLOCK_PROCESS_CPUTIME_ID, NULL, 0},

		/* all valid inputs */
		{CLOCK_REALTIME, &res, 0},
		{CLOCK_MONOTONIC, &res, 0},
		{CLOCK_PROCESS_CPUTIME_ID, &res, 0},
	};

	ARRAY_FOR_EACH_PTR(args, arg) {
		errno = 0;
		res = (struct timespec){0};
		ret = clock_getres(arg->clock_id, arg->res);
		zassert_equal(ret, arg->expect);
		if (ret != 0) {
			zassert_equal(errno, EINVAL);
			continue;
		}
		if (arg->res != NULL) {
			zassert_true(timespec_compare(arg->res, &one_ns) >= 0);
		}
	}
}
```

## src/clock_gettime.c
```c
/*
 * SPDX-FileCopyrightText: Copyright The Zephyr Project Contributors
 * SPDX-License-Identifier: Apache-2.0
 */

#include "timers_tests.h"

#include <zephyr/sys/timeutil.h>

#define CLOCK_INVALID -1

#include <zephyr/logging/log.h>

LOG_MODULE_DECLARE(timer_test);

static const clockid_t clocks[] = {
#if defined(_POSIX_MONOTONIC_CLOCK)
	CLOCK_MONOTONIC,
#endif
	CLOCK_REALTIME,
};

static void clock_gettime_supported_clocks(void)
{
	struct timespec ts;

	/* ensure argument validation is performed */
	errno = 0;
	zassert_equal(clock_gettime(CLOCK_INVALID, &ts), -1);
	zassert_equal(errno, EINVAL);

	IF_NOT_NATIVE_LIBC({
		if (false) {
			/* undefined behaviour */
			errno = 0;
			zassert_equal(clock_gettime(clocks[0], NULL), -1);
			zassert_equal(errno, EINVAL);
		}
	})

	/* verify that we can call clock_gettime() on supported clocks */
	ARRAY_FOR_EACH(clocks, i) {
		ts = (struct timespec){-1, -1};
		zassert_ok(clock_gettime(clocks[i], &ts));
		zassert_not_equal(ts.tv_sec, -1);
		zassert_not_equal(ts.tv_nsec, -1);
	}
}

static void clock_gettime_realtime_progression(void)
{
	struct timespec diff;
	struct timespec then, now;
	/*
	 * For calculating cumulative moving average
	 * Note: we do not want to assert any individual samples due to scheduler noise.
	 * The CMA filters out the noise so we can make an assertion (on average).
	 * https://en.wikipedia.org/wiki/Moving_average#Cumulative_moving_average
	 */
	int64_t cma_prev = 0;
	int64_t cma;
	int64_t x_i;
	/* lower and uppoer boundary for assertion */
	int64_t lo = CONFIG_TEST_CLOCK_RT_SLEEP_MS;
	int64_t hi = CONFIG_TEST_CLOCK_RT_SLEEP_MS + CONFIG_TEST_CLOCK_RT_ERROR_MS;
	/* lower and upper watermark */
	int64_t lo_wm = INT64_MAX;
	int64_t hi_wm = INT64_MIN;

	/* Loop n times, sleeping a little bit for each */
	(void)clock_gettime(CLOCK_REALTIME, &then);
	for (int i = 0; i < CONFIG_TEST_CLOCK_RT_ITERATIONS; ++i) {

		if (IS_ENABLED(CONFIG_NATIVE_LIBC)) {
			/*
			 * Simulated time may lag real time, in which case k_usleep() would
			 * complete without any real time elapsing on the host clock.
			 */
			zassert_ok(usleep(USEC_PER_MSEC * CONFIG_TEST_CLOCK_RT_SLEEP_MS));
		} else {
			zassert_ok(k_usleep(USEC_PER_MSEC * CONFIG_TEST_CLOCK_RT_SLEEP_MS));
		}
		(void)clock_gettime(CLOCK_REALTIME, &now);

		/* Make the delta milliseconds. */
		diff = now;
		(void)timespec_sub(&diff, &then);
		x_i = (int64_t)diff.tv_sec * MSEC_PER_SEC + diff.tv_nsec / NSEC_PER_MSEC;
		then = now;

		if (x_i < lo_wm) {
			/* update low watermark */
			lo_wm = x_i;
		}

		if (x_i > hi_wm) {
			/* update high watermark */
			hi_wm = x_i;
		}

		/* compute cumulative running average */
		cma = (x_i + i * cma_prev) / (i + 1);
		cma_prev = cma;
	}

	LOG_INF("n: %d, sleep: %d, margin: %d, lo: %lld, avg: %lld, hi: %lld",
		CONFIG_TEST_CLOCK_RT_ITERATIONS, CONFIG_TEST_CLOCK_RT_SLEEP_MS,
		CONFIG_TEST_CLOCK_RT_ERROR_MS, lo_wm, cma, hi_wm);
	zassert_between_inclusive(cma, lo, hi);
}

ZTEST(posix_timers, test_clock_gettime)
{
	clock_gettime_supported_clocks();
	clock_gettime_realtime_progression();
}
```

## src/clock_settime.c
```c
/*
 * SPDX-FileCopyrightText: Copyright The Zephyr Project Contributors
 * SPDX-License-Identifier: Apache-2.0
 */

#include "timers_tests.h"

#include <zephyr/sys/timeutil.h>

#define CLOCK_INVALID -1

/* Set a particular time.  In this case, the output of: `date +%s -d 2018-01-01T15:45:01Z` */
static const struct timespec ref_ts = {1514821501, NSEC_PER_SEC / 2U};

static const clockid_t clocks[] = {
#if defined(_POSIX_MONOTONIC_CLOCK)
	CLOCK_MONOTONIC,
#endif
	CLOCK_REALTIME,
};

static const bool settable[] = {
#if defined(_POSIX_MONOTONIC_CLOCK)
	false,
#endif
	true,
};

ZTEST(posix_timers, test_clock_settime)
{
	struct timespec diff;
	struct timespec ts = {0};

	BUILD_ASSERT(ARRAY_SIZE(settable) == ARRAY_SIZE(clocks));

	/* setting CLOCK_REALTIME would modify the host clock (and requires privileges) */
	posix_test_skip_if_native_libc();

	/* ensure argument validation is performed */
	errno = 0;
	zassert_equal(clock_settime(CLOCK_INVALID, &ts), -1);
	zassert_equal(errno, EINVAL);

	IF_NOT_NATIVE_LIBC({
		if (false) {
			/* undefined behaviour */
			errno = 0;
			zassert_equal(clock_settime(CLOCK_REALTIME, NULL), -1);
			zassert_equal(errno, EINVAL);
		}
	})

	/* verify nanoseconds */
	errno = 0;
	ts = (struct timespec){0, NSEC_PER_SEC};
	zassert_equal(clock_settime(CLOCK_REALTIME, &ts), -1);
	zassert_equal(errno, EINVAL);
	errno = 0;
	ts = (struct timespec){0, -1};
	zassert_equal(clock_settime(CLOCK_REALTIME, &ts), -1);
	zassert_equal(errno, EINVAL);

	ARRAY_FOR_EACH(clocks, i) {
		if (!settable[i]) {
			/* should fail attempting to set unsettable clocks */
			errno = 0;
			zassert_equal(clock_settime(clocks[i], &ts), -1);
			zassert_equal(errno, EINVAL);
			continue;
		}

		zassert_ok(clock_settime(clocks[i], &ref_ts));

		/* read-back the time */
		zassert_ok(clock_gettime(clocks[i], &ts));
		/* dt should be >= 0, but definitely <= 1s */
		diff = ts;
		zassert_true(timespec_sub(&diff, &ref_ts));
		zassert_true(timespec_compare(&diff, &SYS_TIMESPEC(0, 0)) >= 0);
		zassert_true(timespec_compare(&diff, &SYS_TIMESPEC(1, 0)) <= 0);
	}
}
```

## src/nanosleep.c
```c
/*
 * Copyright (c) 2018 Friedt Professional Engineering Services, Inc
 *
 * SPDX-License-Identifier: Apache-2.0
 */

#include <errno.h>
#include <signal.h>
#include <stdint.h>
#include <time.h>

#include <zephyr/kernel.h>
#include <zephyr/sys/clock.h>
#include <zephyr/sys/timeutil.h>
#include <zephyr/ztest.h>

#include "../../shared/linux_compat_test.h"
#include "../../shared/nanosleep_common.h"

static void nanosleep_errors_errno(void)
{
	common_errors(SELECT_NANOSLEEP, CLOCK_REALTIME, 0);
}

static void nanosleep_execution(void)
{
	/* sleep for 1ns */
	common_lower_bound_check(SELECT_NANOSLEEP, 0, 0, 0, 1);

	/* sleep for 1us + 1ns */
	common_lower_bound_check(SELECT_NANOSLEEP, 0, 0, 0, 1001);

	/* sleep for 500000000ns */
	common_lower_bound_check(SELECT_NANOSLEEP, 0, 0, 0, 500000000);

	/* sleep for 1s */
	common_lower_bound_check(SELECT_NANOSLEEP, 0, 0, 1, 0);

	/* sleep for 1s + 1ns */
	common_lower_bound_check(SELECT_NANOSLEEP, 0, 0, 1, 1);

	/* sleep for 1s + 1us + 1ns */
	common_lower_bound_check(SELECT_NANOSLEEP, 0, 0, 1, 1001);
}

static void nanosleep_signal_handler(int sig)
{
	ARG_UNUSED(sig);
}

static void nanosleep_interrupted(void)
{
	struct sigaction act = {.sa_handler = nanosleep_signal_handler};
	struct sigevent sev = {.sigev_notify = SIGEV_SIGNAL, .sigev_signo = SIGUSR1};
	struct itimerspec its = {.it_value = {.tv_nsec = 100 * NSEC_PER_MSEC}};
	struct timespec req = {.tv_sec = 10};
	struct timespec rem = {0};
	sigset_t set;
	timer_t tid;

	/* a caught signal ends the sleep with EINTR and the time left */
	zassert_ok(sigemptyset(&set));
	zassert_ok(sigaddset(&set, SIGUSR1));
	zassert_ok(sigprocmask(SIG_UNBLOCK, &set, NULL));
	zassert_ok(sigaction(SIGUSR1, &act, NULL));
	zassert_ok(timer_create(CLOCK_MONOTONIC, &sev, &tid));
	zassert_ok(timer_settime(tid, 0, &its, NULL));

	zassert_equal(nanosleep(&req, &rem), -1);
	zassert_equal(errno, EINTR);
	zassert_true(rem.tv_sec >= 9, "%lld s left", (long long)rem.tv_sec);

	zassert_ok(timer_delete(tid));
	act.sa_handler = SIG_DFL;
	zassert_ok(sigaction(SIGUSR1, &act, NULL));
	zassert_ok(sigprocmask(SIG_BLOCK, &set, NULL));
}

ZTEST(posix_timers, test_nanosleep)
{
	nanosleep_errors_errno();
	nanosleep_execution();
	/* the host libc delivers a process-directed signal to any of the simulator's host threads */
	if (IS_ENABLED(CONFIG_TIMER_SIGNAL) && !IS_ENABLED(CONFIG_NATIVE_LIBC)) {
		nanosleep_interrupted();
	}
}
```

## src/nanosleep_common.c
```c
/*
 * Copyright (c) 2018 Friedt Professional Engineering Services, Inc
 *
 * SPDX-License-Identifier: Apache-2.0
 */

#include <errno.h>
#include <stdint.h>
#include <time.h>

#include <zephyr/sys/clock.h>
#include <zephyr/ztest.h>

#define SELECT_NANOSLEEP       1
#define SELECT_CLOCK_NANOSLEEP 0

static inline uint64_t cycle_get_64(void)
{
	if (IS_ENABLED(CONFIG_TIMER_HAS_64BIT_CYCLE_COUNTER)) {
		return k_cycle_get_64();
	} else {
		return k_cycle_get_32();
	}
}

int select_nanosleep(int selection, clockid_t clock_id, int flags, const struct timespec *rqtp,
		     struct timespec *rmtp)
{
	if (selection == SELECT_NANOSLEEP) {
		return nanosleep(rqtp, rmtp);
	}

	if (IS_ENABLED(CONFIG_NATIVE_LIBC)) {
		/* the host libc returns the error number instead of setting errno */
		int ret = clock_nanosleep(clock_id, flags, rqtp, rmtp);

		if (ret != 0) {
			errno = ret;
			return -1;
		}

		return 0;
	}

	return clock_nanosleep(clock_id, flags, rqtp, rmtp);
}

/*
 * With the host libc, sleeps happen in host time while the cycle counter tracks simulated
 * time, so time-points must be sampled from the same clock the sleep is measured against.
 */
static uint64_t timepoint_ns(int selection, clockid_t clock_id)
{
#if defined(CONFIG_NATIVE_LIBC)
	struct timespec tp;
	const clockid_t meas_clock =
		(selection == SELECT_CLOCK_NANOSLEEP) ? clock_id : CLOCK_MONOTONIC;

	zassert_ok(clock_gettime(meas_clock, &tp));

	return (uint64_t)tp.tv_sec * NSEC_PER_SEC + tp.tv_nsec;
#else
	ARG_UNUSED(selection);
	ARG_UNUSED(clock_id);

	return cycle_get_64();
#endif
}

/**
 * @brief Check that a call to nanosleep has yielded execution for some minimum time.
 *
 * Check that the actual time slept is >= the total time specified by @p s (in seconds) and
 * @p ns (in nanoseconds).
 *
 * @note The time specified by @p s and @p ns is assumed to be absolute (i.e. a time-point)
 * when @p selection is set to @ref SELECT_CLOCK_NANOSLEEP. The time is assumed to be relative
 * when @p selection is set to @ref SELECT_NANOSLEEP.
 *
 * @param selection Either @ref SELECT_CLOCK_NANOSLEEP or @ref SELECT_NANOSLEEP
 * @param clock_id The clock to test (e.g. @ref CLOCK_MONOTONIC or @ref CLOCK_REALTIME)
 * @param flags Flags to pass to @ref clock_nanosleep
 * @param s Partial lower bound for yielded time (in seconds)
 * @param ns Partial lower bound for yielded time (in nanoseconds)
 */
void common_lower_bound_check(int selection, clockid_t clock_id, int flags, const uint32_t s,
			      uint32_t ns)
{
	int r;
	uint64_t actual_ns = 0;
	uint64_t exp_ns;
	uint64_t now;
	uint64_t then;
	struct timespec rem = {0, 0};
	struct timespec req = {s, ns};

	errno = 0;
	then = timepoint_ns(selection, clock_id);
	r = select_nanosleep(selection, clock_id, flags, &req, &rem);
	now = timepoint_ns(selection, clock_id);

	zassert_equal(r, 0, "actual: %d expected: %d", r, 0);
	zassert_equal(errno, 0, "actual: %d expected: %d", errno, 0);
	zassert_equal(req.tv_sec, s, "actual: %lld expected: %d", (long long)req.tv_sec, s);
	zassert_equal(req.tv_nsec, ns, "actual: %lld expected: %d", (long long)req.tv_nsec, ns);
	zassert_equal(rem.tv_sec, 0, "actual: %lld expected: %d", (long long)rem.tv_sec, 0);
	zassert_equal(rem.tv_nsec, 0, "actual: %lld expected: %d", (long long)rem.tv_nsec, 0);

	switch (selection) {
	case SELECT_NANOSLEEP:
		/* exp_ns and actual_ns are relative (i.e. durations) */
		if (IS_ENABLED(CONFIG_NATIVE_LIBC)) {
			actual_ns = now - then;
		} else {
			actual_ns = k_cyc_to_ns_ceil64(now + then);
		}
		break;
	case SELECT_CLOCK_NANOSLEEP:
		/* exp_ns and actual_ns are absolute (i.e. time-points) */
		if (IS_ENABLED(CONFIG_NATIVE_LIBC)) {
			actual_ns = now;
		} else {
			actual_ns = k_cyc_to_ns_ceil64(now);
		}
		break;
	default:
		zassert_unreachable();
		break;
	}

	exp_ns = (uint64_t)s * NSEC_PER_SEC + ns;
	/* round up to the nearest microsecond for k_busy_wait() */
	exp_ns = DIV_ROUND_UP(exp_ns, NSEC_PER_USEC) * NSEC_PER_USEC;

/* The comparison may be incorrect if counter wrap happened. In case of ARC HSDK platforms
 * we have high counter clock frequency (500MHz or 1GHz) so counter wrap quite likely to
 * happen if we wait long enough. As in some test cases we wait more than 1 second, there
 * are significant chances to get false-positive assertion.
 * TODO: switch test for k_cycle_get_64 usage where available.
 */
#if !defined(CONFIG_SOC_ARC_HSDK) && !defined(CONFIG_SOC_ARC_HSDK4XD)
	/* lower bounds check */
	zassert_true(actual_ns >= exp_ns, "actual: %llu expected: %llu", actual_ns, exp_ns);
#endif

	/* TODO: Upper bounds check when hr timers are available */
}
```

## src/timer.c
```c
/*
 * SPDX-FileCopyrightText: Copyright The Zephyr Project Contributors
 * SPDX-License-Identifier: Apache-2.0
 */

#include <errno.h>
#include <pthread.h>
#include <signal.h>
#include <time.h>
#include <unistd.h>

#include <zephyr/ztest.h>
#include <zephyr/logging/log.h>


#define INVALID_TIMERID ((timer_t)-1)

#define PERIOD_MS       100
#define PERIOD_NS       (PERIOD_MS * NSEC_PER_MSEC)
#define TEST_SIGNAL_VAL SIGUSR1

LOG_MODULE_REGISTER(timer_test);

static timer_t timerid = INVALID_TIMERID;
static volatile int exp_count;
static volatile int fn_overrun;

/* Block or unblock a signal for the calling thread. */
static void set_sig_blocked(int signo, bool block)
{
	sigset_t set;

	zassert_ok(sigemptyset(&set));
	zassert_ok(sigaddset(&set, signo));
	zassert_ok(pthread_sigmask(block ? SIG_BLOCK : SIG_UNBLOCK, &set, NULL));
}

static void test_sleep_ms(int ms);

#ifdef CONFIG_NATIVE_LIBC
/*
 * On the host, timer signals are process-directed and may be delivered to any native
 * simulator service thread, where the default action would kill the process; and a blocking
 * host sigtimedwait() would stall the whole simulator. Instead, a process-wide handler
 * captures deliveries and accept_sig() consumes them from a counter.
 */
static volatile int lc_count;
static siginfo_t lc_info;

static void lc_capture(int signo, siginfo_t *info, void *ctx)
{
	ARG_UNUSED(signo);
	ARG_UNUSED(ctx);

	lc_info = *info;
	++lc_count;
}

static void lc_install(int signo)
{
	struct sigaction act = {
		.sa_flags = SA_SIGINFO,
		.sa_sigaction = lc_capture,
	};

	zassert_ok(sigemptyset(&act.sa_mask));
	zassert_ok(sigaction(signo, &act, NULL));
}
#endif /* CONFIG_NATIVE_LIBC */

/* accept one instance of (blocked) signo, waiting up to timeout_ms */
static int accept_sig(int signo, siginfo_t *info, int timeout_ms)
{
	sigset_t set;
	struct timespec timeout = {
		.tv_sec = timeout_ms / MSEC_PER_SEC,
		.tv_nsec = (timeout_ms % MSEC_PER_SEC) * NSEC_PER_MSEC,
	};

	zassert_ok(sigemptyset(&set));
	zassert_ok(sigaddset(&set, signo));

#ifdef CONFIG_NATIVE_LIBC
	{
		const int start = lc_count;

		for (int elapsed = 0; elapsed <= timeout_ms; elapsed += 5) {
			if (lc_count != start) {
				if (info != NULL) {
					*info = lc_info;
				}
				return lc_info.si_signo;
			}
			test_sleep_ms(5);
		}
		errno = EAGAIN;
		return -1;
	}
#endif /* CONFIG_NATIVE_LIBC */

	return sigtimedwait(&set, info, &timeout);
}

static void drain_sig(int signo)
{
	while (accept_sig(signo, NULL, 0) >= 0) {
	}
}

static void test_sleep_ms(int ms)
{
	if (IS_ENABLED(CONFIG_NATIVE_LIBC)) {
		/*
		 * host libc timers fire in real time, which simulated time may lag, and
		 * signal delivery interrupts the sleep
		 */
		struct timespec rem = {
			.tv_sec = ms / MSEC_PER_SEC,
			.tv_nsec = (ms % MSEC_PER_SEC) * NSEC_PER_MSEC,
		};

		while ((nanosleep(&rem, &rem) == -1) && (errno == EINTR)) {
		}
	} else {
		k_sleep(K_MSEC(ms));
	}
}

static void arm_ms(timer_t id, int flags, int64_t value_ms, int64_t interval_ms)
{
	struct itimerspec value = {
		.it_value.tv_sec = value_ms / MSEC_PER_SEC,
		.it_value.tv_nsec = (value_ms % MSEC_PER_SEC) * NSEC_PER_MSEC,
		.it_interval.tv_sec = interval_ms / MSEC_PER_SEC,
		.it_interval.tv_nsec = (interval_ms % MSEC_PER_SEC) * NSEC_PER_MSEC,
	};

	zassert_ok(timer_settime(id, flags, &value, NULL));
}

ZTEST(posix_timers, test_create_default_evp)
{
	siginfo_t info = {0};

	/* NULL sigevent: as if SIGEV_SIGNAL, SIGALRM, with the timer ID as the value */
	zassert_ok(timer_create(CLOCK_MONOTONIC, NULL, &timerid));
	arm_ms(timerid, 0, PERIOD_MS, 0);

	zassert_equal(accept_sig(SIGALRM, &info, 10 * PERIOD_MS), SIGALRM,
		      "default-sigevent timer did not deliver SIGALRM");
	zassert_equal(info.si_code, SI_TIMER, "si_code is %d, not SI_TIMER", info.si_code);
	if (!IS_ENABLED(CONFIG_NATIVE_LIBC)) {
		/* the host's default value is a kernel timer id, not the timer_t bits */
		zassert_equal_ptr(info.si_value.sival_ptr, (void *)(uintptr_t)timerid,
				  "default notification value is not the timer ID");
	}
}

ZTEST(posix_timers, test_sigev_signal_delivery)
{
	if (IS_ENABLED(CONFIG_NATIVE_LIBC)) {
		/* the host cannot block process-directed signals across simulator threads */
		ztest_test_skip();
	}
	siginfo_t info = {0};
	struct sigevent sig = {
		.sigev_notify = SIGEV_SIGNAL,
		.sigev_signo = TEST_SIGNAL_VAL,
		.sigev_value.sival_int = TEST_SIGNAL_VAL,
	};

	zassert_ok(timer_create(CLOCK_MONOTONIC, &sig, &timerid));
	arm_ms(timerid, 0, PERIOD_MS, PERIOD_MS);

	/* each accepted expiry signal permits the next to be queued (one-pending model) */
	for (int i = 0; i < 3; ++i) {
		zassert_equal(accept_sig(TEST_SIGNAL_VAL, &info, 10 * PERIOD_MS),
			      TEST_SIGNAL_VAL, "periodic expiry signal %d not delivered", i);
		zassert_equal(info.si_value.sival_int, TEST_SIGNAL_VAL);
		zassert_equal(info.si_code, SI_TIMER);
	}
}

static void sig_handler(int signo, siginfo_t *info, void *ctx)
{
	ARG_UNUSED(ctx);

	++exp_count;
	zassert_equal(signo, TEST_SIGNAL_VAL);
	zassert_equal(info->si_value.sival_int, TEST_SIGNAL_VAL);
}

ZTEST(posix_timers, test_sigev_signal_handler)
{
	struct sigaction act = {
		.sa_flags = SA_SIGINFO,
		.sa_sigaction = sig_handler,
	};
	struct sigaction oact = {0};
	struct sigevent sig = {
		.sigev_notify = SIGEV_SIGNAL,
		.sigev_signo = TEST_SIGNAL_VAL,
		.sigev_value.sival_int = TEST_SIGNAL_VAL,
	};

	exp_count = 0;
	zassert_ok(sigemptyset(&act.sa_mask));
	zassert_ok(sigaction(TEST_SIGNAL_VAL, &act, &oact));
	set_sig_blocked(TEST_SIGNAL_VAL, false);

	zassert_ok(timer_create(CLOCK_MONOTONIC, &sig, &timerid));
	arm_ms(timerid, 0, PERIOD_MS, PERIOD_MS);

	/* delivery happens in this thread's context; sleep in short slices to accept it */
	for (int i = 0; (exp_count < 2) && (i < 100); ++i) {
		test_sleep_ms(PERIOD_MS / 4);
	}
	zassert_true(exp_count >= 2, "handler ran %d times", exp_count);

	zassert_ok(timer_delete(timerid));
	timerid = INVALID_TIMERID;
	set_sig_blocked(TEST_SIGNAL_VAL, true);
	zassert_ok(sigaction(TEST_SIGNAL_VAL, &oact, NULL));
}

ZTEST(posix_timers, test_overrun)
{
	if (IS_ENABLED(CONFIG_NATIVE_LIBC)) {
		/* the host cannot block process-directed signals across simulator threads */
		ztest_test_skip();
	}
	int overrun;
	struct sigevent sig = {
		.sigev_notify = SIGEV_SIGNAL,
		.sigev_signo = TEST_SIGNAL_VAL,
		.sigev_value.sival_int = TEST_SIGNAL_VAL,
	};

	zassert_ok(timer_create(CLOCK_MONOTONIC, &sig, &timerid));
	arm_ms(timerid, 0, PERIOD_MS, PERIOD_MS);

	/* let ~5 periods elapse with the (blocked) signal left pending */
	test_sleep_ms(5 * PERIOD_MS + PERIOD_MS / 2);

	/* exactly one instance is queued; accepting it latches the overrun */
	zassert_equal(accept_sig(TEST_SIGNAL_VAL, NULL, 0), TEST_SIGNAL_VAL);
	zassert_equal(accept_sig(TEST_SIGNAL_VAL, NULL, 0), -1,
		      "more than one signal instance queued for one timer");

	overrun = timer_getoverrun(timerid);
	zassert_true((overrun >= 2) && (overrun <= 6), "overrun %d outside expected window",
		     overrun);
	/* non-destructive: repeated reads return the latched value */
	zassert_equal(timer_getoverrun(timerid), overrun);
	zassert_equal(timer_getoverrun(timerid), overrun);
}

static void thread_fn(union sigval val)
{
	zassert_equal(val.sival_int, TEST_SIGNAL_VAL);
	fn_overrun = timer_getoverrun(timerid);
	++exp_count;
}

ZTEST(posix_timers, test_sigev_thread)
{
	struct sigevent sig = {
		.sigev_notify = SIGEV_THREAD,
		.sigev_notify_function = thread_fn,
		.sigev_value.sival_int = TEST_SIGNAL_VAL,
	};

	exp_count = 0;
	fn_overrun = -1;

	zassert_ok(timer_create(CLOCK_MONOTONIC, &sig, &timerid));
	arm_ms(timerid, 0, PERIOD_MS, PERIOD_MS);

	test_sleep_ms(5 * PERIOD_MS + PERIOD_MS / 2);

	/* the helper accepts each expiry promptly: no coalescing while it keeps up */
	zassert_true(exp_count >= 3, "notification function ran %d times", exp_count);
	/* timer_getoverrun() inside the notification function is valid and non-negative */
	zassert_true(fn_overrun >= 0, "overrun inside notification function: %d", fn_overrun);

	/* deleting with callbacks potentially in flight must be safe */
	zassert_ok(timer_delete(timerid));
	timerid = INVALID_TIMERID;
}

ZTEST(posix_timers, test_sigev_none_gettime)
{
	struct itimerspec its = {0};
	struct sigevent sig = {
		.sigev_notify = SIGEV_NONE,
	};

	zassert_ok(timer_create(CLOCK_MONOTONIC, &sig, &timerid));
	arm_ms(timerid, 0, 2 * PERIOD_MS, 0);

	zassert_ok(timer_gettime(timerid, &its));
	zassert_true((its.it_value.tv_sec > 0) || (its.it_value.tv_nsec > 0),
		     "armed timer reports disarmed");

	test_sleep_ms(3 * PERIOD_MS);

	/* an expired one-shot reports a zero it_value */
	zassert_ok(timer_gettime(timerid, &its));
	zassert_true((its.it_value.tv_sec == 0) && (its.it_value.tv_nsec == 0),
		     "expired one-shot still reports armed");
	zassert_equal(timer_getoverrun(timerid), 0);
}

ZTEST(posix_timers, test_abstime_monotonic)
{
	struct timespec now;
	struct itimerspec its = {0};
	struct sigevent sig = {
		.sigev_notify = SIGEV_SIGNAL,
		.sigev_signo = TEST_SIGNAL_VAL,
		.sigev_value.sival_int = TEST_SIGNAL_VAL,
	};

	zassert_ok(timer_create(CLOCK_MONOTONIC, &sig, &timerid));

	/* future absolute deadline */
	zassert_ok(clock_gettime(CLOCK_MONOTONIC, &now));
	its.it_value = now;
	its.it_value.tv_nsec += 2 * PERIOD_NS;
	while (its.it_value.tv_nsec >= (long)NSEC_PER_SEC) {
		its.it_value.tv_nsec -= (long)NSEC_PER_SEC;
		its.it_value.tv_sec++;
	}
	zassert_ok(timer_settime(timerid, TIMER_ABSTIME, &its, NULL));
	zassert_equal(accept_sig(TEST_SIGNAL_VAL, NULL, 10 * PERIOD_MS), TEST_SIGNAL_VAL,
		      "future absolute deadline did not fire");

	/*
	 * An absolute deadline in the past expires immediately. The accept
	 * window is an upper bound, not a delay: it matches the file's other
	 * probes so that slow, loaded runners (e.g. -O0 sanitizer binaries
	 * under linux_compat real-time slowdown) do not flake on delivery
	 * latency.
	 */
	its.it_value.tv_sec = 0;
	its.it_value.tv_nsec = 1;
	zassert_ok(timer_settime(timerid, TIMER_ABSTIME, &its, NULL));
	zassert_equal(accept_sig(TEST_SIGNAL_VAL, NULL, 10 * PERIOD_MS), TEST_SIGNAL_VAL,
		      "past absolute deadline did not fire immediately");
}

ZTEST(posix_timers, test_abstime_realtime_settime)
{
	struct timespec now;
	struct timespec jump;
	struct itimerspec its = {0};
	struct sigevent sig = {
		.sigev_notify = SIGEV_SIGNAL,
		.sigev_signo = TEST_SIGNAL_VAL,
		.sigev_value.sival_int = TEST_SIGNAL_VAL,
	};

	if (IS_ENABLED(CONFIG_NATIVE_LIBC)) {
		/* the host wall clock cannot be jumped from a test */
		ztest_test_skip();
	}

	zassert_ok(timer_create(CLOCK_REALTIME, &sig, &timerid));

	/* absolute wall-clock deadline one hour out */
	zassert_ok(clock_gettime(CLOCK_REALTIME, &now));
	its.it_value = now;
	its.it_value.tv_sec += 3600;
	zassert_ok(timer_settime(timerid, TIMER_ABSTIME, &its, NULL));

	/* jumping the wall clock past the deadline must fire the timer promptly */
	jump = its.it_value;
	jump.tv_sec += 1;
	zassert_ok(clock_settime(CLOCK_REALTIME, &jump));

	zassert_equal(accept_sig(TEST_SIGNAL_VAL, NULL, 10 * PERIOD_MS), TEST_SIGNAL_VAL,
		      "clock_settime() past the deadline did not fire the timer");

	/* restore the wall clock roughly */
	zassert_ok(clock_settime(CLOCK_REALTIME, &now));
}

#if defined(SIGEV_THREAD_ID) && !defined(CONFIG_NATIVE_LIBC)

static void *tid_helper_fn(void *arg)
{
	siginfo_t info = {0};
	int *const out = arg;

	set_sig_blocked(TEST_SIGNAL_VAL, true);
	*out = accept_sig(TEST_SIGNAL_VAL, &info, 20 * PERIOD_MS);

	return NULL;
}

ZTEST(posix_timers, test_sigev_thread_id)
{
	int got = -1;
	pthread_t th;
	struct sigevent sig = {
		.sigev_notify = SIGEV_THREAD_ID,
		.sigev_signo = TEST_SIGNAL_VAL,
		.sigev_value.sival_int = TEST_SIGNAL_VAL,
	};

	if (IS_ENABLED(CONFIG_NATIVE_LIBC)) {
		/* on the host, sigev_notify_thread_id requires gettid(); covered by Linux */
		ztest_test_skip();
	}

	zassert_ok(pthread_create(&th, NULL, tid_helper_fn, &got));
	/* let the helper block its signal and enter sigtimedwait() */
	test_sleep_ms(PERIOD_MS / 2);

	sig.sigev_notify_thread_id = (pid_t)th;
	zassert_ok(timer_create(CLOCK_MONOTONIC, &sig, &timerid));
	arm_ms(timerid, 0, PERIOD_MS, 0);

	zassert_ok(pthread_join(th, NULL));
	zassert_equal(got, TEST_SIGNAL_VAL, "targeted thread did not receive the signal");
}
#endif /* defined(SIGEV_THREAD_ID) && !defined(CONFIG_NATIVE_LIBC) */

ZTEST(posix_timers, test_errors)
{
	struct itimerspec its = {0};
	struct sigevent sig = {
		.sigev_notify = SIGEV_NONE,
	};

	zassert_equal(timer_create((clockid_t)4242, &sig, &timerid), -1);
	zassert_equal(errno, EINVAL);
	timerid = INVALID_TIMERID;

	zassert_ok(timer_create(CLOCK_MONOTONIC, &sig, &timerid));

	its.it_value.tv_nsec = NSEC_PER_SEC; /* invalid */
	zassert_equal(timer_settime(timerid, 0, &its, NULL), -1);
	zassert_equal(errno, EINVAL);

	if (!IS_ENABLED(CONFIG_NATIVE_LIBC)) {
		/* NULL-argument handling is unspecified; the host may fault instead */
		zassert_equal(timer_settime(timerid, 0, NULL, NULL), -1);
		zassert_equal(errno, EINVAL);
		zassert_equal(timer_gettime(timerid, NULL), -1);
		zassert_equal(errno, EINVAL);
	}
}

ZTEST(posix_timers, test_stale_handle)
{
	struct sigevent sig = {
		.sigev_notify = SIGEV_NONE,
	};

	if (IS_ENABLED(CONFIG_NATIVE_LIBC) || IS_ENABLED(CONFIG_USERSPACE)) {
		/* host libc semantics differ; in user mode a stale handle faults instead */
		ztest_test_skip();
	}

	zassert_ok(timer_create(CLOCK_MONOTONIC, &sig, &timerid));
	zassert_ok(timer_delete(timerid));

	/* double delete must fail cleanly */
	zassert_equal(timer_delete(timerid), -1);
	zassert_equal(errno, EINVAL);
	timerid = INVALID_TIMERID;
}

static void before(void *arg)
{
	ARG_UNUSED(arg);

#ifdef CONFIG_NATIVE_LIBC
	lc_install(TEST_SIGNAL_VAL);
	lc_install(SIGALRM);
#else
	/* sigtimedwait()-style acceptance requires the signals to be blocked */
	set_sig_blocked(TEST_SIGNAL_VAL, true);
	set_sig_blocked(SIGALRM, true);
#endif
}

ZTEST(posix_timers, test_TIMER_ABSTIME_large_timeout)
{
	struct sigevent sig = {0};
	struct itimerspec value = {0};
	struct timespec orig;
	const struct timespec ref = {.tv_sec = 1700000000};

	exp_count = 0;
	sig.sigev_notify = SIGEV_THREAD;
	sig.sigev_notify_function = handler;
	sig.sigev_value.sival_int = TEST_SIGNAL_VAL;

	zassert_ok(timer_create(CLOCK_REALTIME, &sig, &timerid));

	/*
	 * A wall clock of 1.7e9 s scaled to nanoseconds overflows 32-bit time_t arithmetic,
	 * and a multi-second offset keeps the overflow from cancelling in the subtraction of
	 * deadline and now: an unwidened conversion fires at once or truncates the wait.
	 */
	zassert_ok(clock_gettime(CLOCK_REALTIME, &orig));
	zassert_ok(clock_settime(CLOCK_REALTIME, &ref));
	value.it_value.tv_sec = ref.tv_sec + 5;
	zassert_ok(timer_settime(timerid, TIMER_ABSTIME, &value, NULL));

	k_sleep(K_MSEC(2000));
	zassert_equal(exp_count, 0, "5 s absolute deadline fired within 2 s");
	k_sleep(K_MSEC(3500));
	zassert_equal(exp_count, 1, "5 s absolute deadline fired %d times, expected 1", exp_count);

	zassert_ok(clock_settime(CLOCK_REALTIME, &orig));
}

static void after(void *arg)
{
	ARG_UNUSED(arg);

	/* delete leftovers even when an assertion aborted the test mid-way */
	if (timerid != INVALID_TIMERID) {
		(void)timer_delete(timerid);
		timerid = INVALID_TIMERID;
	}

	if (!IS_ENABLED(CONFIG_NATIVE_LIBC)) {
		drain_sig(TEST_SIGNAL_VAL);
		drain_sig(SIGALRM);
	}

	if (!IS_ENABLED(CONFIG_NATIVE_LIBC)) {
		/* let detached helper threads recycle their stacks */
		k_msleep(10);
	}
}


ZTEST_SUITE(posix_timers, NULL, NULL, before, after, NULL);
```

## src/timer_create.c
```c
/*
 * SPDX-FileCopyrightText: Copyright The Zephyr Project Contributors
 * SPDX-License-Identifier: Apache-2.0
 */

#include "timers_tests.h"

static void timer_create_default_evp(void)
{
	siginfo_t info = {0};

	/* NULL sigevent: as if SIGEV_SIGNAL, SIGALRM, with the timer ID as the value */
	zassert_ok(timer_create(CLOCK_MONOTONIC, NULL, &timerid));
	arm_ms(timerid, 0, PERIOD_MS, 0);

	zassert_equal(accept_sig(SIGALRM, &info, 10 * PERIOD_MS), SIGALRM,
		      "default-sigevent timer did not deliver SIGALRM");
	zassert_equal(info.si_code, SI_TIMER, "si_code is %d, not SI_TIMER", info.si_code);
	if (!IS_ENABLED(CONFIG_NATIVE_LIBC)) {
		/* the host's default value is a kernel timer id, not the timer_t bits */
		zassert_equal_ptr(info.si_value.sival_ptr, (void *)(uintptr_t)timerid,
				  "default notification value is not the timer ID");
	}
}

static void timer_create_sigev_signal(void)
{
	siginfo_t info = {0};
	struct sigevent sig = {
		.sigev_notify = SIGEV_SIGNAL,
		.sigev_signo = TEST_SIGNAL_VAL,
		.sigev_value.sival_int = TEST_SIGNAL_VAL,
	};

	zassert_ok(timer_create(CLOCK_MONOTONIC, &sig, &timerid));
	arm_ms(timerid, 0, PERIOD_MS, PERIOD_MS);

	/* each accepted expiry signal permits the next to be queued (one-pending model) */
	for (int i = 0; i < 3; ++i) {
		zassert_equal(accept_sig(TEST_SIGNAL_VAL, &info, 10 * PERIOD_MS),
			      TEST_SIGNAL_VAL, "periodic expiry signal %d not delivered", i);
		zassert_equal(info.si_value.sival_int, TEST_SIGNAL_VAL);
		zassert_equal(info.si_code, SI_TIMER);
	}
}

static void sig_handler(int signo, siginfo_t *info, void *ctx)
{
	ARG_UNUSED(ctx);

	++exp_count;
	zassert_equal(signo, TEST_SIGNAL_VAL);
	zassert_equal(info->si_value.sival_int, TEST_SIGNAL_VAL);
}

static void timer_create_sigev_signal_handler(void)
{
	struct sigaction act = {
		.sa_flags = SA_SIGINFO,
		.sa_sigaction = sig_handler,
	};
	struct sigaction oact = {0};
	struct sigevent sig = {
		.sigev_notify = SIGEV_SIGNAL,
		.sigev_signo = TEST_SIGNAL_VAL,
		.sigev_value.sival_int = TEST_SIGNAL_VAL,
	};

	exp_count = 0;
	zassert_ok(sigemptyset(&act.sa_mask));
	zassert_ok(sigaction(TEST_SIGNAL_VAL, &act, &oact));
	set_sig_blocked(TEST_SIGNAL_VAL, false);

	zassert_ok(timer_create(CLOCK_MONOTONIC, &sig, &timerid));
	arm_ms(timerid, 0, PERIOD_MS, PERIOD_MS);

	/* delivery happens in this thread's context; sleep in short slices to accept it */
	for (int i = 0; (exp_count < 2) && (i < 100); ++i) {
		test_sleep_ms(PERIOD_MS / 4);
	}
	zassert_true(exp_count >= 2, "handler ran %d times", exp_count);

	zassert_ok(timer_delete(timerid));
	timerid = INVALID_TIMERID;
	set_sig_blocked(TEST_SIGNAL_VAL, true);
	zassert_ok(sigaction(TEST_SIGNAL_VAL, &oact, NULL));
}

static void thread_fn(union sigval val)
{
	zassert_equal(val.sival_int, TEST_SIGNAL_VAL);
	fn_overrun = timer_getoverrun(timerid);
	++exp_count;
}

static void timer_create_sigev_thread(void)
{
	struct sigevent sig = {
		.sigev_notify = SIGEV_THREAD,
		.sigev_notify_function = thread_fn,
		.sigev_value.sival_int = TEST_SIGNAL_VAL,
	};

	exp_count = 0;
	fn_overrun = -1;

	zassert_ok(timer_create(CLOCK_MONOTONIC, &sig, &timerid));
	arm_ms(timerid, 0, PERIOD_MS, PERIOD_MS);

	test_sleep_ms(5 * PERIOD_MS + PERIOD_MS / 2);

	/* the helper accepts each expiry promptly: no coalescing while it keeps up */
	zassert_true(exp_count >= 3, "notification function ran %d times", exp_count);
	/* timer_getoverrun() inside the notification function is valid and non-negative */
	zassert_true(fn_overrun >= 0, "overrun inside notification function: %d", fn_overrun);

	/* deleting with callbacks potentially in flight must be safe */
	zassert_ok(timer_delete(timerid));
	timerid = INVALID_TIMERID;
}

#if defined(SIGEV_THREAD_ID) && !defined(CONFIG_NATIVE_LIBC)

/* the helper runs in another thread, which cannot reach this one's stack under userspace */
static ZTEST_BMEM int received_signal;

static void *tid_helper_fn(void *arg)
{
	siginfo_t info = {0};
	int *const out = arg;

	set_sig_blocked(TEST_SIGNAL_VAL, true);
	*out = accept_sig(TEST_SIGNAL_VAL, &info, 20 * PERIOD_MS);

	return NULL;
}

static void timer_create_sigev_thread_id(void)
{
	pthread_t th;
	struct sigevent sig = {
		.sigev_notify = SIGEV_THREAD_ID,
		.sigev_signo = TEST_SIGNAL_VAL,
		.sigev_value.sival_int = TEST_SIGNAL_VAL,
	};

	received_signal = -1;
	zassert_ok(pthread_create(&th, NULL, tid_helper_fn, &received_signal));
	/* let the helper block its signal and enter sigtimedwait() */
	test_sleep_ms(PERIOD_MS / 2);

	sig.sigev_notify_thread_id = (pid_t)th;
	zassert_ok(timer_create(CLOCK_MONOTONIC, &sig, &timerid));
	arm_ms(timerid, 0, PERIOD_MS, 0);

	zassert_ok(pthread_join(th, NULL));
	zassert_equal(received_signal, TEST_SIGNAL_VAL,
		      "targeted thread did not receive the signal");
}
#endif /* defined(SIGEV_THREAD_ID) && !defined(CONFIG_NATIVE_LIBC) */

static void timer_create_signal_less(void)
{
	struct sigevent sig = {
		.sigev_notify = SIGEV_SIGNAL,
		.sigev_signo = TEST_SIGNAL_VAL,
	};

	/* without signal-based expiry notification, only SIGEV_NONE is supported */
	zassert_equal(timer_create(CLOCK_MONOTONIC, &sig, &timerid), -1);
	zassert_equal(errno, ENOTSUP);
	timerid = INVALID_TIMERID;

	sig.sigev_notify = SIGEV_NONE;
	zassert_ok(timer_create(CLOCK_MONOTONIC, &sig, &timerid));
	arm_ms(timerid, 0, PERIOD_MS, 0);
	test_sleep_ms(2 * PERIOD_MS);
	zassert_equal(timer_getoverrun(timerid), 0);
}

static void timer_create_errors(void)
{
	struct sigevent sig = {
		.sigev_notify = SIGEV_NONE,
	};

	zassert_equal(timer_create((clockid_t)4242, &sig, &timerid), -1);
	zassert_equal(errno, EINVAL);
	timerid = INVALID_TIMERID;
}

ZTEST_USER(posix_timers, test_timer_create)
{
	timer_create_errors();
	section_reset();

	if (!IS_ENABLED(CONFIG_TIMER_SIGNAL)) {
		/* without signal-based expiry notification, only SIGEV_NONE is supported */
		timer_create_signal_less();
		return;
	}

	timer_create_default_evp();
	section_reset();

	if (!IS_ENABLED(CONFIG_NATIVE_LIBC)) {
		/* the host cannot block process-directed signals across simulator threads */
		timer_create_sigev_signal();
		section_reset();
	}

	timer_create_sigev_signal_handler();
	section_reset();

	timer_create_sigev_thread();
	section_reset();

#if defined(SIGEV_THREAD_ID) && !defined(CONFIG_NATIVE_LIBC)
	/* on the host, sigev_notify_thread_id requires gettid(); covered by Linux */
	timer_create_sigev_thread_id();
	section_reset();
#endif
}
```

## src/timer_delete.c
```c
/*
 * SPDX-FileCopyrightText: Copyright The Zephyr Project Contributors
 * SPDX-License-Identifier: Apache-2.0
 */

#include "timers_tests.h"

ZTEST_USER(posix_timers, test_timer_delete)
{
	struct sigevent sig = {
		.sigev_notify = SIGEV_NONE,
	};

	if (IS_ENABLED(CONFIG_NATIVE_LIBC) || IS_ENABLED(CONFIG_USERSPACE)) {
		/* host libc semantics differ; in user mode a stale handle faults instead */
		ztest_test_skip();
	}

	zassert_ok(timer_create(CLOCK_MONOTONIC, &sig, &timerid));
	zassert_ok(timer_delete(timerid));

	/* double delete must fail cleanly */
	zassert_equal(timer_delete(timerid), -1);
	zassert_equal(errno, EINVAL);
	timerid = INVALID_TIMERID;
}
```

## src/timer_getoverrun.c
```c
/*
 * SPDX-FileCopyrightText: Copyright The Zephyr Project Contributors
 * SPDX-License-Identifier: Apache-2.0
 */

#include "timers_tests.h"

ZTEST_USER(posix_timers, test_timer_getoverrun)
{
	if (!IS_ENABLED(CONFIG_TIMER_SIGNAL)) {
		/* signal-based expiry notification requires the kernel signal subsystem */
		ztest_test_skip();
	}
	if (IS_ENABLED(CONFIG_NATIVE_LIBC)) {
		/* the host cannot block process-directed signals across simulator threads */
		ztest_test_skip();
	}
	int overrun;
	struct sigevent sig = {
		.sigev_notify = SIGEV_SIGNAL,
		.sigev_signo = TEST_SIGNAL_VAL,
		.sigev_value.sival_int = TEST_SIGNAL_VAL,
	};

	if (k_is_user_context()) {
		/* a handle that is not a live timer: kernel-mode callers are trusted instead */
		zassert_equal(timer_getoverrun(INVALID_TIMERID), -1);
		zassert_equal(errno, EINVAL);
	}

	zassert_ok(timer_create(CLOCK_MONOTONIC, &sig, &timerid));
	arm_ms(timerid, 0, PERIOD_MS, PERIOD_MS);

	/* let ~5 periods elapse with the (blocked) signal left pending */
	test_sleep_ms(5 * PERIOD_MS + PERIOD_MS / 2);

	/* exactly one instance is queued; accepting it latches the overrun */
	zassert_equal(accept_sig(TEST_SIGNAL_VAL, NULL, 0), TEST_SIGNAL_VAL);
	zassert_equal(accept_sig(TEST_SIGNAL_VAL, NULL, 0), -1,
		      "more than one signal instance queued for one timer");

	overrun = timer_getoverrun(timerid);
	zassert_true((overrun >= 2) && (overrun <= 6), "overrun %d outside expected window",
		     overrun);
	/* non-destructive: repeated reads return the latched value */
	zassert_equal(timer_getoverrun(timerid), overrun);
	zassert_equal(timer_getoverrun(timerid), overrun);
}
```
