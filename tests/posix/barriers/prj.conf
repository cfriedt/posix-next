## prj.conf
```kconfig
CONFIG_ZTEST=y

CONFIG_POSIX_AEP_CHOICE_BASE=y
CONFIG_POSIX_BARRIERS=y
CONFIG_POSIX_THREAD_PROCESS_SHARED=y
CONFIG_HEAP_MEM_POOL_SIZE=16384
CONFIG_TEST_EXTRA_STACK_SIZE=4096
CONFIG_COMMON_LIBC_MALLOC_ARENA_SIZE=16384

# static stacks/threads: heap-carved user stacks do not fit the fixed heap above
CONFIG_SYS_THREAD_STACK_MIN_ADD_TEST=3
CONFIG_SYS_THREAD_THREAD_MIN_ADD_TEST=3
```

## src/main.c
```c
/*
 * Copyright (c) 2023, Harshil Bhatt
 * Copyright (c) 2025 Friedt Professional Engineering Services, Inc.
 *
 * SPDX-License-Identifier: Apache-2.0
 */

#include <pthread.h>

#include <zephyr/sys/util.h>
#include <zephyr/ztest.h>

#include "../../shared/linux_compat_test.h"

#define N_THR    3
#define N_CYCLES 5

static ZTEST_BMEM pthread_barrier_t barrier;
static ZTEST_BMEM int barrier_return[N_THR];
static ZTEST_BMEM int barrier_done[N_THR];
static ZTEST_BMEM int barrier_serial[N_THR];

static void *barrier_thread(void *p1)
{
	int id = POINTER_TO_INT(p1);

	barrier_return[id] = pthread_barrier_wait(&barrier);
	barrier_done[id] = 1;

	return NULL;
}

static void *barrier_cycle_thread(void *p1)
{
	int id = POINTER_TO_INT(p1);

	for (int i = 0; i < N_CYCLES; i++) {
		int ret = pthread_barrier_wait(&barrier);

		zassert_true(ret == 0 || ret == PTHREAD_BARRIER_SERIAL_THREAD,
			     "pthread_barrier_wait returned unexpected value %d", ret);

		if (ret == PTHREAD_BARRIER_SERIAL_THREAD) {
			barrier_serial[id]++;
		}
	}

	return NULL;
}

ZTEST_USER(posix_barriers, test_pthread_barrierattr_init)
{
	int ret, pshared;
	pthread_barrierattr_t attr;

	ret = pthread_barrierattr_init(&attr);
	zassert_equal(ret, 0, "pthread_barrierattr_init failed");

	ret = pthread_barrierattr_getpshared(&attr, &pshared);
	zassert_equal(ret, 0, "pthread_barrierattr_getpshared failed");
	zassert_equal(pshared, PTHREAD_PROCESS_PRIVATE, "pshared attribute not set correctly");

	ret = pthread_barrierattr_setpshared(&attr, PTHREAD_PROCESS_PRIVATE);
	zassert_equal(ret, 0, "pthread_barrierattr_setpshared failed");

	ret = pthread_barrierattr_setpshared(&attr, PTHREAD_PROCESS_SHARED);
	zassert_equal(ret, 0, "pthread_barrierattr_setpshared failed");

	ret = pthread_barrierattr_getpshared(&attr, &pshared);
	zassert_equal(ret, 0, "pthread_barrierattr_getpshared failed");
	zassert_equal(pshared, PTHREAD_PROCESS_SHARED, "pshared attribute not retrieved correctly");

	/* degenerate cases */
	IF_NOT_NATIVE_LIBC({
		ret = pthread_barrierattr_setpshared(&attr, 42);
		zassert_equal(ret, -EINVAL, "pthread_barrierattr_setpshared did not return EINVAL");
	})

	ret = pthread_barrierattr_destroy(&attr);
	zassert_equal(ret, 0, "pthread_barrierattr_destroy failed");
}

ZTEST_USER(posix_barriers, test_pthread_barrier_init)
{
	zassert_ok(pthread_barrier_init(&barrier, NULL, N_THR));
	zassert_ok(pthread_barrier_destroy(&barrier));
}

static void pthread_barrier_wait_single_cycle(void)
{
	pthread_t threads[N_THR];
	int serial_threads = 0;
	int i;

	zassert_ok(pthread_barrier_init(&barrier, NULL, N_THR));

	for (i = 0; i < N_THR; i++) {
		barrier_done[i] = 0;
		barrier_return[i] = 0;
		zassert_ok(pthread_create(&threads[i], NULL, barrier_thread, INT_TO_POINTER(i)));
	}

	for (i = 0; i < N_THR; i++) {
		zassert_ok(pthread_join(threads[i], NULL));
		if (barrier_return[i] == PTHREAD_BARRIER_SERIAL_THREAD) {
			serial_threads++;
		}
	}

	zassert_equal(serial_threads, 1, "expected exactly one PTHREAD_BARRIER_SERIAL_THREAD");
	zassert_ok(pthread_barrier_destroy(&barrier));
}

/*
 * A barrier can be reused immediately after a successful return: a thread that re-enters
 * for the next cycle before every thread of the previous cycle has woken up must not
 * stall the stragglers.
 */
static void pthread_barrier_wait_cyclic_reuse(void)
{
	pthread_t threads[N_THR];
	int serial_threads = 0;
	int i;

	zassert_ok(pthread_barrier_init(&barrier, NULL, N_THR));

	for (i = 0; i < N_THR; i++) {
		barrier_serial[i] = 0;
		zassert_ok(pthread_create(&threads[i], NULL, barrier_cycle_thread,
					  INT_TO_POINTER(i)));
	}

	for (i = 0; i < N_THR; i++) {
		zassert_ok(pthread_join(threads[i], NULL));
		serial_threads += barrier_serial[i];
	}

	/* exactly one PTHREAD_BARRIER_SERIAL_THREAD per cycle */
	zassert_equal(serial_threads, N_CYCLES, "expected %d serial threads, got %d", N_CYCLES,
		      serial_threads);
	zassert_ok(pthread_barrier_destroy(&barrier));
}

ZTEST_USER(posix_barriers, test_pthread_barrier_wait)
{
	if (CONFIG_SYS_THREAD_STACK_MAX == 0) {
		ztest_test_skip();
	}

	pthread_barrier_wait_single_cycle();
	pthread_barrier_wait_cyclic_reuse();
}

ZTEST_USER(posix_barriers, test_pthread_barrier_destroy)
{
	zassert_ok(pthread_barrier_init(&barrier, NULL, 2));
	zassert_ok(pthread_barrier_destroy(&barrier));
}

ZTEST_SUITE(posix_barriers, NULL, NULL, NULL, NULL, NULL);
```
