## CMakeLists.txt
```
# SPDX-License-Identifier: Apache-2.0

cmake_minimum_required(VERSION 3.20.0)
find_package(Zephyr REQUIRED HINTS $ENV{ZEPHYR_BASE})
project(posix_signals)

target_sources(app PRIVATE
  src/main.c
  src/test_default_action.c
  src/test_generate.c
  src/test_sigaction.c
  src/test_wait.c
  ../common/test_sigmask_common.c
)

target_compile_options(app PRIVATE -U_POSIX_C_SOURCE -D_POSIX_C_SOURCE=200809L)
```

## prj.conf
```kconfig
CONFIG_ZTEST=y
CONFIG_ZTEST_FATAL_HOOK=y

CONFIG_POSIX_AEP_CHOICE_PSE51=y
CONFIG_POSIX_SIGNALS=y
# POSIX_SIGNALS no longer selects POSIX_MULTI_PROCESS (they are independent
# Subprofiling Option Groups); the tests use getpid() as the kill() target
CONFIG_POSIX_MULTI_PROCESS=y
# a process-directed signal is checked after an aio completion: the aio worker is a kernel
# thread born inside a user system call
CONFIG_POSIX_ASYNCHRONOUS_IO=y
CONFIG_POSIX_PIPE=y

CONFIG_SYS_THREAD_STACK_MIN_ADD_TEST=1
CONFIG_SYS_THREAD_THREAD_MIN_ADD_TEST=2
```

## src/main.c
```c
/*
 * Copyright (c) 2026, Friedt Professional Engineering Services, Inc.
 *
 * SPDX-License-Identifier: Apache-2.0
 */

#include "_main.h"

#include <errno.h>
#include <pthread.h>
#include <signal.h>
#include <stdio.h>
#include <string.h>

#include <zephyr/kernel.h>
#include <zephyr/kernel/signal.h>
#include <zephyr/sys/util.h>
#include <zephyr/ztest.h>

#define BYTES_PER_LONG (sizeof(unsigned long))

#define SIGNO_WORD_IDX(_signo) ((_signo - 1) / BITS_PER_LONG)
#define SIGNO_WORD_BIT(_signo) ((_signo - 1) & BIT_MASK(LOG2(BITS_PER_LONG)))

#if defined(CONFIG_NATIVE_LIBC)
#ifdef __GLIBC__
/* glibc's sigset_t is publicly capable of holding 1024 bits, but its sigsetops only operate on
 * the first _NSIG bits: sigemptyset() clears only the first 64 bits, corresponding to
 * SIGSET_NLONGS below, so value checks only cover that many words. The rest of the object is
 * still part of the libc contract, however: raw buffers passed as sigset_t must provide
 * SIGSET_STORAGE_NLONGS words (e.g. ASAN's interceptors assert writability of the whole
 * sigset_t).
 */
#define SIGSET_NLONGS (_NSIG / (BITS_PER_LONG))
#else
#error "Unknown native libc"
#endif
#else
#define SIGSET_NLONGS (sizeof(sigset_t) / sizeof(unsigned long))
#endif
#define SIGSET_STORAGE_NLONGS (sizeof(sigset_t) / sizeof(unsigned long))
#define SIGSET_SIZE           (SIGSET_NLONGS * BYTES_PER_LONG)

BUILD_ASSERT(SIGSET_NLONGS > 0, "sigset_t has no storage");

/*
 * Some C libraries provide a sigset_t that is too small to hold the real-time signals Zephyr is
 * configured for. Cases that reach into individual bits skip the ones that do not fit.
 */
#define SIGNO_FITS(_signo) (((_signo) - 1) < (int)(SIGSET_NLONGS * BITS_PER_LONG))

ZTEST_BMEM struct test_signals_record test_signals_state;

void test_signals_record_reset(void)
{
	test_signals_state = (struct test_signals_record){0};
}

void test_signals_handler(int signo)
{
	test_signals_state.calls++;
	test_signals_state.signo = signo;
	test_signals_state.mask_valid = sigprocmask(SIG_SETMASK, NULL, &test_signals_state.mask) == 0;
}

void test_signals_sigaction_handler(int signo, siginfo_t *info, void *context)
{
	ARG_UNUSED(context);

	test_signals_handler(signo);
	test_signals_state.si_signo = (info == NULL) ? -1 : info->si_signo;
	test_signals_state.si_code = (info == NULL) ? -1 : info->si_code;
}

bool test_signals_blocked(int signo)
{
	sigset_t mask;

	zassert_ok(sigprocmask(SIG_SETMASK, NULL, &mask));

	return sigismember(&mask, signo) == 1;
}

void test_signals_reset(int signo)
{
	sigset_t set;
	struct sigaction act = {
		.sa_handler = SIG_IGN,
		.sa_flags = 0,
	};

	zassert_ok(sigemptyset(&act.sa_mask));
	zassert_ok(sigemptyset(&set));
	zassert_ok(sigaddset(&set, signo));

	/*
	 * Ignore the signal before unblocking it, so that an instance left pending by an earlier
	 * case is discarded rather than acted on. Unblocking first would run the default action,
	 * which on a hosted C library ends the whole test binary.
	 */
	zassert_ok(sigaction(signo, &act, NULL));
	zassert_ok(sigprocmask(SIG_UNBLOCK, &set, NULL));

	/*
	 * The signal is left ignored rather than default. A signal directed at the process can be
	 * taken by any thread at any time, so leaving SIG_DFL installed between cases would let a
	 * late instance run the default action, and blocking it here would not help. Cases that
	 * need the default disposition use a signal that nothing generates.
	 */
}

void test_signals_set_default(int signo)
{
	struct sigaction act = {
		.sa_handler = SIG_DFL,
		.sa_flags = 0,
	};

	zassert_ok(sigemptyset(&act.sa_mask));
	zassert_ok(sigaction(signo, &act, NULL));
}

bool test_signals_wait_for_delivery(int calls)
{
	/*
	 * A signal directed at the process rather than at a thread is delivered to whichever
	 * thread is willing to take it, and not necessarily before the generating call returns.
	 */
	for (int i = 0; (i < 200) && (test_signals_state.calls < calls); i++) {
		k_msleep(10);
	}

	return test_signals_state.calls >= calls;
}

void test_signals_install(int signo, void *handler, int flags)
{
	struct sigaction act = {
		.sa_handler = (void (*)(int))handler,
		.sa_flags = flags,
	};

	zassert_ok(sigemptyset(&act.sa_mask));
	zassert_ok(sigaction(signo, &act, NULL));

	test_signals_record_reset();
}

ZTEST_USER(posix_signals, test_sigemptyset)
{
	unsigned long _set[SIGSET_STORAGE_NLONGS];
	sigset_t *const set = (sigset_t *)_set;

	ARRAY_FOR_EACH(_set, i) {
		_set[i] = -1;
	}

	zassert_ok(sigemptyset(set));

	for (int i = 0; i < SIGSET_NLONGS; i++) {
		zassert_equal(_set[i], 0u, "set.sig[%d] is not empty: 0x%lx", i, _set[i]);
	}

	/* an empty set has no members */
	zassert_equal(0, sigismember(set, SIGUSR1));
	zassert_equal(0, sigismember(set, SIGTERM));
}

ZTEST_USER(posix_signals, test_sigfillset)
{
	sigset_t set = (sigset_t){0};

	zassert_ok(sigfillset(&set));

	/* every signal the application may use is a member */
	zassert_equal(1, sigismember(&set, SIGUSR1));
	zassert_equal(1, sigismember(&set, SIGTERM));
	zassert_equal(1, sigismember(&set, SIGKILL));
	zassert_equal(1, sigismember(&set, SIGSTOP));

	/*
	 * The two signals reserved for thread cancellation are not, and cannot be added back.
	 * Zephyr follows the Linux NPTL implementation here.
	 */
	zassert_equal(-1, sigaddset(&set, CONFIG_THREAD_CANCEL_SIGNAL_NUMBER));
	zassert_equal(EINVAL, errno);
	zassert_equal(-1, sigaddset(&set, CONFIG_THREAD_CANCEL_SIGNAL_NUMBER + 1));
	zassert_equal(EINVAL, errno);
}

ZTEST_USER(posix_signals, test_sigaddset)
{
	int signo;
	sigset_t set = (sigset_t){0};
	unsigned long *const _set = (unsigned long *)&set;
	sigset_t target = (sigset_t){0};
	unsigned long *const _target = (unsigned long *)&target;

	/* signal numbers outside the supported range are rejected */
	zassert_equal(-1, sigaddset(&set, -1));
	zassert_equal(EINVAL, errno);
	zassert_equal(-1, sigaddset(&set, 0));
	zassert_equal(EINVAL, errno);
	zassert_equal(-1, sigaddset(&set, SIGRTMAX + 1));
	zassert_equal(EINVAL, errno);

	/* as are the two signals reserved for thread cancellation */
	zassert_equal(-1, sigaddset(&set, CONFIG_THREAD_CANCEL_SIGNAL_NUMBER));
	zassert_equal(EINVAL, errno);
	zassert_equal(-1, sigaddset(&set, CONFIG_THREAD_CANCEL_SIGNAL_NUMBER + 1));
	zassert_equal(EINVAL, errno);

	/* a rejected signal number leaves the set untouched */
	for (int i = 0; i < SIGSET_NLONGS; i++) {
		zassert_equal(_set[i], 0u, "a rejected signal number modified the set");
	}

	signo = SIGHUP;
	zassert_ok(sigaddset(&set, signo));
	WRITE_BIT(_target[SIGNO_WORD_IDX(signo)], SIGNO_WORD_BIT(signo), 1);
	for (int i = 0; i < SIGSET_NLONGS; i++) {
		zassert_equal(_set[i], _target[i],
			      "set.sig[%d of %d] has content: %lx, expected %lx", i,
			      (int)(SIGSET_NLONGS - 1), _set[i], _target[i]);
	}

	/* adding a second signal does not disturb the first */
	signo = SIGSYS;
	zassert_ok(sigaddset(&set, signo));
	WRITE_BIT(_target[SIGNO_WORD_IDX(signo)], SIGNO_WORD_BIT(signo), 1);
	for (int i = 0; i < SIGSET_NLONGS; i++) {
		zassert_equal(_set[i], _target[i],
			      "set.sig[%d of %d] has content: %lx, expected %lx", i,
			      (int)(SIGSET_NLONGS - 1), _set[i], _target[i]);
	}

	/* adding a signal that is already a member is not an error */
	zassert_ok(sigaddset(&set, SIGSYS));
	zassert_equal(1, sigismember(&set, SIGSYS));

	if (SIGNO_FITS(SIGRTMIN)) {
		zassert_ok(sigaddset(&set, SIGRTMIN));
		zassert_equal(1, sigismember(&set, SIGRTMIN));
	}
}

ZTEST_USER(posix_signals, test_sigdelset)
{
	int signo;
	sigset_t set = (sigset_t){0};
	unsigned long *const _set = (unsigned long *)&set;
	sigset_t target = (sigset_t){0};
	unsigned long *const _target = (unsigned long *)&target;

	zassert_equal(-1, sigdelset(&set, -1));
	zassert_equal(EINVAL, errno);
	zassert_equal(-1, sigdelset(&set, 0));
	zassert_equal(EINVAL, errno);
	zassert_equal(-1, sigdelset(&set, SIGRTMAX + 1));
	zassert_equal(EINVAL, errno);

	zassert_ok(sigfillset(&set));
	zassert_ok(sigfillset(&target));

	signo = SIGHUP;
	zassert_ok(sigdelset(&set, signo));
	WRITE_BIT(_target[SIGNO_WORD_IDX(signo)], SIGNO_WORD_BIT(signo), 0);
	for (int i = 0; i < SIGSET_NLONGS; i++) {
		zassert_equal(_set[i], _target[i],
			      "set.sig[%d of %d] has content: %lx, expected %lx", i,
			      (int)(SIGSET_NLONGS - 1), _set[i], _target[i]);
	}

	signo = SIGSYS;
	zassert_ok(sigdelset(&set, signo));
	WRITE_BIT(_target[SIGNO_WORD_IDX(signo)], SIGNO_WORD_BIT(signo), 0);
	for (int i = 0; i < SIGSET_NLONGS; i++) {
		zassert_equal(_set[i], _target[i],
			      "set.sig[%d of %d] has content: %lx, expected %lx", i,
			      (int)(SIGSET_NLONGS - 1), _set[i], _target[i]);
	}

	/* removing a signal that is not a member is not an error */
	zassert_ok(sigdelset(&set, SIGSYS));
	zassert_equal(0, sigismember(&set, SIGSYS));
}

ZTEST_USER(posix_signals, test_sigismember)
{
	sigset_t set = (sigset_t){0};

	zassert_equal(-1, sigismember(&set, -1));
	zassert_equal(EINVAL, errno);
	zassert_equal(-1, sigismember(&set, 0));
	zassert_equal(EINVAL, errno);
	zassert_equal(-1, sigismember(&set, SIGRTMAX + 1));
	zassert_equal(EINVAL, errno);

	zassert_ok(sigaddset(&set, SIGHUP));
	zassert_ok(sigaddset(&set, SIGSYS));

	zassert_equal(1, sigismember(&set, SIGHUP), "%s expected to be member", "SIGHUP");
	zassert_equal(1, sigismember(&set, SIGSYS), "%s expected to be member", "SIGSYS");

	zassert_equal(0, sigismember(&set, SIGKILL), "%s not expected to be member", "SIGKILL");
	zassert_equal(0, sigismember(&set, SIGTERM), "%s not expected to be member", "SIGTERM");
}

ZTEST_USER(posix_signals, test_pthread_sigmask)
{
	test_pthread_sigmask_common(pthread_sigmask);
}

/*
 * The shared expectations are written against pthread_sigmask(), which returns an error number.
 * sigprocmask() reports the same errors through errno, so translate before handing it over.
 */
static int sigprocmask_as_pthread_sigmask(int how, const sigset_t *set, sigset_t *oset)
{
	if (sigprocmask(how, set, oset) == 0) {
		return 0;
	}

	return errno;
}

ZTEST_USER(posix_signals, test_sigprocmask)
{
	sigset_t set;
	sigset_t oset;

	/*
	 * POSIX leaves sigprocmask() unspecified in a multi-threaded process, but Zephyr has no
	 * processes: the calling thread is the whole process, so it behaves like pthread_sigmask()
	 * and differs only in reporting errors through errno rather than the return value.
	 */
	test_pthread_sigmask_common(sigprocmask_as_pthread_sigmask);

	zassert_ok(sigemptyset(&set));
	zassert_equal(-1, sigprocmask(-1, &set, NULL), "an invalid 'how' was accepted");
	zassert_equal(EINVAL, errno);

	/*
	 * Asking to block SIGKILL or SIGSTOP is not an error. Zephyr only enforces the restriction
	 * for user threads, which are the ones running application code; a supervisor thread is
	 * not a POSIX thread and is trusted to mask whatever it likes.
	 */
	zassert_ok(sigemptyset(&set));
	zassert_ok(sigaddset(&set, SIGKILL));
	zassert_ok(sigaddset(&set, SIGSTOP));
	zassert_ok(sigprocmask(SIG_BLOCK, &set, NULL));

	if (IS_ENABLED(CONFIG_USERSPACE) && k_is_user_context()) {
		zassert_ok(sigprocmask(SIG_SETMASK, NULL, &oset));
		zassert_equal(0, sigismember(&oset, SIGKILL), "%s must not be blockable", "SIGKILL");
		zassert_equal(0, sigismember(&oset, SIGSTOP), "%s must not be blockable", "SIGSTOP");
	}

	zassert_ok(sigprocmask(SIG_UNBLOCK, &set, NULL));
}

static void *setup(void)
{
	test_pthread_sigmask_init_expectation_mask();
	return NULL;
}

ZTEST_SUITE(posix_signals, NULL, setup, NULL, NULL, NULL);
```

## src/_main.h
```c
/*
 * SPDX-FileCopyrightText: Copyright The Zephyr Project Contributors
 * SPDX-License-Identifier: Apache-2.0
 */

#ifndef POSIX_TESTS_SIGNALS_MAIN_H_
#define POSIX_TESTS_SIGNALS_MAIN_H_

#include <signal.h>

#include <zephyr/kernel.h>
#include <zephyr/sys/util.h>
#include <zephyr/ztest.h>

/*
 * Everything except the child-thread termination and fatal-error cases runs as ZTEST_USER(): the
 * option group keeps no state of its own -- dispositions and the alarm live in the kernel,
 * behind system calls. The termination cases stay supervisor-side because they assert on what a
 * dying thread leaves behind, which is kernel business either way.
 */

/* provided by ../shared/test_sigmask_common.c */
void test_pthread_sigmask_init_expectation_mask(void);
void test_pthread_sigmask_common(int (*sigmask)(int how, const sigset_t *set, sigset_t *oset));

/*
 * State recorded by test_signals_handler() and test_signals_sigaction_handler()
 *
 * A disposition belongs to the process, not to the caller, so a test case cannot assume anything
 * about what ran before it. Every case that catches a signal resets this first.
 */
struct test_signals_record {
	int calls;         /* number of times the handler has been entered */
	int signo;         /* signal number the handler was passed */
	int si_signo;      /* siginfo_t::si_signo, for SA_SIGINFO handlers */
	int si_code;       /* siginfo_t::si_code, for SA_SIGINFO handlers */
	sigset_t mask;     /* signal mask in effect inside the handler */
	bool mask_valid;   /* whether mask could be read */
};

extern struct test_signals_record test_signals_state;

/* A one-argument handler that records its arguments in test_signals_state */
void test_signals_handler(int signo);

/* A three-argument (SA_SIGINFO) handler that records its arguments */
void test_signals_sigaction_handler(int signo, siginfo_t *info, void *context);

/* Forget everything test_signals_handler() has recorded so far */
void test_signals_record_reset(void);

/*
 * Restore signo to its default disposition, unblock it, and discard it if pending
 *
 * Dispositions, the signal mask, and pending signals all outlive the test case that created
 * them, so each case starts from a known state by calling this for every signal it touches.
 */
void test_signals_reset(int signo);

/*
 * Install the default disposition for signo
 *
 * Only the cases that assert on the default disposition need it, since test_signals_reset()
 * deliberately leaves the signal ignored where SIG_DFL would be dangerous.
 */
void test_signals_set_default(int signo);

/* Install handler for signo with an empty mask and flags, and reset the record */
void test_signals_install(int signo, void *handler, int flags);

/* Whether signo is currently blocked for the calling thread */
bool test_signals_blocked(int signo);

/*
 * Wait, up to a couple of seconds, for the handler to have been entered calls times
 *
 * A signal directed at the process rather than at a thread is delivered to whichever thread is
 * willing to take it, and not necessarily before the call that generated it returns.
 *
 * returns true if the handler has run at least calls times
 */
bool test_signals_wait_for_delivery(int calls);

/*
 * Skip the running test case when the C library owns the implementation under test
 *
 * The linux_compat variant runs these expectations against the host C library. Cases that would
 * end the process there, such as those that let a signal's default action run, opt out.
 */
#define TEST_SIGNALS_SKIP_IF_LINUX_COMPAT()                                                        \
	do {                                                                                       \
		if (IS_ENABLED(CONFIG_POSIX_TEST_LINUX_COMPAT)) {                                  \
			ztest_test_skip();                                                         \
		}                                                                                  \
	} while (false)

/* Stack size for the child threads used by cases whose signal terminates the caller */
#define TEST_SIGNALS_CHILD_STACK_SIZE 2048

#endif /* POSIX_TESTS_SIGNALS_MAIN_H_ */
```

## src/test_default_action.c
```c
/*
 * SPDX-FileCopyrightText: Copyright The Zephyr Project Contributors
 * SPDX-License-Identifier: Apache-2.0
 */

#include "_main.h"

#include <pthread.h>
#include <signal.h>
#include <unistd.h>

#include <zephyr/fatal.h>
#include <zephyr/kernel.h>
#include <zephyr/sys/util.h>
#include <zephyr/ztest.h>
#include <zephyr/ztest_error_hook.h>

/*
 * These two cases cover behaviour rather than a single POSIX function: what happens when nobody
 * catches a signal, and what a thread leaves behind when it dies. Neither outcome is observable
 * from the thread it happens to, so the offending code runs in a child thread.
 */

static pthread_t child_thread;

static ZTEST_BMEM volatile bool child_survived;
static ZTEST_BMEM int child_signo;
static ZTEST_BMEM bool child_ignores;
static ZTEST_BMEM volatile int fatal_reason;
static ZTEST_BMEM volatile int fatal_count;

void ztest_post_fatal_error_hook(unsigned int reason, const struct arch_esf *esf)
{
	ARG_UNUSED(esf);

	fatal_reason = (int)reason;
	fatal_count++;
}

static int spawn_child(void *(*entry)(void *), int signo, bool ignores)
{
	child_survived = false;
	child_signo = signo;
	child_ignores = ignores;

	return pthread_create(&child_thread, NULL, entry, NULL);
}

static void *raise_entry(void *arg)
{
	sigset_t empty;
	struct sigaction act = {
		.sa_handler = child_ignores ? SIG_IGN : SIG_DFL,
		.sa_flags = 0,
	};

	ARG_UNUSED(arg);

	/* a kernel thread blocks all signals by default, and must opt in to delivery */
	(void)sigemptyset(&empty);
	(void)sigprocmask(SIG_SETMASK, &empty, NULL);

	/*
	 * Dispositions are process-wide, so the ignore left installed by
	 * test_signals_reset() applies here too: install the disposition this
	 * case asserts on explicitly.
	 */
	(void)sigemptyset(&act.sa_mask);
	(void)sigaction(child_signo, &act, NULL);

	(void)raise(child_signo);

	child_survived = true;

	return NULL;
}

ZTEST(posix_signals, test_default_action)
{
	/* on a hosted C library these default actions would end the test binary */
	TEST_SIGNALS_SKIP_IF_LINUX_COMPAT();

	test_signals_reset(SIGTERM);
	test_signals_reset(SIGCHLD);

	/* the default action for SIGTERM is to terminate */
	zassert_ok(spawn_child(raise_entry, SIGTERM, false));
	zassert_ok(pthread_join(child_thread, NULL),
		   "the default action for %s did not terminate the thread", "SIGTERM");
	zassert_false(child_survived, "the thread ran on past a signal that should have ended it");

	/* the default action for SIGCHLD is to ignore */
	zassert_ok(spawn_child(raise_entry, SIGCHLD, false));
	zassert_ok(pthread_join(child_thread, NULL));
	zassert_true(child_survived, "the default action for %s terminated the thread", "SIGCHLD");

	/* and an explicitly ignored signal does not terminate either */
	zassert_ok(spawn_child(raise_entry, SIGTERM, true));
	zassert_ok(pthread_join(child_thread, NULL));
	zassert_true(child_survived, "an explicitly ignored %s terminated the thread", "SIGTERM");
}

static void *oops_entry(void *arg)
{
	ARG_UNUSED(arg);

	ztest_set_fault_valid(true);
	k_oops();

	child_survived = true;

	return NULL;
}

/*
 * The cause reported for a fatal error, and its effect on the offending thread
 *
 * Zephyr reports CPU exceptions and kernel errors through the fatal error path rather than by
 * generating SIGILL, SIGFPE, SIGSEGV, or SIGBUS for the offending thread. This case pins the
 * behaviour that exists today; once the kernel does generate those signals, it should assert on
 * the signal instead.
 */
ZTEST(posix_signals, test_fatal_error)
{
	TEST_SIGNALS_SKIP_IF_LINUX_COMPAT();

	fatal_reason = -1;
	fatal_count = 0;

	zassert_ok(spawn_child(oops_entry, 0, false));
	zassert_ok(pthread_join(child_thread, NULL));

	zassert_equal(1, fatal_count, "the fatal error hook ran %d times, expected 1", fatal_count);
	zassert_equal(K_ERR_KERNEL_OOPS, fatal_reason, "fatal error reason was %d, expected %d",
		      fatal_reason, K_ERR_KERNEL_OOPS);
	zassert_false(child_survived, "the thread ran on past a fatal error");
}
```

## src/test_generate.c
```c
/*
 * SPDX-FileCopyrightText: Copyright The Zephyr Project Contributors
 * SPDX-License-Identifier: Apache-2.0
 */

#include "_main.h"

#include <errno.h>
#include <pthread.h>
#include <signal.h>
#include <stdlib.h>
#include <unistd.h>

#include <zephyr/kernel.h>
#include <zephyr/sys/util.h>
#include <zephyr/ztest.h>

/*
 * A signal whose default action terminates ends the thread it is delivered to, so cases that let
 * one run do so in a child thread and inspect what is left behind once it is gone.
 *
 * TODO (processes): once Zephyr has processes, the default action should end the process rather
 * than the one thread, and these cases should assert that instead.
 */

static ZTEST_BMEM volatile bool child_survived;
static pthread_t child_thread;

static int spawn_child(void *(*entry)(void *), void *arg)
{
	child_survived = false;

	return pthread_create(&child_thread, NULL, entry, arg);
}

ZTEST_USER(posix_signals, test_kill)
{
	test_signals_reset(SIGUSR1);

	/* [EINVAL] the sig argument is not a valid signal number */
	zassert_equal(-1, kill(getpid(), SIGRTMAX + 1));
	zassert_equal(EINVAL, errno);
	zassert_equal(-1, kill(getpid(), -1));
	zassert_equal(EINVAL, errno);

	/* signal 0 performs error checking but delivers nothing */
	test_signals_install(SIGUSR1, test_signals_handler, 0);
	zassert_ok(kill(getpid(), 0));
	zassert_equal(0, test_signals_state.calls, "signal 0 was delivered");

	/* a signal sent to the calling process invokes its handler */
	zassert_ok(kill(getpid(), SIGUSR1));
	zassert_true(test_signals_wait_for_delivery(1), "the handler ran %d times, expected 1",
		     test_signals_state.calls);
	zassert_equal(SIGUSR1, test_signals_state.signo);

	/* Skip on the host libc, where kill(0, ...) would signal the real process group */
	if (IS_ENABLED(CONFIG_PROCESS) && !IS_ENABLED(CONFIG_NATIVE_LIBC)) {
		test_signals_reset(SIGUSR1);
		test_signals_install(SIGUSR1, test_signals_handler, 0);
		zassert_ok(kill(0, 0));
		zassert_equal(0, test_signals_state.calls, "group signal 0 was delivered");
	}

	/* single implicit process: 0 and -1 name it; skip host libc (real kill) */
	if (IS_ENABLED(CONFIG_POSIX_SINGLE_PROCESS) && !IS_ENABLED(CONFIG_POSIX_MULTI_PROCESS) &&
	    !IS_ENABLED(CONFIG_NATIVE_LIBC)) {
		for (pid_t self = 0; self >= -1; self--) {
			test_signals_reset(SIGUSR1);
			test_signals_install(SIGUSR1, test_signals_handler, 0);
			zassert_ok(kill(self, SIGUSR1));
			zassert_true(test_signals_wait_for_delivery(1),
				     "kill(%d) handler ran %d times, expected 1", (int)self,
				     test_signals_state.calls);
			zassert_equal(SIGUSR1, test_signals_state.signo);
		}

		errno = 0;
		zassert_equal(-1, kill(getpid() + 1, 0));
		zassert_equal(ESRCH, errno);
	}

	/* [ESRCH] broadcast excludes the caller: no other process exists to signal */
	if (IS_ENABLED(CONFIG_PROCESS) && !IS_ENABLED(CONFIG_NATIVE_LIBC)) {
		errno = 0;
		zassert_equal(-1, kill(-1, 0));
		zassert_equal(ESRCH, errno);
	}

	/*
	 * Blocking is not exercised here. It is a property of the calling thread, and kill() is
	 * directed at the process, so holding a signal pending this way only works where the two
	 * are the same. test_raise() covers it with a thread-directed signal instead.
	 */

	test_signals_reset(SIGUSR1);
}

ZTEST_USER(posix_signals, test_raise)
{
	sigset_t blocked;
	sigset_t pending;

	test_signals_reset(SIGUSR1);

	/* [EINVAL] the sig argument is not a valid signal number */
	zassert_equal(-1, raise(SIGRTMAX + 1));
	zassert_equal(EINVAL, errno);
	zassert_equal(-1, raise(-1));
	zassert_equal(EINVAL, errno);

	test_signals_install(SIGUSR1, test_signals_handler, 0);

	/* the handler completes before raise() returns */
	zassert_ok(raise(SIGUSR1));
	zassert_equal(1, test_signals_state.calls,
		      "the handler ran %d times before raise() returned, expected 1",
		      test_signals_state.calls);
	zassert_equal(SIGUSR1, test_signals_state.signo);

	zassert_ok(raise(SIGUSR1));
	zassert_equal(2, test_signals_state.calls);

	/* a raised signal that is blocked is held pending */
	zassert_ok(sigemptyset(&blocked));
	zassert_ok(sigaddset(&blocked, SIGUSR1));
	zassert_ok(sigprocmask(SIG_BLOCK, &blocked, NULL));

	zassert_ok(raise(SIGUSR1));
	zassert_equal(2, test_signals_state.calls, "a blocked signal was delivered");
	zassert_ok(sigpending(&pending));
	zassert_equal(1, sigismember(&pending, SIGUSR1));

	zassert_ok(sigprocmask(SIG_UNBLOCK, &blocked, NULL));
	zassert_equal(3, test_signals_state.calls);

	test_signals_reset(SIGUSR1);
}

ZTEST_USER(posix_signals, test_alarm)
{
	test_signals_reset(SIGALRM);

	/* with no alarm scheduled there is no remaining time to report */
	zassert_equal(0, alarm(0));

	/* scheduling one reports what was left of the previous one, and cancels it */
	zassert_equal(0, alarm(10));
	zassert_equal(10, alarm(5), "the remaining time of a pending alarm was not reported");
	zassert_equal(5, alarm(0), "a rescheduled alarm did not replace the previous one");
	zassert_equal(0, alarm(0), "alarm(0) did not cancel the pending alarm");

	/* an alarm that expires generates SIGALRM for the process */
	test_signals_install(SIGALRM, test_signals_handler, 0);
	zassert_equal(0, alarm(1));

	zassert_true(test_signals_wait_for_delivery(1), "alarm() did not generate %s", "SIGALRM");
	zassert_equal(SIGALRM, test_signals_state.signo);

	zassert_equal(0, alarm(0));
	test_signals_reset(SIGALRM);
}

/*
 * The child installs the disposition itself: Zephyr has no processes, so a signal action is
 * associated with the thread that installed it rather than with the process as POSIX requires.
 */
static void *abort_entry(void *handler)
{
	struct sigaction act = {
		.sa_handler = (void (*)(int))handler,
		.sa_flags = 0,
	};

	if (handler != NULL) {
		(void)sigemptyset(&act.sa_mask);
		(void)sigaction(SIGABRT, &act, NULL);
	}

	abort();

	child_survived = true;

	return NULL;
}

ZTEST(posix_signals, test_abort)
{
	/* the host C library's abort() would take the whole test binary with it */
	TEST_SIGNALS_SKIP_IF_LINUX_COMPAT();

	test_signals_reset(SIGABRT);

	/* abort() does not return to its caller */
	zassert_ok(spawn_child(abort_entry, NULL));
	zassert_ok(pthread_join(child_thread, NULL),
		   "abort() did not terminate the calling thread");
	zassert_false(child_survived, "abort() returned to its caller");

	/* abort() raises SIGABRT, so an installed handler runs */
	test_signals_record_reset();

	zassert_ok(spawn_child(abort_entry, test_signals_handler));
	zassert_ok(pthread_join(child_thread, NULL));

	zassert_equal(1, test_signals_state.calls, "abort() did not raise %s", "SIGABRT");
	zassert_equal(SIGABRT, test_signals_state.signo);

	/*
	 * and it terminates the caller even though the handler returned, by restoring the default
	 * disposition and raising SIGABRT a second time.
	 */
	zassert_false(child_survived, "abort() returned after its handler returned");

	/* ignoring SIGABRT does not make abort() a no-op: it still terminates the caller */
	zassert_ok(spawn_child(abort_entry, SIG_IGN));
	zassert_ok(pthread_join(child_thread, NULL));
	zassert_false(child_survived, "abort() returned with %s ignored", "SIGABRT");

	test_signals_reset(SIGABRT);
}
```

## src/test_sigaction.c
```c
/*
 * SPDX-FileCopyrightText: Copyright The Zephyr Project Contributors
 * SPDX-License-Identifier: Apache-2.0
 */

#include "_main.h"

#include <errno.h>
#include <pthread.h>
#include <signal.h>

#include <zephyr/sys/util.h>
#include <zephyr/ztest.h>

static void other_handler(int signo)
{
	ARG_UNUSED(signo);
}

static void *sigaction_installer(void *arg)
{
	struct sigaction act = {
		.sa_handler = other_handler,
		.sa_flags = 0,
	};

	ARG_UNUSED(arg);

	zassert_ok(sigemptyset(&act.sa_mask));
	zassert_ok(sigaction(SIGUSR2, &act, NULL));

	return NULL;
}

/*
 * With CONFIG_PROCESS an action is a property of the process: installed by any
 * member thread, in force for every member, outliving the installer. Without
 * it, actions are per-thread and die with the installing thread.
 */
static void sigaction_process_scope(void)
{
	pthread_t th;
	struct sigaction oact;

	test_signals_reset(SIGUSR2);

	zassert_ok(pthread_create(&th, NULL, sigaction_installer, NULL));
	zassert_ok(pthread_join(th, NULL));

	zassert_ok(sigaction(SIGUSR2, NULL, &oact));
	if (IS_ENABLED(CONFIG_PROCESS)) {
		zassert_equal(other_handler, oact.sa_handler,
			      "another thread's install is not in force for this thread");
	} else {
		/* the reset's ignore, keyed to this thread, is unaffected */
		zassert_equal(SIG_IGN, oact.sa_handler,
			      "a per-thread action leaked across threads");
	}

	test_signals_reset(SIGUSR2);
}

ZTEST_USER(posix_signals, test_sigaction)
{
	sigset_t unmaskable;
	struct sigaction oact;
	struct sigaction act = {
		.sa_handler = test_signals_handler,
		.sa_flags = 0,
	};

	zassert_ok(sigemptyset(&act.sa_mask));

	/* [EINVAL] the sig argument is not a valid signal number */
	zassert_equal(-1, sigaction(0, &act, NULL));
	zassert_equal(EINVAL, errno);
	zassert_equal(-1, sigaction(-1, &act, NULL));
	zassert_equal(EINVAL, errno);
	zassert_equal(-1, sigaction(SIGRTMAX + 1, &act, NULL));
	zassert_equal(EINVAL, errno);

	/*
	 * The two signals reserved for thread cancellation are not available to applications.
	 * Zephyr follows the Linux NPTL implementation here.
	 */
	zassert_equal(-1, sigaction(CONFIG_THREAD_CANCEL_SIGNAL_NUMBER, &act, NULL));
	zassert_equal(EINVAL, errno);
	zassert_equal(-1, sigaction(CONFIG_THREAD_CANCEL_SIGNAL_NUMBER + 1, &act, NULL));
	zassert_equal(EINVAL, errno);

	/* [EINVAL] an attempt to catch a signal that cannot be caught */
	zassert_equal(-1, sigaction(SIGKILL, &act, NULL));
	zassert_equal(EINVAL, errno);
	zassert_equal(-1, sigaction(SIGSTOP, &act, NULL));
	zassert_equal(EINVAL, errno);

	/* [EINVAL] an attempt to ignore a signal that cannot be ignored */
	act.sa_handler = SIG_IGN;
	zassert_equal(-1, sigaction(SIGKILL, &act, NULL));
	zassert_equal(EINVAL, errno);
	zassert_equal(-1, sigaction(SIGSTOP, &act, NULL));
	zassert_equal(EINVAL, errno);

	test_signals_reset(SIGUSR1);
	test_signals_reset(SIGUSR2);

	/*
	 * The default disposition is checked on a signal that nothing here generates. Leaving
	 * SIG_DFL installed for a signal that is in play would let a stray instance run the
	 * default action, which ends the process, and blocking it would not help: a signal aimed
	 * at the process is taken by whichever thread will have it.
	 */
	test_signals_set_default(SIGVTALRM);

	/* a NULL act queries the current action without changing it */
	zassert_ok(sigaction(SIGVTALRM, NULL, &oact));
	zassert_equal(SIG_DFL, oact.sa_handler, "the default disposition was not reported");
	zassert_ok(sigaction(SIGVTALRM, NULL, &oact));
	zassert_equal(SIG_DFL, oact.sa_handler, "querying the action changed it");

	/* oact reports the action that was in effect before the call */
	act.sa_handler = test_signals_handler;
	zassert_ok(sigaction(SIGVTALRM, &act, &oact));
	zassert_equal(SIG_DFL, oact.sa_handler);
	test_signals_reset(SIGVTALRM);

	/* a signal nothing on this system generates still takes a handler: editors install one */
	act.sa_handler = test_signals_handler;
	zassert_ok(sigaction(SIGWINCH, &act, NULL));
	zassert_ok(sigaction(SIGWINCH, NULL, &oact));
	zassert_equal(test_signals_handler, oact.sa_handler);
	test_signals_reset(SIGWINCH);

	act.sa_handler = test_signals_handler;
	zassert_ok(sigaction(SIGUSR1, &act, NULL));

	zassert_ok(sigaction(SIGUSR1, NULL, &oact));
	zassert_equal(test_signals_handler, oact.sa_handler,
		      "the installed handler was not reported back");

	act.sa_handler = other_handler;
	zassert_ok(sigaction(SIGUSR1, &act, &oact));
	zassert_equal(test_signals_handler, oact.sa_handler);

	act.sa_handler = SIG_IGN;
	zassert_ok(sigaction(SIGUSR1, &act, &oact));
	zassert_equal(other_handler, oact.sa_handler);

	/* an ignored signal is discarded rather than delivered */
	test_signals_record_reset();
	zassert_ok(raise(SIGUSR1));
	zassert_equal(0, test_signals_state.calls, "an ignored signal invoked a handler");

	sigaction_process_scope();

	/* a caught signal invokes the handler with the signal number */
	test_signals_install(SIGUSR1, test_signals_handler, 0);
	zassert_ok(raise(SIGUSR1));
	zassert_equal(1, test_signals_state.calls, "the handler ran %d times, expected 1",
		      test_signals_state.calls);
	zassert_equal(SIGUSR1, test_signals_state.signo);

	/* the action stays installed until it is explicitly changed */
	zassert_ok(raise(SIGUSR1));
	zassert_equal(2, test_signals_state.calls, "the action did not stay installed");

	/*
	 * The mask in force inside the handler is the union of the mask before delivery, sa_mask,
	 * and the signal being delivered.
	 */
	act.sa_handler = test_signals_handler;
	act.sa_flags = 0;
	zassert_ok(sigemptyset(&act.sa_mask));
	zassert_ok(sigaddset(&act.sa_mask, SIGUSR2));
	zassert_ok(sigaction(SIGUSR1, &act, NULL));

	test_signals_record_reset();
	zassert_ok(raise(SIGUSR1));
	zassert_equal(1, test_signals_state.calls);
	zassert_true(test_signals_state.mask_valid, "the mask could not be read in the handler");
	zassert_equal(1, sigismember(&test_signals_state.mask, SIGUSR2),
		      "sa_mask did not block %s inside the handler", "SIGUSR2");
	zassert_equal(1, sigismember(&test_signals_state.mask, SIGUSR1),
		      "the signal being delivered was not blocked inside the handler");

	/* and the mask in force before delivery is restored when the handler returns */
	zassert_false(test_signals_blocked(SIGUSR1),
		      "the mask was not restored after the handler returned");
	zassert_false(test_signals_blocked(SIGUSR2),
		      "the mask was not restored after the handler returned");

	/* SA_NODEFER leaves the signal being delivered unblocked inside the handler */
	act.sa_flags = SA_NODEFER;
	zassert_ok(sigemptyset(&act.sa_mask));
	zassert_ok(sigaction(SIGUSR1, &act, NULL));

	test_signals_record_reset();
	zassert_ok(raise(SIGUSR1));
	zassert_equal(1, test_signals_state.calls);
	zassert_equal(0, sigismember(&test_signals_state.mask, SIGUSR1),
		      "SA_NODEFER did not leave %s unblocked inside the handler", "SIGUSR1");

	/* SA_RESETHAND restores the default disposition on entry to the handler */
	act.sa_flags = SA_RESETHAND;
	zassert_ok(sigemptyset(&act.sa_mask));
	zassert_ok(sigaction(SIGUSR1, &act, NULL));

	test_signals_record_reset();
	zassert_ok(raise(SIGUSR1));
	zassert_equal(1, test_signals_state.calls);
	zassert_ok(sigaction(SIGUSR1, NULL, &oact));
	zassert_equal(SIG_DFL, oact.sa_handler,
		      "SA_RESETHAND did not restore the default disposition");

	/* SA_SIGINFO selects the three-argument handler and supplies a siginfo_t */
	act.sa_sigaction = test_signals_sigaction_handler;
	act.sa_flags = SA_SIGINFO;
	zassert_ok(sigemptyset(&act.sa_mask));
	zassert_ok(sigaction(SIGUSR1, &act, NULL));

	test_signals_record_reset();
	zassert_ok(raise(SIGUSR1));
	zassert_equal(1, test_signals_state.calls);
	zassert_equal(SIGUSR1, test_signals_state.signo);
	zassert_equal(SIGUSR1, test_signals_state.si_signo,
		      "siginfo_t::si_signo was %d, expected %d", test_signals_state.si_signo,
		      SIGUSR1);

	/*
	 * SIGKILL and SIGSTOP cannot be added to the mask through sa_mask, and the restriction is
	 * enforced without indicating an error.
	 */
	zassert_ok(sigemptyset(&unmaskable));
	zassert_ok(sigaddset(&unmaskable, SIGKILL));
	zassert_ok(sigaddset(&unmaskable, SIGSTOP));

	/* a kernel thread blocks all signals by default, so start from a known state */
	zassert_ok(sigprocmask(SIG_UNBLOCK, &unmaskable, NULL));

	act.sa_handler = test_signals_handler;
	act.sa_flags = 0;
	act.sa_mask = unmaskable;
	zassert_ok(sigaction(SIGUSR1, &act, NULL), "sa_mask containing %s was rejected",
		   "SIGKILL/SIGSTOP");

	test_signals_record_reset();
	zassert_ok(raise(SIGUSR1));
	zassert_equal(1, test_signals_state.calls);
	zassert_equal(0, sigismember(&test_signals_state.mask, SIGKILL),
		      "%s must not be blockable through sa_mask", "SIGKILL");
	zassert_equal(0, sigismember(&test_signals_state.mask, SIGSTOP),
		      "%s must not be blockable through sa_mask", "SIGSTOP");

	test_signals_reset(SIGUSR1);
	test_signals_reset(SIGUSR2);
}

ZTEST_USER(posix_signals, test_signal)
{
	sigset_t blocked;
	sigset_t previous;
	struct sigaction oact;

	/* SIG_ERR with EINVAL for signals that can neither be caught nor ignored */
	zassert_equal(SIG_ERR, signal(SIGKILL, test_signals_handler));
	zassert_equal(EINVAL, errno);
	zassert_equal(SIG_ERR, signal(SIGSTOP, test_signals_handler));
	zassert_equal(EINVAL, errno);

	/* and for signal numbers that are not valid */
	zassert_equal(SIG_ERR, signal(SIGRTMAX + 1, test_signals_handler));
	zassert_equal(EINVAL, errno);
	zassert_equal(SIG_ERR, signal(0, test_signals_handler));
	zassert_equal(EINVAL, errno);

	test_signals_reset(SIGUSR1);

	/*
	 * Block the signal while its disposition is being shuffled: the sequence below leaves it
	 * at SIG_DFL for a moment, and an instance generated meanwhile would run the default
	 * action, which on a hosted C library ends the test binary.
	 */
	zassert_ok(sigemptyset(&blocked));
	zassert_ok(sigaddset(&blocked, SIGUSR1));
	zassert_ok(sigprocmask(SIG_BLOCK, &blocked, &previous));

	/* the previous disposition is returned, starting from the default */
	test_signals_set_default(SIGVTALRM);
	zassert_equal(SIG_DFL, signal(SIGVTALRM, test_signals_handler), "expected %s", "SIG_DFL");
	test_signals_reset(SIGVTALRM);

	(void)signal(SIGUSR1, test_signals_handler);
	zassert_equal(test_signals_handler, signal(SIGUSR1, other_handler),
		      "the previously installed handler was not reported");
	zassert_equal(other_handler, signal(SIGUSR1, SIG_IGN));

	/*
	 * The chain deliberately ends on a handler rather than on SIG_DFL: leaving the disposition
	 * at SIG_DFL, even briefly, lets a stray instance run the default action, and blocking the
	 * signal here would not help because a process-directed instance can be taken by any thread.
	 */
	zassert_equal(SIG_IGN, signal(SIGUSR1, test_signals_handler));

	/*
	 * POSIX specifies signal() in terms of sigaction(), so a disposition installed by one is
	 * visible to the other.
	 */
	zassert_ok(sigprocmask(SIG_SETMASK, &previous, NULL));
	zassert_ok(sigaction(SIGUSR1, NULL, &oact));
	zassert_equal(test_signals_handler, oact.sa_handler,
		      "sigaction() did not report the handler installed by signal()");

	/* a handler installed by signal() is invoked on delivery */
	test_signals_record_reset();
	zassert_ok(raise(SIGUSR1));
	zassert_equal(1, test_signals_state.calls, "the handler ran %d times, expected 1",
		      test_signals_state.calls);
	zassert_equal(SIGUSR1, test_signals_state.signo);

	/*
	 * Whether the disposition survives delivery is not asserted: ISO C leaves it
	 * implementation-defined (C17 7.14.1.1), and glibc built with strict _POSIX_C_SOURCE
	 * resets it to SIG_DFL, System V style. Persistence is only guaranteed for a disposition
	 * installed by sigaction() without SA_RESETHAND, which test_sigaction() covers.
	 */

	test_signals_reset(SIGUSR1);
}
```

## src/test_wait.c
```c
/*
 * SPDX-FileCopyrightText: Copyright The Zephyr Project Contributors
 * SPDX-License-Identifier: Apache-2.0
 */

#include "_main.h"

#include <aio.h>
#include <errno.h>
#include <pthread.h>
#include <signal.h>
#include <stdint.h>
#include <unistd.h>

#include <zephyr/kernel.h>
#include <zephyr/sys/util.h>
#include <zephyr/ztest.h>

#include "../../shared/linux_compat_test.h"

#ifndef CONFIG_NATIVE_LIBC
#if defined(CONFIG_POSIX_ASYNCHRONOUS_IO) && defined(CONFIG_POSIX_PIPE)
static void sigpending_aio_worker(void)
{
	int fds[2];
	char buf[1] = {0};
	struct aiocb cb = {
		.aio_buf = buf,
		.aio_nbytes = sizeof(buf),
		.aio_sigevent = {.sigev_notify = SIGEV_SIGNAL, .sigev_signo = SIGUSR1},
	};
	const struct aiocb *list[1] = {&cb};
	int accepted = 0;
	sigset_t set;

	zassert_ok(pipe(fds));
	zassert_equal(write(fds[1], "x", 1), 1);
	cb.aio_fildes = fds[0];
	zassert_ok(aio_read(&cb));
	zassert_ok(aio_suspend(list, 1, NULL));
	zassert_equal(aio_return(&cb), 1);
	zassert_ok(sigemptyset(&set));
	zassert_ok(sigaddset(&set, SIGUSR1));
	zassert_ok(sigwait(&set, &accepted));
	zassert_equal(SIGUSR1, accepted);
	zassert_ok(close(fds[0]));
	zassert_ok(close(fds[1]));
}
#else
static void sigpending_aio_worker(void)
{
}
#endif

/* SIGUSR1 is blocked on entry */
static void sigpending_process_directed(const sigset_t *set)
{
	int accepted = 0;
	sigset_t pending;

	sigpending_aio_worker();

	zassert_ok(kill(getpid(), SIGUSR1));
	zassert_ok(sigpending(&pending));
	zassert_equal(1, sigismember(&pending, SIGUSR1),
		      "a blocked process-directed signal is not reported as pending");
	zassert_ok(sigwait(set, &accepted));
	zassert_equal(SIGUSR1, accepted);
}
#endif /* !CONFIG_NATIVE_LIBC */

ZTEST_USER(posix_signals, test_sigpending)
{
	int accepted = 0;
	sigset_t set;
	sigset_t pending;
	sigset_t previous;

	test_signals_reset(SIGUSR1);

	/* nothing is pending to begin with */
	zassert_ok(sigfillset(&pending));
	zassert_ok(sigpending(&pending));
	zassert_equal(0, sigismember(&pending, SIGUSR1), "%s was pending before it was raised",
		      "SIGUSR1");

	zassert_ok(sigemptyset(&set));
	zassert_ok(sigaddset(&set, SIGUSR1));
	zassert_ok(sigprocmask(SIG_BLOCK, &set, &previous));

	/* a signal that is blocked when generated is reported as pending */
	zassert_ok(raise(SIGUSR1));
	zassert_ok(sigpending(&pending));
	zassert_equal(1, sigismember(&pending, SIGUSR1),
		      "a blocked signal that was raised is not reported as pending");

	/* signals that were never generated are not */
	zassert_equal(0, sigismember(&pending, SIGUSR2));

	/* accepting the signal clears it from the pending set */
	zassert_ok(sigwait(&set, &accepted));
	zassert_equal(SIGUSR1, accepted);

	zassert_ok(sigpending(&pending));
	zassert_equal(0, sigismember(&pending, SIGUSR1),
		      "%s is still pending after it was accepted", "SIGUSR1");

	/*
	 * A process-directed signal that every thread blocks pends for the process and is
	 * reported by any of its threads. The aio request first: its completion is delivered by
	 * a kernel worker born inside this thread's system call, which must not become a
	 * delivery target for the process.
	 */
	/* the host delivers a process-directed signal to any of the simulator's threads */
	IF_NOT_NATIVE_LIBC(sigpending_process_directed(&set);)

	zassert_ok(sigprocmask(SIG_SETMASK, &previous, NULL));
}

ZTEST_USER(posix_signals, test_sigwait)
{
	int sig;
	sigset_t set;
	sigset_t pending;
	sigset_t previous;

	test_signals_reset(SIGUSR1);
	test_signals_reset(SIGUSR2);

	/*
	 * POSIX requires the signals in set to be blocked at the time of the call; the behaviour
	 * is undefined otherwise.
	 *
	 * TODO (processes): when several threads wait on the same signal, exactly one must return
	 * from sigwait(), and a signal generated for a specific thread must go to that thread.
	 * Neither is meaningful until signals are process-scoped.
	 */
	zassert_ok(sigemptyset(&set));
	zassert_ok(sigaddset(&set, SIGUSR1));
	zassert_ok(sigaddset(&set, SIGUSR2));
	zassert_ok(sigprocmask(SIG_BLOCK, &set, &previous));

	/* an already pending signal is returned without suspending the caller */
	zassert_ok(raise(SIGUSR1));

	sig = 0;
	zassert_ok(sigwait(&set, &sig), "sigwait() reports errors through its return value");
	zassert_equal(SIGUSR1, sig, "sigwait() accepted signal %d, expected %d", sig, SIGUSR1);

	/* the accepted signal is atomically cleared from the set of pending signals */
	zassert_ok(sigpending(&pending));
	zassert_equal(0, sigismember(&pending, SIGUSR1),
		      "sigwait() did not clear the accepted signal from the pending set");

	/* only signals in set are accepted; the others stay pending */
	zassert_ok(raise(SIGUSR2));
	zassert_ok(sigemptyset(&set));
	zassert_ok(sigaddset(&set, SIGUSR1));

	zassert_ok(raise(SIGUSR1));
	sig = 0;
	zassert_ok(sigwait(&set, &sig));
	zassert_equal(SIGUSR1, sig);

	zassert_ok(sigpending(&pending));
	zassert_equal(1, sigismember(&pending, SIGUSR2),
		      "sigwait() accepted a signal that was not in set");

	zassert_ok(sigprocmask(SIG_SETMASK, &previous, NULL));
	test_signals_reset(SIGUSR1);
	test_signals_reset(SIGUSR2);
}

static void *waker_entry(void *sleeper)
{
	/*
	 * The signal is directed at the thread blocked in pause() rather than at the process, so
	 * that it cannot be taken by some other thread.
	 */
	k_msleep(100);
	(void)pthread_kill((pthread_t)(uintptr_t)sleeper, SIGUSR1);

	return NULL;
}

ZTEST_USER(posix_signals, test_pause)
{
	pthread_t waker;

	test_signals_reset(SIGUSR1);
	test_signals_install(SIGUSR1, test_signals_handler, 0);

	/*
	 * pause() suspends the caller until a signal is delivered whose action is either to
	 * terminate it or to invoke a handler, so arrange for one to arrive.
	 */
	zassert_ok(pthread_create(&waker, NULL, waker_entry,
				  (void *)(uintptr_t)pthread_self()));

	/* pause() never returns successfully */
	zassert_equal(-1, pause(), "pause() must always return -1");
	zassert_equal(EINTR, errno);

	zassert_equal(1, test_signals_state.calls, "pause() returned without running a handler");
	zassert_equal(SIGUSR1, test_signals_state.signo);

	zassert_ok(pthread_join(waker, NULL));
	test_signals_reset(SIGUSR1);
}

ZTEST_USER(posix_signals, test_sigsuspend)
{
	sigset_t empty;
	sigset_t blocked;
	sigset_t previous;
	sigset_t restored;

	test_signals_reset(SIGUSR1);
	test_signals_install(SIGUSR1, test_signals_handler, 0);

	/*
	 * Raise SIGUSR1 while it is blocked so that it is pending, then let sigsuspend() install a
	 * mask that unblocks it. The handler must run before sigsuspend() returns.
	 */
	zassert_ok(sigemptyset(&blocked));
	zassert_ok(sigaddset(&blocked, SIGUSR1));
	zassert_ok(sigprocmask(SIG_BLOCK, &blocked, &previous));

	zassert_ok(raise(SIGUSR1));
	zassert_equal(0, test_signals_state.calls, "a blocked signal was delivered");

	zassert_ok(sigemptyset(&empty));
	zassert_equal(-1, sigsuspend(&empty), "sigsuspend() must always return -1");
	zassert_equal(EINTR, errno);

	zassert_equal(1, test_signals_state.calls, "sigsuspend() returned without running a handler");
	zassert_equal(SIGUSR1, test_signals_state.signo);

	/* the mask in force before the call is restored before it returns */
	zassert_ok(sigprocmask(SIG_SETMASK, NULL, &restored));
	zassert_equal(1, sigismember(&restored, SIGUSR1),
		      "sigsuspend() did not restore the previous signal mask");

	zassert_ok(sigprocmask(SIG_SETMASK, &previous, NULL));
	test_signals_reset(SIGUSR1);
}
```
