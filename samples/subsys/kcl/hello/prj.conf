## CMakeLists.txt
```
# SPDX-FileCopyrightText: Copyright The Zephyr Project Contributors
# SPDX-License-Identifier: Apache-2.0

cmake_minimum_required(VERSION 3.20.0)
find_package(Zephyr REQUIRED HINTS $ENV{ZEPHYR_BASE})
project(kcl_linux_hello)

# The guest is an ordinary Linux program, built for the host with the host's
# compiler: static and position independent, so the sample only runs on the
# qemu target of the host's own architecture.
set(GUEST "" CACHE FILEPATH "A prebuilt static-pie Linux executable to run instead")
if(GUEST)
  set(guest ${GUEST})
else()
  # the guest is a Linux program for the target: the host's own compiler when
  # the architectures agree, a Linux cross compiler otherwise
  if(CONFIG_X86_64)
    set(guest_cc_names x86_64-linux-gnu-gcc cc gcc)
  elseif(CONFIG_ARM64)
    set(guest_cc_names aarch64-linux-gnu-gcc)
  elseif(CONFIG_RISCV AND CONFIG_64BIT)
    set(guest_cc_names riscv64-linux-gnu-gcc)
  else()
    message(FATAL_ERROR "no Linux guest build for this architecture")
  endif()
  find_program(HOST_CC NAMES ${guest_cc_names})
  if(NOT HOST_CC)
    message(FATAL_ERROR "Linux compiler for the target not found (one of: ${guest_cc_names}); "
                        "install the distribution's cross toolchain, or pass -DGUEST=<prebuilt>")
  endif()
  set(guest ${CMAKE_CURRENT_BINARY_DIR}/hello)
  add_custom_command(
    OUTPUT ${guest}
    COMMAND ${HOST_CC} -static-pie -O2 -Wall -o ${guest} ${CMAKE_CURRENT_SOURCE_DIR}/guest/hello.c
    DEPENDS ${CMAKE_CURRENT_SOURCE_DIR}/guest/hello.c
    COMMENT "Building the Linux guest with ${HOST_CC}"
  )
endif()
# stripped and compressed: inflated into the root file system at boot
find_program(XZ xz REQUIRED)
set(guest_xz ${CMAKE_CURRENT_BINARY_DIR}/hello.xz)
add_custom_command(
  OUTPUT ${guest_xz}
  COMMAND ${CMAKE_STRIP} -o ${guest_xz}.elf ${guest}
  COMMAND sh -c "${XZ} --format=xz --check=crc32 --lzma2=preset=9e,dict=2MiB -c ${guest_xz}.elf > ${guest_xz}"
  DEPENDS ${guest}
  COMMENT "Stripping and compressing the Linux guest"
  VERBATIM
)
add_custom_target(guest DEPENDS ${guest} ${guest_xz})
add_dependencies(app guest)

target_sources(app PRIVATE src/main.c)
target_sources_ifdef(CONFIG_TRACING_USER app PRIVATE src/trace.c)
generate_inc_file_for_target(app ${guest_xz} ${ZEPHYR_BINARY_DIR}/include/generated/hello.inc)
```

## sample.yaml
```
sample:
  description: spawn a Linux executable, built with the host's compiler, as a process
  name: kcl linux hello
common:
  tags:
    - posix
    - kcl
    - exec
  harness: console
  harness_config:
    type: multi_line
    ordered: true
    regex:
      - "hello, world"
      - "exited with status 42"
      - "kcl linux hello sample complete"
  timeout: 60
tests:
  sample.kcl.hello:
    # the guest is a Linux program for the target: the host's own compiler, or a
    # Linux cross toolchain with a static-PIE C library (see the README)
    platform_allow:
      - qemu_x86_64
      - qemu_cortex_a53
      - qemu_riscv64
    integration_platforms:
      - qemu_x86_64
  sample.kcl.hello.trace:
    platform_allow:
      - qemu_x86_64
      - qemu_cortex_a53
      - qemu_riscv64
    extra_args: EXTRA_CONF_FILE=trace.conf
    harness_config:
      type: multi_line
      ordered: true
      regex:
        - "linux-syscall: pid=[0-9]+ brk"
        - "hello, world"
        - "linux-syscall: pid=[0-9]+ exit_group"
        - "exited with status 42"
        - "kcl linux hello sample complete"
  # services the layer only implies switched off, and one call on its own: the
  # program runs without them (uname() fails, so its report line is gone)
  sample.kcl.hello.trimmed:
    platform_allow:
      - qemu_x86_64
      - qemu_cortex_a53
      - qemu_riscv64
    extra_configs:
      - CONFIG_ZVFS_PIPE=n
      - CONFIG_ZVFS_FIFO=n
      - CONFIG_ZVFS_POLL=n
      - CONFIG_PROCESS_STOP=n
      - CONFIG_KCL_LINUX_SYSCALL_UNAME=n
    harness_config:
      type: multi_line
      ordered: true
      regex:
        - "hello, world"
        - "env: LANG=C"
        - "exited with status 42"
        - "kcl linux hello sample complete"
```

## prj.conf
```kconfig
# SPDX-FileCopyrightText: Copyright The Zephyr Project Contributors
# SPDX-License-Identifier: Apache-2.0

CONFIG_USERSPACE=y
# nothing of the POSIX API: the layer selects the services it is built on
CONFIG_POSIX_AEP_CHOICE_NONE=y

# the Linux kernel compatibility layer, for the executable's system calls
CONFIG_KCL=y
CONFIG_KCL_LINUX=y

CONFIG_LLEXT=y
CONFIG_LLEXT_TYPE_ELF_RELOCATABLE=y
CONFIG_LLEXT_HEAP_SIZE=16

# the root file system lives in pages mapped as it fills; the guest arrives
# in it from the image's .xz stream
CONFIG_FILE_SYSTEM=y
CONFIG_FILE_SYSTEM_TMPFS=y
CONFIG_XZ_DEC=y
# random bytes for the executable's AT_RANDOM and its getrandom()
CONFIG_TEST_RANDOM_GENERATOR=y
CONFIG_ZVFS_STDIN_CONSOLE=y

CONFIG_SYS_PROCESS_MAX=4
# the guest's leader thread and its stack come from the system pools
CONFIG_SYS_THREAD_THREAD_MAX=4
CONFIG_SYS_THREAD_STACK_MAX=4
CONFIG_SYS_THREAD_STACK_SIZE=8192
CONFIG_PRIVILEGED_STACK_SIZE=8192
CONFIG_MAIN_STACK_SIZE=8192
CONFIG_MAX_DOMAIN_PARTITIONS=16
CONFIG_HEAP_MEM_POOL_SIZE=4194304
```

## trace.conf
```kconfig
# SPDX-FileCopyrightText: Copyright The Zephyr Project Contributors
# SPDX-License-Identifier: Apache-2.0

# log the guest's system calls through the user tracing backend (src/trace.c)
CONFIG_TRACING=y
CONFIG_TRACING_USER=y
CONFIG_TRACING_SYSCALL=y
```

## boards/qemu_cortex_a53.conf
```kconfig
# SPDX-FileCopyrightText: Copyright The Zephyr Project Contributors
# SPDX-License-Identifier: Apache-2.0

# the board maps 8 MiB by default: the guest image, its copy in the file
# system and the heap it is loaded into need more
CONFIG_KERNEL_VM_SIZE=0x4000000
CONFIG_MAX_XLAT_TABLES=64
# Linux executables use the SIMD and floating-point registers
CONFIG_FPU=y
CONFIG_FPU_SHARING=y
```

## boards/qemu_riscv64.conf
```kconfig
# SPDX-FileCopyrightText: Copyright The Zephyr Project Contributors
# SPDX-License-Identifier: Apache-2.0

# the board maps 8 MiB by default: the guest image, its copy in the file
# system and the heap it is loaded into need more
CONFIG_KERNEL_VM_SIZE=0x4000000
CONFIG_MAX_XLAT_TABLES=64
# Linux executables use the floating-point registers (lp64d)
CONFIG_FPU=y
CONFIG_FPU_SHARING=y
```

## boards/qemu_x86_64.conf
```kconfig
# SPDX-FileCopyrightText: Copyright The Zephyr Project Contributors
# SPDX-License-Identifier: Apache-2.0

# the guest image, its copy in the file system, the heap it is loaded into
CONFIG_KERNEL_VM_SIZE=0x2000000
```

## src/main.c
```c
/*
 * SPDX-FileCopyrightText: Copyright The Zephyr Project Contributors
 * SPDX-License-Identifier: Apache-2.0
 */

#include <stdio.h>
#include <string.h>

#include <zephyr/fs/fs.h>
#include <zephyr/kernel.h>
#include <zephyr/sys/process.h>
#include <zephyr/sys/thread.h>
#include <zephyr/xz/extract.h>

#define GUEST_PATH "/bin/hello"

/* the root: pages mapped as it fills, nothing of it in the image */
static struct fs_mount_t root_mnt = {
	.type = FS_TMPFS,
	.mnt_point = "/",
};

/* the guest, stripped and compressed; inflated into the root at boot */
static const uint8_t guest_xz[] __aligned(8) = {
#include "hello.inc"
};

static int spawn(k_pid_t *child, const char *path, char *const argv[], char *const envp[])
{
	struct sys_clone_args args = {
		.flags = SYS_CLONE_PAUSED,
		.prio = k_thread_priority_get(k_current_get()),
		.options = K_USER,
		.argv = argv,
		.envp = envp,
	};
	int ret;

	ret = sys_clone(&args, child);
	if (ret < 0) {
		return ret;
	}
	/* a Linux executable is loaded into the paused leader like any image */
	ret = sys_exec_load(*child, path);
	if (ret < 0) {
		k_thread_abort(*child);
		(void)k_waitpid(*child, NULL, NULL, 0, K_FOREVER);
		return ret;
	}
	k_thread_start(*child);

	return 0;
}

int main(void)
{
	static char *const argv[] = {GUEST_PATH, "from", "zephyr", NULL};
	static char *const envp[] = {"HOME=/", "LANG=C", NULL};
	int status = 0;
	k_pid_t pid;
	long n;
	int ret;

	ret = fs_mount(&root_mnt);
	if (ret < 0) {
		printf("mount failed: %d\n", ret);
		return ret;
	}
	(void)fs_mkdir("/bin");
	n = xz_extract(guest_xz, sizeof(guest_xz), GUEST_PATH);
	if (n < 0) {
		printf("extracting %s failed: %ld\n", GUEST_PATH, n);
		return (int)n;
	}
	printf("running %s (%zu bytes compressed, %ld bytes)\n", GUEST_PATH, sizeof(guest_xz), n);

	ret = spawn(&pid, GUEST_PATH, argv, envp);
	if (ret < 0) {
		printf("spawning %s failed: %d\n", GUEST_PATH, ret);
		return ret;
	}
	ret = k_waitpid(pid, NULL, &status, 0, K_FOREVER);
	if (ret < 0) {
		printf("waiting for %s failed: %d\n", GUEST_PATH, ret);
		return ret;
	}
	if (K_WIFEXITED(status)) {
		printf("%s exited with status %d\n", GUEST_PATH, K_WEXITSTATUS(status));
	} else if (K_WIFSIGNALED(status)) {
		printf("%s killed by signal %d\n", GUEST_PATH, K_WTERMSIG(status));
	}
	printf("kcl linux hello sample complete\n");

	return 0;
}
```

## src/trace.c
```c
/*
 * SPDX-FileCopyrightText: Copyright The Zephyr Project Contributors
 * SPDX-License-Identifier: Apache-2.0
 */

/*
 * The user tracing backend's system call hooks: every Linux system call the
 * guest makes is logged as one line, which scripts/linux_syscall_graph.py
 * turns into a graph.
 */

#include <string.h>

#include <zephyr/kernel.h>
#include <zephyr/sys/printk.h>
#include <zephyr/sys/process.h>

#define LINUX_PREFIX "zkcl_linux_syscall_"

void sys_trace_syscall_enter_user(uint32_t syscall_id, const char *syscall_name)
{
	ARG_UNUSED(syscall_id);
	if (strncmp(syscall_name, LINUX_PREFIX, strlen(LINUX_PREFIX)) == 0) {
		printk("linux-syscall: pid=%d %s\n", sys_process_id(k_getpid()),
		       syscall_name + strlen(LINUX_PREFIX));
	}
}

void sys_trace_syscall_exit_user(uint32_t syscall_id, const char *syscall_name)
{
	ARG_UNUSED(syscall_id);
	ARG_UNUSED(syscall_name);
}
```
