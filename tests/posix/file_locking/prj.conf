## CMakeLists.txt
```
# SPDX-License-Identifier: Apache-2.0

cmake_minimum_required(VERSION 3.20.0)
find_package(Zephyr REQUIRED HINTS $ENV{ZEPHYR_BASE})
project(posix_file_locking)

FILE(GLOB app_sources
  src/*.c
  ../common/msleep.c
)
target_sources(app PRIVATE ${app_sources})

target_compile_options(app PRIVATE -U_POSIX_C_SOURCE -D_POSIX_C_SOURCE=200809L)
```

## Kconfig
```
# Copyright (c) 2024 Friedt Professional Engineering Services, Inc.
# SPDX-License-Identifier: Apache-2.0

source "Kconfig.zephyr"
rsource "../Kconfig.test_common"

menu "File Locking Tests"

config TEST_NEGLIGIBLE_DELAY_MS
	int "Negligible delay in milliseconds"
	default 100
	help
	  Delays less than or equal to this value are considered neglible for the purposes of this
	  testsuite.

config TEST_LOCK_PERIOD_MS
	int "Time to hold a lock in milliseconds"
	default 100
	help
	  The amount of time to hold a lock before releasing it, for the purposes of this testuite.

endmenu
```

## prj.conf
```kconfig
CONFIG_ZTEST=y

CONFIG_POSIX_AEP_CHOICE_BASE=y
CONFIG_POSIX_FILE_LOCKING=y

CONFIG_FILE_SYSTEM=y
CONFIG_FAT_FILESYSTEM_ELM=y

CONFIG_HEAP_MEM_POOL_SIZE=16384
CONFIG_COMMON_LIBC_MALLOC_ARENA_SIZE=16384
CONFIG_TEST_EXTRA_STACK_SIZE=4096

CONFIG_SYS_THREAD_STACK_MIN_ADD_TEST=2
CONFIG_SYS_THREAD_THREAD_MIN_ADD_TEST=2

CONFIG_MAIN_STACK_SIZE=4096
```

## src/main.c
```c
/*
 * Copyright (c) 2024 Friedt Professional Engineering Services, Inc.
 *
 * SPDX-License-Identifier: Apache-2.0
 */

#include <pthread.h>
#include <stdio.h>
#include <time.h>

#include <zephyr/ztest.h>
#include <zephyr/kernel.h>
#include <zephyr/sys/timeutil.h>

/* Picolibc has a conflicting macro definition with the wrong number of arguments */
#undef putchar_unlocked
int putchar_unlocked(int c);

#undef getchar_unlocked
int getchar_unlocked(void);

int msleep(int ms);
uint32_t now_ms(void);

#define N 2

struct thread_ctx {
	int delay_ms;
	int hold_ms;
	int lock_count;
	FILE *fp;
	bool retry;
	bool success;
};

static ZTEST_BMEM size_t fp_idx;
static ZTEST_BMEM FILE *fp[N];
static ZTEST_BMEM struct thread_ctx ctx[N];

static void *flockfile_thread_entry(void *arg)
{
	struct thread_ctx *const ctx = (struct thread_ctx *)arg;

	if (ctx->delay_ms > 0) {
		zassert_ok(msleep(ctx->delay_ms));
	}

	for (int i = 0; i < ctx->lock_count; ++i) {
		flockfile(ctx->fp);
		if (ctx->hold_ms > 0) {
			msleep(ctx->hold_ms);
		}
		funlockfile(ctx->fp);
	}

	return NULL;
}

static int flockfile_retry(FILE *fp, bool retry, int delay_ms)
{
	while (true) {
		int ret = ftrylockfile(fp);

		if (!retry) {
			return ret;
		}
		if (ret == 0) {
			return 0;
		}
		msleep(1);
	}

	CODE_UNREACHABLE;
}

static void *ftrylockfile_thread_entry(void *arg)
{
	struct thread_ctx *const ctx = (struct thread_ctx *)arg;

	if (ctx->delay_ms > 0) {
		zassert_ok(msleep(ctx->delay_ms));
	}

	for (int i = 0; i < ctx->lock_count; ++i) {
		int ret = flockfile_retry(ctx->fp, ctx->retry, ctx->delay_ms);

		if (ret == 0) {
			ctx->success = true;

			if (ctx->hold_ms > 0) {
				msleep(ctx->hold_ms);
			}
			funlockfile(ctx->fp);
		}
	}

	return NULL;
}

static void flockfile_common(bool try)
{
	uint32_t now, then;
	pthread_t th[2];
	void *(*thread_entry)(void *) = try ? ftrylockfile_thread_entry : flockfile_thread_entry;

	if (false) {
		/* degenerate cases */
		flockfile_retry(NULL, try, 0); /* this will throw an assertion if enabled */
	}

	/*
	 * > The functions shall behave as if there is a lock count associated with each
	 * (FILE *) > object. This count is implicitly initialized to zero when the (FILE *)
	 * object is > created.
	 *
	 * 1. A newly opened FILE object will have negligible delay associated with locking
	 * it, because they are not waiting for another thread to release the lock.
	 *
	 * > When the count is positive, a single thread owns the (FILE *) object
	 *
	 * 1. Two threads can call flockfile() on separate files with neglible delay.
	 * 2. When two threads call flockfile() simultaneously on the same file, the second
	 * thread to acquire the lock will experience a delay equal to or greater than the
	 * amount of time that the first thread holds the lock.
	 */

	/* check for locking in parallel - should be no contention */
	for (int i = 0; i < N; ++i) {
		ctx[i] = (struct thread_ctx){
			.lock_count = 1,
			.hold_ms = 0,
			.fp = fp[i],
			.retry = try,
		};
	}

	then = now_ms();
	for (int i = 0; i < N; ++i) {
		zassert_ok(pthread_create(&th[i], NULL, thread_entry, &ctx[i]));
	}
	msleep(1);
	ARRAY_FOR_EACH_PTR(th, it) {
		zassert_ok(pthread_join(*it, NULL));
	}
	now = now_ms();
	zexpect_true(now - then <= CONFIG_TEST_NEGLIGIBLE_DELAY_MS, "delay of %d ms exceeds %d ms",
		     (int)(now - then), CONFIG_TEST_NEGLIGIBLE_DELAY_MS);

	/*
	 * Check for locking the same file once - should be contention resulting in a delay
	 * of twice CONFIG_TEST_LOCK_PERIOD_MS.
	 */
	ARRAY_FOR_EACH_PTR(ctx, it) {
		*it = (struct thread_ctx){
			.lock_count = 1,
			.hold_ms = CONFIG_TEST_LOCK_PERIOD_MS,
			.fp = fp[0],
			.retry = try,
		};
	}

	then = now_ms();
	ARRAY_FOR_EACH(th, i) {
		zassert_ok(pthread_create(&th[i], NULL, thread_entry, &ctx[i]));
	}
	ARRAY_FOR_EACH_PTR(th, it) {
		zassert_ok(pthread_join(*it, NULL));
	}
	now = now_ms();
	zexpect_true((now - then) >= 2 * CONFIG_TEST_LOCK_PERIOD_MS,
		     "delay of %u ms less than %u ms", (int)(now - then),
		     2 * CONFIG_TEST_LOCK_PERIOD_MS);

	/*
	 * Check for locking the same file twice - should be contention resulting in a delay
	 * of four times CONFIG_TEST_LOCK_PERIOD_MS.
	 */
	ARRAY_FOR_EACH_PTR(ctx, it) {
		*it = (struct thread_ctx){
			.lock_count = 2,
			.hold_ms = CONFIG_TEST_LOCK_PERIOD_MS,
			.fp = fp[0],
			.retry = try,
		};
	}

	then = now_ms();
	ARRAY_FOR_EACH(ctx, i) {
		zassert_ok(pthread_create(&th[i], NULL, thread_entry, &ctx[i]));
	}
	msleep(1);
	ARRAY_FOR_EACH_PTR(th, it) {
		zassert_ok(pthread_join(*it, NULL));
	}
	now = now_ms();
	zexpect_true((now - then) >= 4 * CONFIG_TEST_LOCK_PERIOD_MS,
		     "delay of %u ms less than %u ms", (now - then),
		     4 * CONFIG_TEST_LOCK_PERIOD_MS);
}

ZTEST_USER(posix_file_locking, test_flockfile)
{
	flockfile_common(false);
}

ZTEST(posix_file_locking, test_ftrylockfile)
{
	uint32_t now, then;
	pthread_t th[2];

	flockfile_common(true);

	/* additional, special cases for ftrylockfile() */
	ARRAY_FOR_EACH_PTR(ctx, it) {
		*it = (struct thread_ctx){
			.lock_count = 1,
			.hold_ms = CONFIG_TEST_LOCK_PERIOD_MS,
			.fp = fp[0],
			.retry = false,
		};
	}

	then = now_ms();
	ARRAY_FOR_EACH(ctx, i) {
		zassert_ok(pthread_create(&th[i], NULL, ftrylockfile_thread_entry, &ctx[i]));
	}
	ARRAY_FOR_EACH_PTR(th, it) {
		zassert_ok(pthread_join(*it, NULL));
	}
	now = now_ms();
	zexpect_true((now - then) >= CONFIG_TEST_LOCK_PERIOD_MS, "delay of %u ms less than %u ms",
		     (now - then), CONFIG_TEST_LOCK_PERIOD_MS);

	int success = 0;
	int fail = 0;

	ARRAY_FOR_EACH_PTR(ctx, it) {
		success += it->success;
		fail += !it->success;
	}
	zexpect_true(N > 1);
	if (IS_ENABLED(CONFIG_PICOLIBC)) {
		if (success != 1) {
			TC_PRINT("Note: successes equal to %d\n", success);
		}
		if (fail < 1) {
			TC_PRINT("Note: failures equal %d\n", fail);
		}
	} else {
		zexpect_equal(success, 1);
		zexpect_true(fail >= 1);
	}
}

ZTEST(posix_file_locking, test_funlockfile)
{
	/* this is already excercised in test_flockfile_common(), so just a simple check here */
	zexpect_ok(ftrylockfile(fp[0]));
	funlockfile(fp[0]);
}

ZTEST(posix_file_locking, test_getc_unlocked)
{
	flockfile(fp[0]);
	zassert_equal(EOF, getc_unlocked(fp[0]));
	funlockfile(fp[0]);

	static const char msg[] = "Hello";

	flockfile(fp[1]);
	ARRAY_FOR_EACH(msg, i) {
		if (msg[i] == '\0') {
			break;
		}

		int actual = getc_unlocked(fp[1]);

		zassert_equal((int)msg[i], actual, "expected %c, got %c", msg[i], actual);
	}
	funlockfile(fp[1]);
}

ZTEST(posix_file_locking, test_getchar_unlocked)
{
#ifdef CONFIG_NATIVE_LIBC
	/* Host libc blocks on stdin when it is a TTY; twister does not redirect it. */
	zassert_not_null(freopen("/dev/null", "r", stdin));
#endif
	flockfile(stdin);
	zassert_equal(EOF, getchar_unlocked());
	funlockfile(stdin);
}

ZTEST(posix_file_locking, test_putc_unlocked)
{
	flockfile(fp[0]);
	zassert_equal('*', putc_unlocked('*', fp[0]));
	funlockfile(fp[0]);
}

ZTEST(posix_file_locking, test_putchar_unlocked)
{
	flockfile(stdout);
	zassert_equal('*', putchar_unlocked('*'));
	funlockfile(stdout);
}

void *setup(void);
void before(void *arg);
void after(void *arg);
void teardown(void *arg);

void setup_callback(void *arg)
{
	ARG_UNUSED(arg);

	fp_idx = 0;
}

void before_callback(void *arg)
{
	FILE *file = arg;

	zassert_true(fp_idx < ARRAY_SIZE(fp), "fps[] overflow");
	fp[fp_idx++] = file;
}

void after_callback(void *arg)
{
	ARG_UNUSED(arg);

	fp_idx = 0;
}

ZTEST_SUITE(posix_file_locking, NULL, setup, before, after, teardown);
```

## src/fs.c
```c
/*
 * Copyright (c) 2024 Friedt Professional Engineering Services, Inc.
 *
 * SPDX-License-Identifier: Apache-2.0
 */

#include <errno.h>
#include <stdio.h>
#include <string.h>

#include <ff.h>
#include <zephyr/fs/fs.h>
#include <zephyr/sys/util.h>
#include <zephyr/ztest.h>

static FATFS _fs;

static struct fs_mount_t _mnt = {
	.type = FS_FATFS,
	.mnt_point = "/",
	.fs_data = &_fs,
};

struct _entry {
	const char *const name;
	const char *const data;
	FILE *fp;
};

static struct _entry _data[] = {
	{.name = "/tmp/foo.txt", .data = ""},
	{.name = "/tmp/bar.txt", .data = "Hello"},
};

void setup_callback(void *arg);
void before_callback(void *arg);
void after_callback(void *arg);

void *setup(void)
{
	int ret;

	memset(&_fs, 0, sizeof(_fs));

	ret = fs_mount(&_mnt);
	zassert_ok(ret, "mount failed: %d", ret);

	ret = fs_mkdir("/tmp");
	zassert_ok(ret, "mkdir failed: %d", ret);

	setup_callback(NULL);

	return NULL;
}

void before(void *arg)
{
	ARG_UNUSED(arg);

	ARRAY_FOR_EACH_PTR(_data, entry) {
		int len;
		int ret;

		entry->fp = fopen(entry->name, "w+");
		zassert_not_null(entry->fp, "fopen() failed: %d", errno);

		len = strlen(entry->data);
		if (len > 0) {
			ret = (int)fwrite(entry->data, 1, len, entry->fp);
			zassert_equal(ret, len, "%s returned %d instead of %d: %d", "fwrite", ret,
				      len, errno);
			zassert_ok(fclose(entry->fp));
			entry->fp = fopen(entry->name, "r");
			zassert_not_null(entry->fp, "fopen() failed: %d", errno);
		}

		before_callback(entry->fp);
	};
}

void after(void *arg)
{
	ARG_UNUSED(arg);

	ARRAY_FOR_EACH_PTR(_data, entry) {
		(void)fclose(entry->fp);
	};

	after_callback(NULL);
}

void teardown(void *arg)
{
	ARG_UNUSED(arg);
	(void)fs_unmount(&_mnt);
}
```
