## CMakeLists.txt
```
# SPDX-License-Identifier: Apache-2.0

cmake_minimum_required(VERSION 3.20.0)
find_package(Zephyr REQUIRED HINTS $ENV{ZEPHYR_BASE})
project(posix_toybox)

target_sources(app PRIVATE src/main.c src/compat.c)

target_compile_options(app PRIVATE
  -U_POSIX_C_SOURCE -D_POSIX_C_SOURCE=200809L
  -U_XOPEN_SOURCE -D_XOPEN_SOURCE=700
)

# the toybox module builds toybox.llext; embed it for installation into ext2,
# with the list of its commands for the /bin links
add_dependencies(app toybox_llext)
generate_inc_file_for_target(app ${TOYBOX_LLEXT_FILE}
  ${ZEPHYR_BINARY_DIR}/include/generated/toybox.inc
)
set(commands_inc ${ZEPHYR_BINARY_DIR}/include/generated/toybox_commands.inc)
add_custom_command(
  OUTPUT ${commands_inc}
  COMMAND sed -e "s/.*/\"&\",/" ${TOYBOX_COMMANDS_FILE} > ${commands_inc}
  DEPENDS ${TOYBOX_COMMANDS_FILE}
  VERBATIM
)
set_property(SOURCE src/main.c APPEND PROPERTY OBJECT_DEPENDS ${commands_inc})

# a command of our own beside toybox: an image that faults
add_llext_target(fault_ext
  OUTPUT  ${PROJECT_BINARY_DIR}/llext/fault.llext
  SOURCES ${PROJECT_SOURCE_DIR}/src/fault_ext.c
)
generate_inc_file_for_target(app ${PROJECT_BINARY_DIR}/llext/fault.llext
  ${ZEPHYR_BINARY_DIR}/include/generated/fault_ext.inc
)
```

## Kconfig
```
# SPDX-FileCopyrightText: Copyright The Zephyr Project Contributors
# SPDX-License-Identifier: Apache-2.0

config SAMPLE_TOYBOX_TOUR
	bool "Run the command tour before the shell"
	default y
	help
	  Run a scripted sequence of toybox commands and shell scripts before
	  starting the interactive shell. Without it the sample sets up the file
	  system and drops straight into the shell, as the in-browser demo does.

source "Kconfig.zephyr"
```

## sample.yaml
```
sample:
  description: run toybox commands as processes exec'd from an ext2 file system
  name: posix toybox
common:
  tags:
    - posix
    - exec
    - llext
  build_only: false
  harness: console
  harness_config:
    type: multi_line
    ordered: true
    regex:
      - "hello world"
      - "Hello from toybox on Zephyr!"
      - "motd"
      - "bytes from 127[.]0[.]0[.]1"
      - "bytes from ::1"
      - "toybox sample complete"
  timeout: 180
tests:
  sample.posix.toybox:
    # 32-bit targets need an off_t story for toybox's _FILE_OFFSET_BITS=64 first
    platform_allow:
      - qemu_cortex_a53
      - qemu_riscv64
    integration_platforms:
      - qemu_riscv64
  sample.posix.toybox.gateway:
    # qemu user-mode networking: e1000 to the SLIRP virtual gateway, no
    # host-side TAP or privileges needed
    platform_allow:
      - qemu_cortex_a53
    extra_configs:
      - CONFIG_NET_TEST=n
      - CONFIG_NET_SLIP_TAP=n
      - CONFIG_NET_QEMU_USER=y
      - CONFIG_NET_L2_ETHERNET=y
      - CONFIG_ETH_DRIVER=y
      - CONFIG_NET_DEFAULT_IF_ETHERNET=y
      - CONFIG_NET_CONFIG_SETTINGS=y
      - CONFIG_NET_CONFIG_NEED_IPV4=y
      - CONFIG_NET_CONFIG_MY_IPV4_ADDR="10.0.2.15"
      - CONFIG_NET_CONFIG_MY_IPV4_NETMASK="255.255.255.0"
      - CONFIG_NET_CONFIG_MY_IPV4_GW="10.0.2.2"
      # the PCIe ECAM window alone is 256 MB of kernel VM
      - CONFIG_KERNEL_VM_SIZE=0x30000000
      - CONFIG_MAX_XLAT_TABLES=128
      # name resolution: Zephyr's resolver with Google's public servers (SLIRP
      # NATs the queries). The resolver's socket service handles replies on its
      # own thread, whose default 1200-byte stack overflows on 64-bit targets,
      # one network context is taken per server, and the service polls them.
      - CONFIG_NET_IPV6=y
      - CONFIG_NET_CONFIG_NEED_IPV6=y
      - CONFIG_NET_CONFIG_MY_IPV6_ADDR="fec0::15"
      - CONFIG_DNS_RESOLVER=y
      - CONFIG_DNS_SERVER_IP_ADDRESSES=y
      - CONFIG_DNS_RESOLVER_MAX_SERVERS=4
      - CONFIG_DNS_SERVER1="8.8.8.8"
      - CONFIG_DNS_SERVER2="8.8.4.4"
      - CONFIG_DNS_SERVER3="2001:4860:4860::8888"
      - CONFIG_DNS_SERVER4="2001:4860:4860::8844"
      - CONFIG_NET_SOCKETS_SERVICE_STACK_SIZE=4096
      - CONFIG_NET_MAX_CONTEXTS=16
      - CONFIG_ZVFS_POLL_MAX=16
    harness_config:
      type: multi_line
      ordered: true
      regex:
        - "hello world"
        - "Hello from toybox on Zephyr!"
        - "motd"
        - "bytes from 127[.]0[.]0[.]1"
        - "bytes from ::1"
        - "bytes from 10[.]0[.]2[.]2"
        - "bytes from fec0::2"
        # resolved, or not where the host has no internet: either way by name
        - "dns[.]google"
        - "toybox sample complete"
  sample.posix.toybox.fork:
    # user-mode image processes on a PROCESS_VM platform: toysh forks for
    # subshells and command substitution, a faulting command is a signal
    platform_allow:
      - qemu_cortex_a53
      - qemu_riscv64
      - qemu_x86_64
    extra_conf_files:
      - userspace.conf
    extra_configs:
      # PROCESS_VM needs the kernel on the process's page tables (no KPTI);
      # every image process and fork holds a memory domain, and the
      # per-process page tables outgrow the 8 MiB default VM
      - platform:qemu_x86_64/atom:CONFIG_X86_KPTI=n
      - platform:qemu_x86_64/atom:CONFIG_X86_MAX_ADDITIONAL_MEM_DOMAINS=16
      - platform:qemu_x86_64/atom:CONFIG_KERNEL_VM_SIZE=0x2400000
      # a forked child privatizes a leaf table per copied range
      - platform:qemu_cortex_a53/qemu_cortex_a53:CONFIG_MAX_XLAT_TABLES=256
      - platform:qemu_riscv64/qemu_virt_riscv64:CONFIG_MAX_XLAT_TABLES=640
    harness_config:
      type: multi_line
      ordered: true
      regex:
        - "hello world"
        - "Hello from toybox on Zephyr!"
        - "motd"
        - "bytes from 127[.]0[.]0[.]1"
        - "bytes from ::1"
        - "subshell works"
        - "cmdsub is works"
        - "killed by signal 11"
        - "fault exited with 139"
        - "toybox sample complete"
```

## prj.conf
```kconfig
# SPDX-License-Identifier: Apache-2.0

CONFIG_TOYBOX=y

CONFIG_POSIX_AEP_CHOICE_PSE53=y
# PSE53 without the queues, shared memory and packet sockets the shell never uses
CONFIG_POSIX_MESSAGE_PASSING=n
CONFIG_POSIX_SHARED_MEMORY_OBJECTS=n
CONFIG_POSIX_RAW_SOCKETS=n
CONFIG_POSIX_JOB_CONTROL=y
CONFIG_POSIX_EXEC_LLEXT=y
CONFIG_POSIX_ADVISORY_INFO=y
CONFIG_POSIX_FIFO=y
CONFIG_POSIX_FIFO_FD=y
CONFIG_POSIX_DEVICE_SPECIFIC=y
CONFIG_POSIX_DEVICE_SPECIFIC_R=y
CONFIG_POSIX_FILE_SYSTEM_EXT=y
CONFIG_POSIX_FILE_SYSTEM_FD=y
CONFIG_POSIX_FILE_SYSTEM_GLOB=y
CONFIG_POSIX_FILE_ATTRIBUTES=y
CONFIG_POSIX_FILE_ATTRIBUTES_FD=y
CONFIG_POSIX_REGEXP=y
CONFIG_POSIX_SYMBOLIC_LINKS=y
CONFIG_POSIX_SYMBOLIC_LINKS_FD=y
CONFIG_POSIX_SYSTEM_DATABASE=y
CONFIG_POSIX_USER_GROUPS=y
CONFIG_POSIX_USER_GROUPS_R=y

# loopback networking so ping can reach 127.0.0.1. NET_TEST keeps the qemu
# boards off their host-backed NICs (SLIP over uart_pipe, e1000 over a host
# TAP), which hang or fail without host-side setup; loopback needs neither.
CONFIG_NETWORKING=y
CONFIG_NET_TEST=y
CONFIG_NET_DRIVERS=y
CONFIG_NET_LOOPBACK=y
CONFIG_NET_IPV4=y
CONFIG_NET_SOCKETS=y
CONFIG_NET_SOCKETS_INET_RAW=y
CONFIG_NET_PKT_RX_COUNT=8
CONFIG_NET_PKT_TX_COUNT=8
CONFIG_NET_BUF_RX_COUNT=16
CONFIG_NET_BUF_TX_COUNT=16
# loopback nests tx -> rx -> icmp reply -> rx in one thread
CONFIG_NET_TX_STACK_SIZE=8192
CONFIG_NET_RX_STACK_SIZE=8192
# interface bring-up transmits from the system workqueue (NET_TC_TX_COUNT=0)
CONFIG_SYSTEM_WORKQUEUE_STACK_SIZE=4096

CONFIG_XSI=y
CONFIG_XSI_SINGLE_PROCESS=y
CONFIG_XSI_STREAMS=y
CONFIG_XSI_SYSTEM_LOGGING=y

CONFIG_LLEXT=y
CONFIG_POSIX_LLEXT_SYMBOLS=y
CONFIG_LLEXT_TYPE_ELF_RELOCATABLE=y
# every process loads its own copy of the 350 KiB command set: room for a
# shell and a six-stage pipeline
CONFIG_LLEXT_HEAP_SIZE=8192

CONFIG_FILE_SYSTEM=y
CONFIG_FILE_SYSTEM_EXT2=y
CONFIG_FILE_SYSTEM_MKFS=y
CONFIG_DISK_ACCESS=y
CONFIG_DISK_DRIVER_RAM=y
CONFIG_TEST_RANDOM_GENERATOR=y
CONFIG_ZVFS_STDIN_CONSOLE=y

CONFIG_SYS_PROCESS_MAX=8
CONFIG_SYS_THREAD_STACK_SIZE=8192
CONFIG_SYS_PROCESS_ARG_BYTES=1024
CONFIG_POSIX_EXEC_ARGS_MAX=32
CONFIG_HEAP_MEM_POOL_SIZE=524288
# the shell and every process it spawns share this arena
CONFIG_COMMON_LIBC_MALLOC_ARENA_SIZE=524288

# room for multi-stage pipelines: several simultaneous pipes plus the
# shell's stdio, ext2, and cwd descriptors
CONFIG_ZVFS_OPEN_MAX=32
CONFIG_ZVFS_PROC_OPEN_MAX=16
CONFIG_ZVFS_PIPE_MAX=8
CONFIG_ZVFS_OPEN_ADD_SIZE_PIPE=16
CONFIG_MAIN_STACK_SIZE=16384
```

## userspace.conf
```kconfig
# SPDX-License-Identifier: Apache-2.0

# every toybox command is a user-mode process in its own memory domain, with
# the C library state (malloc arena, standard streams) of its own
CONFIG_USERSPACE=y
CONFIG_SYS_PROCESS_STATE_AREA=262144
# a system call stages the image, its arguments and the working directory
CONFIG_PRIVILEGED_STACK_SIZE=8192
# fork(): toysh subshells and background jobs, timeout(1)
CONFIG_PROCESS_VM=y
CONFIG_CURRENT_THREAD_USE_TLS=n
```

## boards/qemu_riscv64_qemu_virt_riscv64.conf
```kconfig
# SPDX-FileCopyrightText: Copyright The Zephyr Project Contributors
# SPDX-License-Identifier: Apache-2.0

# the image outgrows the 8 MiB default kernel virtual region, and its kernel
# mappings plus every process's domain tables outgrow the page-table pool
CONFIG_KERNEL_VM_SIZE=0x2000000
CONFIG_MAX_XLAT_TABLES=64
```

## boards/qemu_x86_64.conf
```kconfig
# SPDX-FileCopyrightText: Copyright The Zephyr Project Contributors
# SPDX-License-Identifier: Apache-2.0

# the image outgrows the 8 MiB default kernel virtual region
CONFIG_KERNEL_VM_SIZE=0x2000000
```

## src/main.c
```c
/*
 * Copyright (c) 2026, Friedt Professional Engineering Services, Inc.
 *
 * SPDX-License-Identifier: Apache-2.0
 */

#include <errno.h>
#include <spawn.h>
#include <stdio.h>
#include <string.h>
#include <sys/stat.h>
#include <sys/wait.h>
#include <unistd.h>

#include <zephyr/fs/fs.h>
#include <zephyr/kernel.h>

#define TOYBOX_PATH "/bin/toybox"
#define FAULT_PATH "/bin/fault"

static struct fs_mount_t root_mnt = {
	.type = FS_EXT2,
	.mnt_point = "/",
	.storage_dev = (void *)"RAM",
};

static const uint8_t toybox_image[] __aligned(8) = {
#include "toybox.inc"
};

/* a command of our own: a process that takes a CPU fault */
static const uint8_t fault_image[] __aligned(8) = {
#include "fault_ext.inc"
};

/* the commands the image provides: each is a /bin symlink to the binary */
static const char *const toybox_commands[] = {
#include "toybox_commands.inc"
};

/* the environment every spawned process starts with */
static char *const spawn_env[] = {"PATH=/bin", "HOME=/root", NULL};

static int write_file(const char *path, const void *data, size_t len)
{
	struct fs_file_t f;
	int ret;

	fs_file_t_init(&f);
	ret = fs_open(&f, path, FS_O_CREATE | FS_O_WRITE);
	if (ret < 0) {
		printf("creating %s failed: %d\n", path, ret);
		return ret;
	}
	/* one fs block at a time: a single 100 KiB+ fs_write() to ext2 has
	 * been seen to corrupt the file's first blocks
	 */
	for (size_t off = 0; off < len;) {
		ssize_t n = fs_write(&f, (const uint8_t *)data + off, MIN(1024, len - off));

		if (n <= 0) {
			printf("writing %s at %zu failed: %zd\n", path, off, n);
			ret = -1;
			break;
		}
		off += n;
	}
	(void)fs_close(&f);

	return (ret < 0) ? ret : 0;
}

static int spawn_wait(const char *path, char *const argv[])
{
	pid_t pid;
	int status = 0;
	int ret;

	ret = posix_spawn(&pid, path, NULL, NULL, argv, spawn_env);
	if (ret != 0) {
		printf("posix_spawn() failed: %d\n", ret);
		return -1;
	}

	if (waitpid(pid, &status, 0) < 0) {
		printf("waitpid() failed: %d\n", errno);
		return -1;
	}

	if (WIFEXITED(status) && (WEXITSTATUS(status) != 0)) {
		printf("exit status: %d\n", WEXITSTATUS(status));
	} else if (WIFSIGNALED(status)) {
		printf("killed by signal %d\n", WTERMSIG(status));
	}

	return status;
}

/* echo the command line the way a shell would, then run it */
static int run(const char *path, char *const argv[])
{
	printf("\n$ %s", argv[0]);
	for (int i = 1; argv[i] != NULL; i++) {
		printf(" %s", argv[i]);
	}
	printf("\n");

	return spawn_wait(path, argv);
}

/* toybox dispatches on argv[0]: "toybox CMD ..." or the command name itself */
#define RUN(...)          run(TOYBOX_PATH, (char *const[]){"toybox", __VA_ARGS__, NULL})
#define RUN_AS(name, ...) run("/bin/" name, (char *const[]){name, __VA_ARGS__, NULL})

/* the scripted tour: what the command set and the shell can do */
static void tour(void)
{
	/* no arguments: list the available commands */
	run(TOYBOX_PATH, (char *const[]){"toybox", NULL});
	RUN("uname", "-a");
	RUN("echo", "hello", "world");
	RUN("cat", "/etc/motd");
	RUN("mkdir", "/tmp/scratch");
	RUN("pwd");
	RUN("ls", "-l", "/etc");
	RUN("printf", "hex of %d is %x\\n", "42", "42");
	RUN("seq", "3");
	RUN("wc", "/etc/motd");

	/* symbolic links on ext2: create, read back, follow */
	RUN("ln", "-s", "motd", "/etc/motd.lnk");
	RUN("readlink", "/etc/motd.lnk");
	RUN("cat", "/etc/motd.lnk");

	/* a command run under its own name */
	RUN_AS("ls", "-l", "/bin/ls", "/bin/sh");
	RUN("sh", "-c", "ls /bin | wc -l");

	/* toysh: builtins, variables, globbing and control flow run in the
	 * shell process itself; external commands are spawned. Subshells and
	 * command substitution need fork() and are not yet part of the demo.
	 */
	static const char init_sh[] = "echo toysh: hello from $0\n"
				      "uname -m\n"
				      "for f in /etc/*; do echo saw $f; done\n"
				      "ls /etc | cat\n"
				      "printf 'hex of 42 is %x\\n' 42\n"
				      "x=zephyr\n"
				      "case $x in z*) echo case matched $x ;; esac\n";

	if (write_file("/etc/init.sh", init_sh, strlen(init_sh)) == 0) {
		RUN("sh", "-c", "echo hello from toysh | cat");
		RUN("sh", "/etc/init.sh");
	}

	RUN("ping", "-c", "1", "127.0.0.1");
	RUN("ping6", "-c", "1", "::1");
#ifdef CONFIG_PROCESS_VM
	/* subshells and command substitution fork() the shell */
	RUN("sh", "-c", "(echo subshell works); echo cmdsub is $(echo works)");
#endif
#ifdef CONFIG_USERSPACE
	/* a user-mode process that faults is killed by the signal; the shell
	 * that ran it reports the death and goes on. In kernel mode the fault
	 * is the kernel's.
	 */
	run(FAULT_PATH, (char *const[]){"fault", NULL});
	RUN("sh", "-c", "fault; echo fault exited with $?");
#endif
#ifdef CONFIG_NET_CONFIG_SETTINGS
	/* a real interface is configured: reach past the loopback */
	RUN("ping", "-c", "1", CONFIG_NET_CONFIG_MY_IPV4_GW);
#ifdef CONFIG_NET_CONFIG_NEED_IPV6
	RUN("ping6", "-c", "1", "fec0::2");
#endif
#ifdef CONFIG_DNS_RESOLVER
	/* a name, through the resolver; the echo itself needs the host's internet */
	RUN("ping", "-c", "1", "dns.google");
#endif
#endif

	printf("\ntoybox sample complete\n");
	printf("\nstarting an interactive shell\n");
}

int main(void)
{
#ifdef CONFIG_USERSPACE
	/* what toybox's processes touch of the system's shared state: directory streams
	 * and the user and group databases
	 */
	extern struct k_mem_partition zvfs_dir_partition;
	extern struct k_mem_partition posix_system_database_partition;

	(void)k_mem_domain_add_partition(&k_mem_domain_default, &zvfs_dir_partition);
	(void)k_mem_domain_add_partition(&k_mem_domain_default, &posix_system_database_partition);
#endif /* CONFIG_USERSPACE */
	static const char passwd[] = "root:x:0:0:root:/root:/bin/sh\n";
	static const char group[] = "root:x:0:\n";
	static const char motd[] = "Hello from toybox on Zephyr!\n";
	int ret;

	ret = fs_mkfs(FS_EXT2, (uintptr_t)"RAM", NULL, 0);
	if (ret < 0) {
		printf("mkfs failed: %d\n", ret);
		return ret;
	}

	ret = fs_mount(&root_mnt);
	if (ret < 0) {
		printf("mount failed: %d\n", ret);
		return ret;
	}

	(void)fs_mkdir("/bin");
	(void)fs_mkdir("/etc");
	(void)fs_mkdir("/root");
	(void)fs_mkdir("/tmp");

	if (write_file("/etc/passwd", passwd, strlen(passwd)) < 0 ||
	    write_file("/etc/group", group, strlen(group)) < 0 ||
	    write_file("/etc/motd", motd, strlen(motd)) < 0 ||
	    write_file(TOYBOX_PATH, toybox_image, sizeof(toybox_image)) < 0 ||
	    write_file(FAULT_PATH, fault_image, sizeof(fault_image)) < 0) {
		return -1;
	}
	/* a file created by the file system API has no execute permission */
	if (chmod(TOYBOX_PATH, 0755) != 0 || chmod(FAULT_PATH, 0755) != 0) {
		printf("chmod failed: %d\n", errno);
		return -1;
	}

	/* the usual install: each command is a /bin symlink to the binary,
	 * exec follows the link, and toybox dispatches on argv[0]
	 */
	for (size_t i = 0; i < ARRAY_SIZE(toybox_commands); i++) {
		char link[32];

		snprintf(link, sizeof(link), "/bin/%s", toybox_commands[i]);
		ret = fs_symlink("toybox", link);
		if (ret < 0) {
			printf("linking %s failed: %d\n", link, ret);
			return ret;
		}
	}
	printf("%zu commands linked in /bin\n", ARRAY_SIZE(toybox_commands));

	if (IS_ENABLED(CONFIG_SAMPLE_TOYBOX_TOUR)) {
		tour();
	}

	/* and finally: a shell on the console. Ctrl-D or 'exit' leaves it. */
	spawn_wait(TOYBOX_PATH, (char *const[]){"toybox", "sh", NULL});
	printf("goodbye\n");

	return 0;
}
```

## src/compat.c
```c
/*
 * Copyright (c) 2026, Friedt Professional Engineering Services, Inc.
 *
 * SPDX-License-Identifier: Apache-2.0
 */

/*
 * Stand-ins for symbols toybox links against that Zephyr does not provide.
 * They sit on code paths the enabled applets never take at runtime; each
 * fails cleanly if ever reached.
 */

#include <arpa/inet.h>
#include <errno.h>
#include <grp.h>
#include <langinfo.h>
#include <libgen.h>
#include <locale.h>
#include <netdb.h>
#include <stdio.h>
#include <time.h>
#include <wchar.h>
#include <stddef.h>
#include <stdlib.h>
#include <string.h>
#include <strings.h>
#include <sys/socket.h>
#include <sys/time.h>
#include <sys/utsname.h>
#include <unistd.h>

#include <zephyr/llext/symbol.h>

char *realpath(const char *path, char *resolved)
{
	/* no dot-segment or symlink canonicalization: absolute paths pass through */
	if ((path == NULL) || (path[0] != '/')) {
		errno = (path == NULL) ? EINVAL : ENOENT;
		return NULL;
	}

	if (resolved == NULL) {
		return strdup(path);
	}

	(void)strcpy(resolved, path);

	return resolved;
}
EXPORT_SYMBOL(realpath);


/* busybox's disabled ulimit builtin still links these from a live object */
struct rlimit;

int getrlimit(int resource, struct rlimit *rlp)
{
	ARG_UNUSED(resource);
	ARG_UNUSED(rlp);
	errno = ENOSYS;
	return -1;
}
EXPORT_SYMBOL(getrlimit);

int setrlimit(int resource, const struct rlimit *rlp)
{
	ARG_UNUSED(resource);
	ARG_UNUSED(rlp);
	errno = ENOSYS;
	return -1;
}
EXPORT_SYMBOL(setrlimit);

int chroot(const char *path)
{
	ARG_UNUSED(path);
	errno = ENOSYS;
	return -1;
}
EXPORT_SYMBOL(chroot);

int mallopt(int param, int value)
{
	ARG_UNUSED(param);
	ARG_UNUSED(value);
	return 0;
}
EXPORT_SYMBOL(mallopt);

char *mktemp(char *tmpl)
{
	if (tmpl != NULL) {
		tmpl[0] = '\0';
	}
	errno = ENOSYS;
	return tmpl;
}
EXPORT_SYMBOL(mktemp);

int settimeofday(const struct timeval *tv, const void *tz)
{
	ARG_UNUSED(tv);
	ARG_UNUSED(tz);
	errno = ENOSYS;
	return -1;
}
EXPORT_SYMBOL(settimeofday);



char *dirname(char *path)
{
	char *slash;

	if ((path == NULL) || (*path == '\0')) {
		return ".";
	}

	slash = strrchr(path, '/');
	if (slash == NULL) {
		return ".";
	}
	if (slash == path) {
		return "/";
	}
	*slash = '\0';

	return path;
}
EXPORT_SYMBOL(dirname);

#ifndef CONFIG_POSIX_NETWORKING
int socket(int domain, int type, int protocol)
{
	ARG_UNUSED(domain);
	ARG_UNUSED(type);
	ARG_UNUSED(protocol);
	errno = EAFNOSUPPORT;
	return -1;
}
EXPORT_SYMBOL(socket);

int bind(int sock, const struct sockaddr *addr, socklen_t addrlen)
{
	ARG_UNUSED(sock);
	ARG_UNUSED(addr);
	ARG_UNUSED(addrlen);
	errno = EBADF;
	return -1;
}
EXPORT_SYMBOL(bind);

int listen(int sock, int backlog)
{
	ARG_UNUSED(sock);
	ARG_UNUSED(backlog);
	errno = EBADF;
	return -1;
}
EXPORT_SYMBOL(listen);

ssize_t sendto(int sock, const void *buf, size_t len, int flags,
	       const struct sockaddr *dest_addr, socklen_t addrlen)
{
	ARG_UNUSED(sock);
	ARG_UNUSED(buf);
	ARG_UNUSED(len);
	ARG_UNUSED(flags);
	ARG_UNUSED(dest_addr);
	ARG_UNUSED(addrlen);
	errno = EBADF;
	return -1;
}
EXPORT_SYMBOL(sendto);
int gethostname(char *name, size_t len)
{
	struct utsname uts;

	if (uname(&uts) < 0) {
		return -1;
	}
	if (strlen(uts.nodename) >= len) {
		errno = ENAMETOOLONG;
		return -1;
	}
	strcpy(name, uts.nodename);

	return 0;
}
EXPORT_SYMBOL(gethostname);

int connect(int sock, const struct sockaddr *addr, socklen_t addrlen)
{
	ARG_UNUSED(sock);
	ARG_UNUSED(addr);
	ARG_UNUSED(addrlen);

	errno = ENOSYS;
	return -1;
}
EXPORT_SYMBOL(connect);

int setsockopt(int sock, int level, int optname, const void *optval, socklen_t optlen)
{
	ARG_UNUSED(sock);
	ARG_UNUSED(level);
	ARG_UNUSED(optname);
	ARG_UNUSED(optval);
	ARG_UNUSED(optlen);

	errno = ENOSYS;
	return -1;
}
EXPORT_SYMBOL(setsockopt);

int shutdown(int sock, int how)
{
	ARG_UNUSED(sock);
	ARG_UNUSED(how);

	errno = ENOSYS;
	return -1;
}
EXPORT_SYMBOL(shutdown);

ssize_t recvfrom(int sock, void *buf, size_t len, int flags, struct sockaddr *addr,
		 socklen_t *addrlen)
{
	ARG_UNUSED(sock);
	ARG_UNUSED(buf);
	ARG_UNUSED(len);
	ARG_UNUSED(flags);
	ARG_UNUSED(addr);
	ARG_UNUSED(addrlen);

	errno = ENOSYS;
	return -1;
}
EXPORT_SYMBOL(recvfrom);

int getaddrinfo(const char *host, const char *service, const struct addrinfo *hints,
		struct addrinfo **res)
{
	ARG_UNUSED(host);
	ARG_UNUSED(service);
	ARG_UNUSED(hints);
	ARG_UNUSED(res);

	return EAI_FAIL;
}
EXPORT_SYMBOL(getaddrinfo);

void freeaddrinfo(struct addrinfo *ai)
{
	ARG_UNUSED(ai);
}
EXPORT_SYMBOL(freeaddrinfo);

const char *gai_strerror(int errcode)
{
	ARG_UNUSED(errcode);

	return "Name resolution unavailable";
}
EXPORT_SYMBOL(gai_strerror);

char *inet_ntop(sa_family_t family, const void *src, char *dst, size_t size)
{
	ARG_UNUSED(family);
	ARG_UNUSED(src);
	ARG_UNUSED(dst);
	ARG_UNUSED(size);

	errno = EAFNOSUPPORT;
	return NULL;
}
EXPORT_SYMBOL(inet_ntop);
#endif /* CONFIG_POSIX_NETWORKING */

/* XSI basename(): the last component, with trailing slashes stripped.
 * The libc header may alias the name; the extension resolves the plain one.
 */
#undef basename
char *basename(char *path)
{
	static char dot[] = {'.', '\0'};
	char *end;
	char *start;

	if (path == NULL || *path == '\0') {
		return dot;
	}

	end = path + strlen(path) - 1;
	while (end > path && *end == '/') {
		*end-- = '\0';
	}

	if (end == path && *end == '/') {
		return path;
	}

	start = strrchr(path, '/');

	return (start == NULL) ? path : start + 1;
}
EXPORT_SYMBOL(basename);

/* one identity, no supplementary groups */
int initgroups(const char *user, gid_t group)
{
	ARG_UNUSED(user);
	ARG_UNUSED(group);

	return 0;
}
EXPORT_SYMBOL(initgroups);

/* provided by the C library; their Option Groups (XSI_C_LANG_SUPPORT,
 * XSI_WIDE_CHAR, MULTI_CONCURRENT_LOCALES, I18N) are not yet claimed by
 * the POSIX layer, so the export lives here
 */
EXPORT_SYMBOL(strptime);
EXPORT_SYMBOL(wcwidth);
EXPORT_SYMBOL(newlocale);
EXPORT_SYMBOL(uselocale);
EXPORT_SYMBOL(nl_langinfo);
EXPORT_SYMBOL(fmemopen);
EXPORT_SYMBOL(random);
EXPORT_SYMBOL(srandom);
EXPORT_SYMBOL(ffs);

/* GNU extensions the C library provides but declares only under _GNU_SOURCE */
void *memmem(const void *haystack, size_t haystacklen, const void *needle, size_t needlelen);
char *strcasestr(const char *haystack, const char *needle);
EXPORT_SYMBOL(memmem);
EXPORT_SYMBOL(strcasestr);
```

## src/fault_ext.c
```c
/*
 * SPDX-FileCopyrightText: Copyright The Zephyr Project Contributors
 *
 * SPDX-License-Identifier: Apache-2.0
 */

#include <stdio.h>

#include <zephyr/llext/symbol.h>

/* a command that takes a CPU fault: a user-mode process is killed by SIGSEGV */
int main(int argc, char **argv, char **envp)
{
	volatile int *nowhere = NULL;

	(void)argc;
	(void)envp;
	printf("%s: storing through a null pointer\n", argv[0]);
	*nowhere = 0;

	return 0;
}
LL_EXTENSION_SYMBOL(main);
```
