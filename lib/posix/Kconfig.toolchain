## lib/posix/options/fd_mgmt/Kconfig
```kconfig
# SPDX-FileCopyrightText: Copyright The Zephyr Project Contributors
# SPDX-License-Identifier: Apache-2.0

menuconfig POSIX_FD_MGMT
	bool "POSIX file descriptor management"
	select ZVFS
	help
	  Select 'y' here and Zephyr will provide dup(), dup2(), fcntl(), fseeko(),
	  ftello(), ftruncate(), and lseek() for the POSIX_FD_MGMT Option Group.

if POSIX_FD_MGMT

# These options are intended to be used for compatibility with external POSIX
# implementations such as those in Newlib or Picolibc.

config POSIX_FD_MGMT_ALIAS_FCNTL
	bool
	help
	  When selected via Kconfig, Zephyr will provide an alias for fcntl() as _fcntl().

config POSIX_FD_MGMT_ALIAS_FTRUNCATE
	bool
	help
	  When selected via Kconfig, Zephyr will provide an alias for ftruncate() as _ftruncate().

config POSIX_FD_MGMT_ALIAS_LSEEK
	bool
	help
	  When selected via Kconfig, Zephyr will provide an alias for lseek() as _lseek().

config POSIX_FD_MGMT_ALIAS_FSEEKO
	bool
	help
	  When selected via Kconfig, Zephyr will provide an alias for fseeko() as _fseeko().

config POSIX_FD_MGMT_ALIAS_FTELLO
	bool
	help
	  When selected via Kconfig, Zephyr will provide an alias for ftello() as _ftello().

config POSIX_FD_MGMT_ALIAS_FSEEKO_R
	bool
	help
	  When selected via Kconfig, Zephyr will provide _fseeko_r() calling fseeko().

config POSIX_FD_MGMT_ALIAS_FTELLO_R
	bool
	help
	  When selected via Kconfig, Zephyr will provide _ftello_r() calling ftello().

endif # POSIX_FD_MGMT
```

## lib/posix/options/memlock/Kconfig
```kconfig
# Copyright (c) 2024 BayLibre SAS
#
# SPDX-License-Identifier: Apache-2.0

config POSIX_MEMLOCK
	bool "POSIX memory locking"
	depends on POSIX_MAPPED_FILES
	help
	  Select 'y' here and Zephyr will provide support for mlockall() and munlockall().

	  Note: This feature depends on hardware MMU support as well as DEMAND_PAGING. If the
	  underlying platform does not support an MMU or DEMAND_PAGING, then affected POSIX API
	  functions will return -1 and set errno to ENOTSUP.
```

## lib/posix/options/memory_protection/Kconfig
```kconfig
# Copyright (c) 2024 BayLibre SAS
#
# SPDX-License-Identifier: Apache-2.0

config POSIX_MEMORY_PROTECTION
	bool "POSIX memory protection"
	help
	  Select 'y' here and Zephyr will provide support for mprotect().
```

## lib/posix/options/networking/Kconfig
```kconfig
# Copyright (c) 2024, Friedt Professional Engineering Services, Inc
#
# SPDX-License-Identifier: Apache-2.0

menuconfig POSIX_NETWORKING
	bool "POSIX Networking API"
	depends on NETWORKING
	select NET_HOSTNAME_ENABLE
	select NET_HOSTNAME_DYNAMIC
	select NET_INTERFACE_NAME
	select NET_SOCKETPAIR
	select NET_SOCKETS
	help
	  Enable this option to support the POSIX networking API. This includes
	  support for BSD Sockets.

if POSIX_NETWORKING

config POSIX_HOST_NAME_MAX
	int
	default NET_HOSTNAME_MAX_LEN
	help
	  The maximum length of a host name as defined by POSIX.

config POSIX_IPV6
	bool "POSIX IPv6 support"
	default y if NET_CONFIG_NEED_IPV6
	help
	  Enable this option to support the POSIX IPv6 API.

config POSIX_RAW_SOCKETS
	bool "POSIX RAW socket support"
	select NET_SOCKETS_PACKET
	help
	  Enable this option to support the raw sockets.

endif # POSIX_NETWORKING
```

## lib/posix/options/non_portable/Kconfig
```kconfig
# Copyright (c) 2025 Friedt Professional Engineering Services, Inc.
#
# SPDX-License-Identifier: Apache-2.0

menuconfig POSIX_NON_PORTABLE
	bool "POSIX non-portable extensions"
	depends on POSIX_THREADS
	select THREAD_NAME
	help
	  Select 'y' here to enable POSIX non-portable (_np) pthread extensions:
	  pthread_getname_np(), pthread_setname_np(), pthread_timedjoin_np(), and
	  pthread_tryjoin_np().

if POSIX_NON_PORTABLE

module = POSIX_NON_PORTABLE
module-str = POSIX non-portable pthread extensions
source "subsys/logging/Kconfig.template.log_config"

endif # POSIX_NON_PORTABLE
```

## lib/posix/options/realtime_signals/Kconfig
```kconfig
# Copyright (c) 2023 Meta
#
# SPDX-License-Identifier: Apache-2.0

config POSIX_REALTIME_SIGNALS
	bool "POSIX realtime signals"
	help
	  Enable support for POSIX realtime signals.

if POSIX_REALTIME_SIGNALS

config SIGNAL_QUEUE_SIZE_ADD_POSIX_REALTIME
	def_int 32
	help
	  This value represents the maximum number of signals that a process may send or have pending
	  at any given time (see SIGQUEUE_MAX and
	  _POSIX_SIGQUEUE_MAX limits.h).

config POSIX_RTSIG_MAX
	int "Maximum number of realtime signals"
	default 8
	help
	  Define the maximum number of realtime signals (RTSIG_MAX).
	  The range of realtime signals is [SIGRTMIN .. (SIGRTMIN+RTSIG_MAX)]

# it would be much better to use arithmetic + variables here but it does not work
config SIGNAL_SET_SIZE_MIN_POSIX_REALTIME
	def_int 42
	help
	  Linux-aligned POSIX realtime sigset_t size (SIGRTMIN is this value
	  minus CONFIG_POSIX_RTSIG_MAX: reserve 32 for cancel, 33 reserved).

endif # POSIX_REALTIME_SIGNALS
```

## lib/posix/options/signals/Kconfig
```kconfig
# Copyright (c) 2023 Meta
#
# SPDX-License-Identifier: Apache-2.0

menu "POSIX signals"

config POSIX_SIGNALS
	bool "POSIX signals"
	select SIGNAL
	select POSIX_MULTI_PROCESS
	help
	  Enable support for POSIX signals.

if POSIX_SIGNALS

config SIGNAL_SET_SIZE_MIN_POSIX
	def_int 32
	help
	  This number of signals required for POSIX conformance.

	  When enabled, this option ensures the value of SIGNAL_SET_SIZE is at least 32.

config SIGNAL_QUEUE_SIZE_ADD_POSIX
	def_int 4
	help
	  Number of signal queue entries required by the POSIX signals option group, which needs
	  room for signals generated by alarm(), kill(), and raise().

config SIGNAL_ACTION_DB_SIZE_MIN_POSIX
	def_int 8
	help
	  Number of signal action database entries required by the POSIX signals option group, so
	  that sigaction() and signal() can install handlers without SIGNAL_ACTION_DB_SIZE having to
	  be configured by hand.

	  When enabled, this option ensures the value of SIGNAL_ACTION_DB_SIZE is at least 8.

# These options are intended to be used for compatibility with external POSIX
# implementations such as those in Newlib or Picolibc.

config POSIX_SIGNALS_ALIAS_KILL
	bool

endif

endmenu # "Signal support"
```

## lib/posix/options/signals_ext/Kconfig
```kconfig
# Copyright (c) 2023 Meta
#
# SPDX-License-Identifier: Apache-2.0

config POSIX_SIGNALS_EXT
	bool "Extended POSIX signal support"
	depends on POSIX_SIGNALS
	default y
	help
	  Enable strsignal() and related helpers from POSIX_SIGNALS_EXT.

if POSIX_SIGNALS_EXT

config POSIX_SIGNAL_STRING_DESC_DISABLE
	bool "Disable full description for the strsignal API"
	depends on !TC_PROVIDES_POSIX_SIGNALS_EXT
	help
	  When enabled, strsignal() returns "Signal N" instead of a human-readable
	  description. Saves approximately 256 bytes of ROM.

endif
```

## lib/posix/options/synchronized_io/Kconfig
```kconfig
# Copyright (c) The Zephyr Project Contributors
#
# SPDX-License-Identifier: Apache-2.0

config POSIX_SYNCHRONIZED_IO
	bool "POSIX synchronized I/O"
	select POSIX_FSYNC
	help
	  Enable POSIX synchronized I/O, for finer-grained control on data integrity and file
	  integrity. If a file is opened with O_SYNC, writes are blocked until both file data and
	  metadata are synchronized. If a file is opened with O_DSYNC, writes are blocked until
	  data (and critical metadata) are synchronized. For read-only files, O_RSYNC ensures that
	  pending writes are flushed before a read finishes.

	  When enabled, the following function is available:

	  fdatasync()

	  This option also selects POSIX_FSYNC.
```

## lib/posix/options/thread_priority_scheduling/Kconfig
```kconfig
# Copyright (c) The Zephyr Project Contributors
#
# SPDX-License-Identifier: Apache-2.0

config POSIX_THREAD_PRIORITY_SCHEDULING
	bool "Run POSIX threads with different priorities and schedulers"
	depends on POSIX_THREADS
	help
	  Enabling this option allows the application to configure different priorities and
	  scheduling algorithms for different threads via functions such as pthread_setschedparam()
	  and pthread_setschedprio(). This is required for Realtime Threads and Advanced Realtime
	  Threads.
```

## lib/posix/options/threads_base/Kconfig
```kconfig
# Copyright (c) 2017 Intel Corporation
# Copyright (c) 2023 Meta
# Copyright (c) 2024 Tenstorrent AI ULC
#
# SPDX-License-Identifier: Apache-2.0

menuconfig POSIX_THREADS
	bool "POSIX thread support"
	select SYS_THREAD
	select SIGNAL
	select THREAD_CANCEL
	select THREAD_RESULT
	select THREAD_SPECIFIC_STORAGE
	select THREAD_CLEANUP
	select THREAD_DETACH
	select MUTEX_OPTIONS
	help
	  Select 'y' here to enable POSIX threads, mutexes, condition variables, and
	  thread-specific storage.

	  This option makes the following functions available:
	  pthread_atfork(), pthread_attr_destroy(), pthread_attr_getdetachstate(),
	  pthread_attr_getschedparam(), pthread_attr_init(), pthread_attr_setdetachstate(),
	  pthread_attr_setschedparam(), pthread_cancel(), pthread_cleanup_pop(),
	  pthread_cleanup_push(), pthread_cond_broadcast(), pthread_cond_destroy(),
	  pthread_cond_init(), pthread_cond_signal(), pthread_cond_timedwait(),
	  pthread_cond_wait(), pthread_condattr_destroy(), pthread_condattr_init(),
	  pthread_create(), pthread_detach(), pthread_equal(), pthread_exit(),
	  pthread_getspecific(), pthread_join(), pthread_key_create(), pthread_key_delete(),
	  pthread_kill(), pthread_mutex_destroy(), pthread_mutex_init(), pthread_mutex_lock(),
	  pthread_mutex_timedlock(), pthread_mutex_trylock(), pthread_mutex_unlock(),
	  pthread_mutexattr_destroy(), pthread_mutexattr_init(), pthread_once(), pthread_self(),
	  pthread_setcancelstate(), pthread_setcanceltype(), pthread_setspecific(),
	  pthread_sigmask(), and pthread_testcancel().

if POSIX_THREADS

# There are a number of things in POSIX that assume the availability of heap space.
config HEAP_MEM_POOL_ADD_SIZE_POSIX_THREADS
	def_int 256

# Required for _POSIX_THREAD_THREADS_MAX in <limits.h>

config SYS_THREAD_THREAD_MAX
	int
	default 64

config SYS_THREAD_STACK_MAX
	int
	default 64

# Required for conventional heap allocation of mutexes, condition variables, etc

uint16_max := 65535

config SYS_THREAD_CONDVAR_MAX
	int
	default $(uint16_max)

config SYS_THREAD_MUTEX_MAX
	int
	default $(uint16_max)

config POSIX_THREAD_THREADS_MAX
	int "Maximum number of POSIX threads"
	default SYS_THREAD_THREAD_MAX
	help
	  Maximum simultaneously active threads in a POSIX application.

config MAX_PTHREAD_MUTEX_COUNT
	int "Maximum number of POSIX mutexes"
	default SYS_THREAD_MUTEX_MAX
	help
	  Maximum simultaneously active mutexes in a POSIX application.

config MAX_PTHREAD_COND_COUNT
	int "Maximum number of POSIX condition variables"
	default SYS_THREAD_CONDVAR_MAX
	help
	  Maximum simultaneously active condition variables in a POSIX application.

config POSIX_THREAD_KEYS_MAX
	int "Maximum number of POSIX thread-specific-storage keys"
	default 5
	help
	  Maximum simultaneously active thread-specific-storage keys in a POSIX application.

config PTHREAD_RECYCLER_DELAY_MS
	int "Delay for reclaiming dynamic pthread stacks (ms) [DEPRECATED]"
	default 0
	help
	  This option is deprecated.

config POSIX_THREAD_ATTR_STACKADDR
	bool "Support getting and setting POSIX thread stack addresses"
	help
	  Enable this option together with POSIX_THREAD_ATTR_STACKSIZE to use
	  pthread_attr_getstack() and pthread_attr_setstack().

	  IEEE 1003.1-2017 removed pthread_attr_getstackaddr() and
	  pthread_attr_setstackaddr() in favour of the combined APIs.

config POSIX_THREAD_ATTR_STACKSIZE
	bool "Support getting and setting POSIX thread stack sizes"
	help
	  Enable this option to use pthread_attr_getstacksize() or
	  pthread_attr_setstacksize().

config POSIX_THREAD_PRIO_INHERIT
	bool "POSIX mutex priority inheritance"
	depends on POSIX_THREADS
	help
	  Select 'y' here to enable POSIX mutex priority inheritance.

config POSIX_THREAD_PRIO_PROTECT
	bool "POSIX mutex priority protection"
	depends on POSIX_THREADS
	help
	  Select 'y' here to enable POSIX mutex priority protection.

config POSIX_THREAD_PROCESS_SHARED
	bool "Support sharing synchronization objects between processes"
	help
	  This option allows sharing synchronization objects such as barriers, condition variables,
	  mutexes, and reader-writer locks between processes.

	  The history behind this option is quite interesting. It represents one of the
	  compromises made between traditional UNIX systems and newer POSIX systems. In UNIX,
	  concurrency was typically achieved via fork() and synchronization primitives were designed
	  to be shared between processes by default. In newer POSIX systems, concurrency was mostly
	  achieved via threads, synchronization primitives were just structures in memory, and
	  sharing them between processes would have proven very difficult without process-shared
	  memory. This is why the default sharing option is PTHREAD_PROCESS_PRIVATE.

module = PTHREAD
module-str = POSIX thread
source "subsys/logging/Kconfig.template.log_config"

module = PTHREAD_MUTEX
module-str = POSIX mutex
source "subsys/logging/Kconfig.template.log_config"

module = PTHREAD_COND
module-str = POSIX condition variable
source "subsys/logging/Kconfig.template.log_config"

module = PTHREAD_KEY
module-str = POSIX thread-specific data
source "subsys/logging/Kconfig.template.log_config"

endif # POSIX_THREADS
```

## lib/posix/options/timers/Kconfig
```kconfig
# Copyright (c) 2018 Intel Corporation
# Copyright (c) 2024 Tenstorrent AI ULC
#
# SPDX-License-Identifier: Apache-2.0

menuconfig POSIX_TIMERS
	bool "POSIX high-resolution timers"
	help
	  Select 'y' here and Zephyr will provide implementations of clock_getres(), clock_gettime(),
	  clock_settime(), nanosleep(), timer_create(), timer_delete(), timer_getoverrun(),
	  timer_settime(), and timer_gettime().

if POSIX_TIMERS

config POSIX_MONOTONIC_CLOCK
	bool "POSIX Monotonic clock support"
	default y
	help
	  This enables CLOCK_MONOTONIC and the _POSIX_MONOTONIC_CLOCK option.

	  May be enabled directly or via :kconfig:option:`CONFIG_XSI_ADVANCED_REALTIME`.

config POSIX_CPUTIME
	bool "POSIX per-process CPU-time clocks"
	default y
	help
	  This enables CLOCK_PROCESS_CPUTIME_ID and the _POSIX_CPUTIME option.

	  May be enabled directly or via :kconfig:option:`CONFIG_XSI_ADVANCED_REALTIME`.

config POSIX_THREAD_CPUTIME
	bool "POSIX per-thread CPU-time clocks"
	help
	  This enables CLOCK_THREAD_CPUTIME_ID and the _POSIX_THREAD_CPUTIME option.

	  May be enabled directly or via
	  :kconfig:option:`CONFIG_XSI_ADVANCED_REALTIME_THREADS`.

config POSIX_DELAYTIMER_MAX
	int "Maximum count returned my timer_getoverrun() in POSIX application"
	default 32
	help
	  This controls the maximum number of times a timer can overrun before
	  timer_getoverrun() in POSIX compliant application.

config POSIX_TIMER_MAX
	int "Maximum number of POSIX timers per process"
	default 32
	help
	  Maximum simultaneously active timer_t in a POSIX application.

config POSIX_TIMEOUTS
	bool "Support for some blocking POSIX services"
	help
	  This option enables support for absolute timeouts for some blocking POSIX services such as
	  mq_timedsend(), mq_timedreceive(), pthread_cond_timedwait(), pthread_mutex_timedlock(),
	  pthread_rwlock_timedrdlock(), pthread_rwlock_timedwrlock(), and sem_timedwait().

config TIMER_CREATE_WAIT
	int "Time to wait for timer availability (in msec) in POSIX application"
	default 100
	range 0 1000
	help
	  This controls how long to wait for resources to come available to create
	  a new timer in POSIX compliant application

module = TIMER
module-str = POSIX Timers
source "subsys/logging/Kconfig.template.log_config"

endif # POSIX_TIMERS
```
