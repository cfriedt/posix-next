## CMakeLists.txt
```
# SPDX-License-Identifier: Apache-2.0

cmake_minimum_required(VERSION 3.20.0)
find_package(Zephyr REQUIRED HINTS $ENV{ZEPHYR_BASE})
project(posix_shell_func)

FILE(GLOB app_sources src/*.c)
target_sources(app PRIVATE ${app_sources})
# what an application supplies beside the POSIX surface for the toybox image: the sample's layer
target_sources_ifdef(CONFIG_TOYBOX app PRIVATE
  ${CMAKE_CURRENT_SOURCE_DIR}/../../../samples/posix/toybox/src/compat.c
)

target_compile_options(app PRIVATE -U_POSIX_C_SOURCE -D_POSIX_C_SOURCE=200809L)
target_compile_options(app PRIVATE -U_XOPEN_SOURCE -D_XOPEN_SOURCE=700)

if(CONFIG_TOYBOX)
  # the toybox module builds toybox.llext; embed it for installation into ext2
  add_dependencies(app toybox_llext)
  generate_inc_file_for_target(app ${TOYBOX_LLEXT_FILE}
    ${ZEPHYR_BINARY_DIR}/include/generated/toybox.inc
  )
endif()
```

## prj.conf
```kconfig
CONFIG_ZTEST=y

CONFIG_POSIX_AEP_CHOICE_PSE52=y
CONFIG_POSIX_SHELL_FUNC=y
# the fixture follows symbolic links
CONFIG_POSIX_SYMBOLIC_LINKS=y
# XSI provides the S_IF* constants and the XSI struct stat members
CONFIG_XSI=y

CONFIG_ZVFS_DIR_MAX=4
CONFIG_MAIN_STACK_SIZE=16384
CONFIG_ZTEST_STACK_SIZE=16384
CONFIG_TEST_EXTRA_STACK_SIZE=4096
```

## toybox.conf
```kconfig
# the shell: toybox, exec'd from ext2 as a loadable extension, with the base
# image exporting what the toybox image imports (the sample's configuration)
CONFIG_TOYBOX=y
CONFIG_POSIX_AEP_CHOICE_PSE53=y
# PSE53 without the queues, shared memory and packet sockets toybox never uses
CONFIG_POSIX_MESSAGE_PASSING=n
CONFIG_POSIX_SHARED_MEMORY_OBJECTS=n
CONFIG_POSIX_RAW_SOCKETS=n
CONFIG_POSIX_JOB_CONTROL=y
CONFIG_POSIX_EXEC_LLEXT=y
CONFIG_POSIX_ADVISORY_INFO=y
CONFIG_POSIX_FIFO=y
CONFIG_POSIX_FIFO_FD=y
CONFIG_POSIX_DEVICE_SPECIFIC=y
CONFIG_POSIX_DEVICE_SPECIFIC_R=y
CONFIG_POSIX_FILE_SYSTEM_EXT=y
CONFIG_POSIX_FILE_SYSTEM_FD=y
CONFIG_POSIX_FILE_SYSTEM_GLOB=y
CONFIG_POSIX_FILE_ATTRIBUTES=y
CONFIG_POSIX_FILE_ATTRIBUTES_FD=y
CONFIG_POSIX_REGEXP=y
CONFIG_POSIX_SYMBOLIC_LINKS_FD=y
CONFIG_POSIX_SYSTEM_DATABASE=y
CONFIG_POSIX_USER_GROUPS=y
CONFIG_POSIX_USER_GROUPS_R=y
CONFIG_NETWORKING=y
CONFIG_NET_TEST=y
CONFIG_NET_DRIVERS=y
CONFIG_NET_LOOPBACK=y
CONFIG_NET_IPV4=y
CONFIG_NET_SOCKETS=y
CONFIG_NET_SOCKETS_INET_RAW=y
CONFIG_NET_PKT_RX_COUNT=8
CONFIG_NET_PKT_TX_COUNT=8
CONFIG_NET_BUF_RX_COUNT=16
CONFIG_NET_BUF_TX_COUNT=16
CONFIG_NET_TX_STACK_SIZE=8192
CONFIG_NET_RX_STACK_SIZE=8192
CONFIG_SYSTEM_WORKQUEUE_STACK_SIZE=4096
CONFIG_XSI_SINGLE_PROCESS=y
CONFIG_XSI_STREAMS=y
CONFIG_XSI_SYSTEM_LOGGING=y
CONFIG_LLEXT=y
CONFIG_POSIX_LLEXT_SYMBOLS=y
CONFIG_LLEXT_TYPE_ELF_RELOCATABLE=y
# every process loads its own copy of the 350 KiB command set: room for a
# shell and a six-stage pipeline
CONFIG_LLEXT_HEAP_SIZE=8192
CONFIG_FILE_SYSTEM=y
CONFIG_FILE_SYSTEM_EXT2=y
CONFIG_FILE_SYSTEM_MKFS=y
CONFIG_DISK_ACCESS=y
CONFIG_DISK_DRIVER_RAM=y
CONFIG_TEST_RANDOM_GENERATOR=y
CONFIG_SYS_PROCESS_MAX=8
CONFIG_SYS_THREAD_STACK_SIZE=8192
CONFIG_SYS_PROCESS_ARG_BYTES=1024
CONFIG_POSIX_EXEC_ARGS_MAX=32
CONFIG_HEAP_MEM_POOL_SIZE=524288
CONFIG_COMMON_LIBC_MALLOC_ARENA_SIZE=524288
CONFIG_ZVFS_OPEN_MAX=32
CONFIG_ZVFS_PROC_OPEN_MAX=16
CONFIG_ZVFS_PIPE_MAX=8
CONFIG_ZVFS_OPEN_ADD_SIZE_PIPE=16
```

## src/main.c
```c
/*
 * SPDX-FileCopyrightText: Copyright The Zephyr Project Contributors
 * SPDX-License-Identifier: Apache-2.0
 */

#include "shell_func_tests.h"

#include <errno.h>
#include <fcntl.h>
#include <stdlib.h>
#include <string.h>
#include <sys/stat.h>
#include <unistd.h>

#include <zephyr/kernel.h>

#ifndef CONFIG_NATIVE_LIBC
#include <zephyr/fs/fs.h>

static struct fs_mount_t fs_mnt = {
	.type = FS_EXT2,
	.mnt_point = "/",
	.storage_dev = (void *)"RAM",
};

static const uint8_t toybox_image[] __aligned(8) = {
#include "toybox.inc"
};

/* one fs block at a time: a single large fs_write() to ext2 corrupts the file's first blocks */
static void install(const char *path, const uint8_t *data, size_t len)
{
	struct fs_file_t f;

	fs_file_t_init(&f);
	zassert_ok(fs_open(&f, path, FS_O_CREATE | FS_O_WRITE));
	for (size_t off = 0; off < len; off += 1024) {
		zassert_true(fs_write(&f, data + off, MIN(1024, len - off)) > 0);
	}
	zassert_ok(fs_close(&f));
	/* a file created by the file system API has no execute permission */
	zassert_ok(fs_chmod(path, 0755));
}
#endif

static char out_buf[128];

const char *test_read_out(void)
{
	int fd = open(TEST_OUT, O_RDONLY);
	ssize_t len;

	zassert_true(fd >= 0, "open(" TEST_OUT ") failed: %d", errno);
	len = read(fd, out_buf, sizeof(out_buf) - 1);
	zassert_true(len >= 0);
	out_buf[len] = '\0';
	zassert_ok(close(fd));

	return out_buf;
}

static void before(void *arg)
{
	int fd;

	ARG_UNUSED(arg);

	(void)unlink(TEST_OUT);
	(void)unlink(TEST_GLOB "/a1");
	(void)unlink(TEST_GLOB "/a2");
	(void)unlink(TEST_GLOB "/b1");
	(void)rmdir(TEST_GLOB);
	(void)rmdir(TEST_ROOT);
	zassert_ok(mkdir(TEST_ROOT, 0777));
	zassert_ok(mkdir(TEST_GLOB, 0777));
	static const char *const names[] = {TEST_GLOB "/a1", TEST_GLOB "/a2", TEST_GLOB "/b1"};

	ARRAY_FOR_EACH(names, i) {
		fd = open(names[i], O_WRONLY | O_CREAT, 0600);
		zassert_true(fd >= 0);
		zassert_ok(close(fd));
	}
}

static void *setup(void)
{
#ifndef CONFIG_NATIVE_LIBC
	zassert_ok(fs_mkfs(FS_EXT2, (uintptr_t)"RAM", NULL, 0));
	zassert_ok(fs_mount(&fs_mnt));
	/* the usual install: the shell is a /bin symlink to the binary, which dispatches on
	 * argv[0]
	 */
	zassert_ok(fs_mkdir("/bin"));
	install("/bin/toybox", toybox_image, sizeof(toybox_image));
	zassert_ok(fs_symlink("toybox", "/bin/sh"));
#endif
	(void)mkdir(FS_TMPDIR, 0777);
	/* what an application that spawns shells provides: where the commands are */
	zassert_ok(setenv("PATH", "/bin", 0));

	return NULL;
}

static void teardown(void *arg)
{
	ARG_UNUSED(arg);

	(void)unlink(TEST_OUT);
	(void)unlink(TEST_GLOB "/a1");
	(void)unlink(TEST_GLOB "/a2");
	(void)unlink(TEST_GLOB "/b1");
	(void)rmdir(TEST_GLOB);
	(void)rmdir(TEST_ROOT);
#ifndef CONFIG_NATIVE_LIBC
	(void)fs_unmount(&fs_mnt);
#endif
}

ZTEST_SUITE(posix_shell_func, NULL, setup, before, NULL, teardown);
```

## src/popen.c
```c
/*
 * SPDX-FileCopyrightText: Copyright The Zephyr Project Contributors
 * SPDX-License-Identifier: Apache-2.0
 */

#include "shell_func_tests.h"

#include <errno.h>
#include <stdio.h>
#include <string.h>
#include <sys/wait.h>

ZTEST(posix_shell_func, test_popen)
{
	char line[64];
	FILE *f;

	/* the command's output is the stream */
	f = popen("echo popen works; echo second line", "r");
	zassert_not_null(f, "popen failed: %d", errno);
	zassert_not_null(fgets(line, sizeof(line), f));
	zassert_str_equal(line, "popen works\n");
	zassert_not_null(fgets(line, sizeof(line), f));
	zassert_str_equal(line, "second line\n");
	zassert_is_null(fgets(line, sizeof(line), f));
	zassert_equal(pclose(f), 0);

	/* the stream is the command's input */
	f = popen("cat > " TEST_OUT, "w");
	zassert_not_null(f, "popen failed: %d", errno);
	zassert_true(fputs("written through popen\n", f) >= 0);
	zassert_equal(pclose(f), 0);
	zassert_str_equal(test_read_out(), "written through popen\n");

	errno = 0;
	zassert_is_null(popen("echo", "x"));
	zassert_equal(errno, EINVAL);
}

ZTEST(posix_shell_func, test_pclose)
{
	int status;
	FILE *f;

	/* the command's exit status comes back as a wait status */
	f = popen("exit 5", "r");
	zassert_not_null(f, "popen failed: %d", errno);
	status = pclose(f);
	zassert_true(WIFEXITED(status));
	zassert_equal(WEXITSTATUS(status), 5);

	/* a stream popen() did not open (the host leaves this undefined) */
	IF_NOT_NATIVE_LIBC({
		f = fopen(TEST_GLOB "/a1", "r");
		zassert_not_null(f);
		errno = 0;
		zassert_equal(pclose(f), -1);
		zassert_equal(errno, EBADF);
		zassert_ok(fclose(f));
	});
}
```

## src/shell_func_tests.h
```c
/*
 * SPDX-FileCopyrightText: Copyright The Zephyr Project Contributors
 * SPDX-License-Identifier: Apache-2.0
 */

#ifndef POSIX_TESTS_SHELL_FUNC_TESTS_H_
#define POSIX_TESTS_SHELL_FUNC_TESTS_H_

#include <zephyr/ztest.h>

#include "../../shared/linux_compat_test.h"

/*
 * /tmp exists in both worlds (the ext2 RAM disk under Zephyr, the host
 * filesystem under CONFIG_NATIVE_LIBC); the shell is toybox's at /bin/sh
 * under Zephyr and the host's on the host.
 */
#define FS_TMPDIR "/tmp"
#define TEST_ROOT FS_TMPDIR "/pshell"
#define TEST_OUT  TEST_ROOT "/out.txt"
#define TEST_GLOB TEST_ROOT "/glob"

/* the bytes TEST_OUT holds */
const char *test_read_out(void);

#endif /* POSIX_TESTS_SHELL_FUNC_TESTS_H_ */
```

## src/system.c
```c
/*
 * SPDX-FileCopyrightText: Copyright The Zephyr Project Contributors
 * SPDX-License-Identifier: Apache-2.0
 */

#include "shell_func_tests.h"

#include <errno.h>
#include <stdio.h>
#include <stdlib.h>
#include <sys/wait.h>
#include <unistd.h>

#include <zephyr/fs/fs.h>

#ifndef CONFIG_NATIVE_LIBC
/* without an interpreter at /bin/sh: no shell, status 127, popen() fails */
static void system_no_shell(void)
{
	int status;

	zassert_ok(unlink("/bin/sh"));

	zassert_equal(system(NULL), 0);
	status = system("exit 0");
	zassert_true(WIFEXITED(status));
	zassert_equal(WEXITSTATUS(status), 127);
	errno = 0;
	zassert_is_null(popen("exit 0", "r"));
	zassert_equal(errno, ENOENT);

	zassert_ok(fs_symlink("toybox", "/bin/sh"));
}
#endif

ZTEST(posix_shell_func, test_system)
{
	int status;

#ifndef CONFIG_NATIVE_LIBC
	system_no_shell();
#endif

	/* a shell is available */
	zassert_true(system(NULL) != 0);

	status = system("exit 0");
	zassert_true(WIFEXITED(status));
	zassert_equal(WEXITSTATUS(status), 0);

	status = system("exit 3");
	zassert_true(WIFEXITED(status));
	zassert_equal(WEXITSTATUS(status), 3);

	/* the command runs in the shell, with its redirections */
	status = system("echo hello from system > " TEST_OUT);
	zassert_equal(WEXITSTATUS(status), 0);
	zassert_str_equal(test_read_out(), "hello from system\n");

	/* a command the shell cannot find: its exit status, not a failure to run the shell */
	status = system("no_such_command_here");
	zassert_true(WIFEXITED(status));
	zassert_true(WEXITSTATUS(status) != 0);
}
```

## src/wordexp.c
```c
/*
 * SPDX-FileCopyrightText: Copyright The Zephyr Project Contributors
 * SPDX-License-Identifier: Apache-2.0
 */

#include "shell_func_tests.h"

#include <stdlib.h>
#include <string.h>
#include <wordexp.h>

static void expect_words(const wordexp_t *we, const char *const *words, size_t n, size_t offs)
{
	zassert_equal(we->we_wordc, n, "we_wordc: %zu, want %zu", we->we_wordc, n);
	for (size_t i = 0; i < offs; i++) {
		zassert_is_null(we->we_wordv[i]);
	}
	for (size_t i = 0; i < n; i++) {
		zassert_str_equal(we->we_wordv[offs + i], words[i], "[%zu]: %s, want %s", i,
				  we->we_wordv[offs + i], words[i]);
	}
	zassert_is_null(we->we_wordv[offs + n]);
}

#define EXPECT_WORDS(we, ...)                                                                      \
	do {                                                                                       \
		const char *const words_[] = {__VA_ARGS__};                                        \
		expect_words((we), words_, ARRAY_SIZE(words_), 0);                                 \
	} while (0)

ZTEST(posix_shell_func, test_wordexp)
{
	static const char *const two[] = {"x", "y"};
	wordexp_t we;

	/* field splitting and quoting */
	zassert_equal(wordexp("a b  c", &we, 0), 0);
	EXPECT_WORDS(&we, "a", "b", "c");
	wordfree(&we);

	zassert_equal(wordexp("'a b' c", &we, 0), 0);
	EXPECT_WORDS(&we, "a b", "c");
	wordfree(&we);

	zassert_equal(wordexp("", &we, 0), 0);
	zassert_equal(we.we_wordc, 0);
	wordfree(&we);

	/* variables come from the caller's environment */
	zassert_ok(setenv("WE_VAR", "x y", 1));
	zassert_equal(wordexp("$WE_VAR", &we, 0), 0);
	EXPECT_WORDS(&we, "x", "y");
	wordfree(&we);
	zassert_equal(wordexp("\"$WE_VAR\" ${WE_VAR}z", &we, 0), 0);
	EXPECT_WORDS(&we, "x y", "x", "yz");
	wordfree(&we);
	zassert_ok(unsetenv("WE_VAR"));

	/* pathname expansion, sorted */
	zassert_equal(wordexp(TEST_GLOB "/a*", &we, 0), 0);
	EXPECT_WORDS(&we, TEST_GLOB "/a1", TEST_GLOB "/a2");
	wordfree(&we);

	/* command substitution, refused before the shell runs */
	zassert_equal(wordexp("$(echo x)", &we, WRDE_NOCMD), WRDE_CMDSUB);
	zassert_equal(wordexp("`echo x`", &we, WRDE_NOCMD), WRDE_CMDSUB);
	zassert_equal(wordexp("'$(not run)'", &we, WRDE_NOCMD), 0);
	EXPECT_WORDS(&we, "$(not run)");
	wordfree(&we);

	/* reserved slots, then more words */
	memset(&we, 0, sizeof(we));
	we.we_offs = 2;
	zassert_equal(wordexp("x y", &we, WRDE_DOOFFS), 0);
	expect_words(&we, two, 2, 2);
	zassert_equal(wordexp("z", &we, WRDE_DOOFFS | WRDE_APPEND), 0);
	zassert_equal(we.we_wordc, 3);
	zassert_str_equal(we.we_wordv[4], "z");
	zassert_is_null(we.we_wordv[5]);
	wordfree(&we);

	/* the shell refuses what it cannot parse, and an unset variable under WRDE_UNDEF */
	zassert_equal(wordexp("a 'b", &we, 0), WRDE_SYNTAX);
	zassert_true(wordexp("$WE_UNSET_VARIABLE", &we, WRDE_UNDEF) != 0);
	zassert_equal(wordexp("$WE_UNSET_VARIABLE", &we, 0), 0);
	zassert_equal(we.we_wordc, 0);
	wordfree(&we);

	/* a flag nobody defined (the host takes it) */
	IF_NOT_NATIVE_LIBC({
		zassert_equal(wordexp("a", &we, 0x1000), WRDE_BADVAL);
	});
}

ZTEST(posix_shell_func, test_wordfree)
{
	wordexp_t we;

	/* nothing to free */
	memset(&we, 0, sizeof(we));
	wordfree(&we);

	zassert_equal(wordexp("a b", &we, 0), 0);
	zassert_equal(we.we_wordc, 2);
	wordfree(&we);
	zassert_is_null(we.we_wordv);
	/* already freed */
	wordfree(&we);

	/* reserved slots are released with the words */
	memset(&we, 0, sizeof(we));
	we.we_offs = 3;
	zassert_equal(wordexp("a b", &we, WRDE_DOOFFS), 0);
	wordfree(&we);
	zassert_is_null(we.we_wordv);
}
```
