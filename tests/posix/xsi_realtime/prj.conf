## CMakeLists.txt
```
# SPDX-License-Identifier: Apache-2.0

cmake_minimum_required(VERSION 3.20.0)
find_package(Zephyr REQUIRED HINTS $ENV{ZEPHYR_BASE})
project(posix_xsi_realtime)

FILE(GLOB app_sources src/*.c)

target_sources(app PRIVATE ${app_sources})

# the process-shared section spawns a prelinked child image
target_include_directories(app PRIVATE ${CMAKE_CURRENT_SOURCE_DIR}/../../../lib/posix/shared)
zephyr_linker_sources(ROM_SECTIONS iterables.ld)

target_compile_options(app PRIVATE -U_POSIX_C_SOURCE -D_POSIX_C_SOURCE=200809L)
target_compile_options(app PRIVATE -U_XOPEN_SOURCE -D_XOPEN_SOURCE=700)
```

## Kconfig
```
# Copyright (c) 2026, Friedt Professional Engineering Services, Inc
# SPDX-License-Identifier: Apache-2.0

rsource "../Kconfig.test_common"
source "Kconfig.zephyr"
```

## prj.conf
```kconfig
CONFIG_ZTEST=y

CONFIG_POSIX_AEP_CHOICE_PSE52=y
CONFIG_XSI_REALTIME=y
CONFIG_FILE_SYSTEM=y
CONFIG_POSIX_FILE_SYSTEM=y

CONFIG_FAT_FILESYSTEM_ELM=y
CONFIG_MAIN_STACK_SIZE=4096
CONFIG_ZTEST_STACK_SIZE=2048

CONFIG_ZVFS_OPEN_IGNORE_MIN=y
CONFIG_ZVFS_OPEN_MAX=5

CONFIG_SYS_THREAD_STACK_MIN_ADD_TEST=2
CONFIG_SYS_THREAD_THREAD_MIN_ADD_TEST=2
```

## src/main.c
```c
/*
 * Copyright (c) 2025 Marvin Ouma <pancakesdeath@protonmail.com>
 *
 * SPDX-License-Identifier: Apache-2.0
 */

#include <pthread.h>
#include <sched.h>
#include <time.h>

#include <zephyr/ztest.h>

#include "../../shared/linux_compat_test.h"

/*
 * Zephyr's process-addressed scheduling functions are ENOSYS stubs. The host
 * libc implements them: a query succeeds, and a non-zero priority is invalid
 * for the SCHED_OTHER process the test runs as.
 */
#define NATIVE (IS_ENABLED(CONFIG_NATIVE_LIBC))

ZTEST_USER(xsi_realtime, test_sched_getparam)
{
	struct sched_param param;
	int rc = sched_getparam(0, &param);
	int err = errno;

	if (NATIVE) {
		zassert_ok(rc, "sched_getparam() failed: %d", err);
	} else {
		zassert_true((rc == -1 && err == ENOSYS));
	}
}

ZTEST_USER(xsi_realtime, test_sched_getscheduler)
{
	int rc = sched_getscheduler(0);
	int err = errno;

	if (NATIVE) {
		zassert_true(rc >= 0, "sched_getscheduler() failed: %d", err);
	} else {
		zassert_true((rc == -1 && err == ENOSYS));
	}
}
ZTEST_USER(xsi_realtime, test_sched_setparam)
{
	struct sched_param param = {
		.sched_priority = 2,
	};
	int rc = sched_setparam(0, &param);
	int err = errno;

	zassert_true((rc == -1 && err == (NATIVE ? EINVAL : ENOSYS)), "rc %d errno %d", rc, err);
}

ZTEST_USER(xsi_realtime, test_sched_setscheduler)
{
	struct sched_param param = {
		.sched_priority = 2,
	};
	int policy = 0;
	int rc = sched_setscheduler(0, policy, &param);
	int err = errno;

	zassert_true((rc == -1 && err == (NATIVE ? EINVAL : ENOSYS)), "rc %d errno %d", rc, err);
}

ZTEST_USER(xsi_realtime, test_sched_rr_get_interval)
{
	struct timespec interval = {
		.tv_sec = 0,
		.tv_nsec = 0,
	};
	int rc = sched_rr_get_interval(0, &interval);
	int err = errno;

	if (NATIVE) {
		zassert_ok(rc, "sched_rr_get_interval() failed: %d", err);
	} else {
		zassert_true((rc == -1 && err == ENOSYS));
	}
}

static void teardown(void *arg)
{
	ARG_UNUSED(arg);

	if (IS_ENABLED(CONFIG_COVERAGE)) {
		/* leave the output a few seconds to drain before the coverage dump */
		const struct timespec ts = {.tv_sec = 5};

		(void)nanosleep(&ts, NULL);
	}
}

ZTEST_SUITE(xsi_realtime, NULL, NULL, NULL, NULL, teardown);
```

## src/image_registry.c
```c
/*
 * SPDX-FileCopyrightText: Copyright The Zephyr Project Contributors
 * SPDX-License-Identifier: Apache-2.0
 */

#include <string.h>

#include "image_registry.h"

#ifdef CONFIG_POSIX_SPAWN
const struct posix_spawn_image *posix_spawn_image_lookup(const char *path)
{
	STRUCT_SECTION_FOREACH(image_registry_entry, entry) {
		if (strcmp(entry->path, path) == 0) {
			return &entry->image;
		}
	}

	return NULL;
}
#endif /* CONFIG_POSIX_SPAWN */
```

## src/image_registry.h
```c
/*
 * SPDX-FileCopyrightText: Copyright The Zephyr Project Contributors
 * SPDX-License-Identifier: Apache-2.0
 */
#ifndef TESTS_POSIX_XSI_REALTIME_IMAGE_REGISTRY_H_
#define TESTS_POSIX_XSI_REALTIME_IMAGE_REGISTRY_H_

#include <zephyr/kernel.h>

#include "posix_image.h"

/* spawn paths name prelinked images: the child of the process-shared section */
struct image_registry_entry {
	const char *path;
	struct posix_spawn_image image;
};

#define IMAGE_REGISTRY_ENTRY_DEFINE(name, _path, _entry)                                           \
	static const STRUCT_SECTION_ITERABLE(image_registry_entry, name) = {                       \
		.path = (_path),                                                                   \
		.image = {.entry = (_entry)},                                                      \
	}

#endif /* TESTS_POSIX_XSI_REALTIME_IMAGE_REGISTRY_H_ */
```

## src/memlock.c
```c
/*
 * SPDX-FileCopyrightText: Copyright The Zephyr Project Contributors
 * SPDX-License-Identifier: Apache-2.0
 */

#include <errno.h>
#include <stdint.h>
#include <sys/mman.h>
#include <unistd.h>

#include <zephyr/kernel.h>
#include <zephyr/sys/util.h>
#include <zephyr/ztest.h>

#include "../../shared/linux_compat_test.h"

/* without demand paging every page is resident already: locking succeeds without effect */
static void expect_memlock(int ret)
{
	zassert_ok(ret, "errno %d", errno);
}

/* the host locks a whole process against RLIMIT_MEMLOCK: it may decline */
static void expect_memlock_all(int ret)
{
	if (IS_ENABLED(CONFIG_NATIVE_LIBC) && (ret != 0)) {
		zassert_true((errno == ENOMEM) || (errno == EPERM), "errno %d", errno);
		return;
	}
	expect_memlock(ret);
}

/* ASAN replaces the host memlock calls with no-ops that succeed */
static bool memlock_is_intercepted(void)
{
	return IS_ENABLED(CONFIG_ASAN) && IS_ENABLED(CONFIG_NATIVE_LIBC);
}

/* kernel memory: user threads cannot read it */
static int page_out_of_reach;

static void *map_page(size_t *page)
{
	long ps = sysconf(_SC_PAGESIZE);
	void *p;

	zassert_true(ps > 0);
	*page = (size_t)ps;
	p = mmap(NULL, *page, PROT_READ | PROT_WRITE, MAP_PRIVATE | MAP_ANONYMOUS, -1, 0);
	zassert_not_equal(p, MAP_FAILED, "mmap() failed: %d", errno);

	return p;
}

ZTEST_USER(xsi_realtime, test_mlock)
{
	uint8_t *p;
	size_t page;

	if (!memlock_is_intercepted()) {
		/* a wrapping range: Linux reports it as memory it does not have */
		errno = 0;
		zassert_equal(mlock((void *)UINTPTR_MAX, 2), -1);
		zassert_equal(errno, IS_ENABLED(CONFIG_NATIVE_LIBC) ? ENOMEM : EINVAL);
	}
	if (k_is_user_context()) {
		/* memory the caller cannot read is not its to lock */
		zassert_equal(mlock(&page_out_of_reach, sizeof(page_out_of_reach)), -1);
		zassert_equal(errno, ENOMEM);
	}

	p = map_page(&page);
	p[0] = 1;
	expect_memlock(mlock(p, 0));
	expect_memlock(mlock(p, page));
	zassert_equal(p[0], 1);
	expect_memlock(munlock(p, page));
	zassert_ok(munmap(p, page));
}

ZTEST_USER(xsi_realtime, test_munlock)
{
	uint8_t *p;
	size_t page;

	if (!memlock_is_intercepted()) {
		errno = 0;
		zassert_equal(munlock((void *)UINTPTR_MAX, 2), -1);
		zassert_equal(errno, IS_ENABLED(CONFIG_NATIVE_LIBC) ? ENOMEM : EINVAL);
	}

	/* unlocking what was never locked is not an error */
	p = map_page(&page);
	p[0] = 2;
	expect_memlock(munlock(p, 0));
	expect_memlock(munlock(p, page));
	zassert_equal(p[0], 2);
	zassert_ok(munmap(p, page));
}

ZTEST_USER(xsi_realtime, test_mlockall)
{
	uint8_t *p;
	size_t page;

	if (!memlock_is_intercepted()) {
		errno = 0;
		zassert_equal(mlockall(0), -1);
		zassert_equal(errno, EINVAL);
		zassert_equal(mlockall(~(MCL_CURRENT | MCL_FUTURE)), -1);
		zassert_equal(errno, EINVAL);
	}

	expect_memlock_all(mlockall(MCL_CURRENT));
	/* mappings created from now on are locked */
	expect_memlock_all(mlockall(MCL_FUTURE));
	p = map_page(&page);
	p[0] = 3;
	zassert_equal(p[0], 3);
	expect_memlock_all(munlockall());
	zassert_ok(munmap(p, page));
}

ZTEST_USER(xsi_realtime, test_munlockall)
{
	expect_memlock_all(munlockall());
	expect_memlock_all(mlockall(MCL_CURRENT | MCL_FUTURE));
	expect_memlock_all(munlockall());
}
```

## src/mqueue.c
```c
/*
 * Copyright (c) 2018 Intel Corporation
 * Copyright (c) 2024 BayLibre, SAS
 *
 * SPDX-License-Identifier: Apache-2.0
 */

#include <fcntl.h>
#include <mqueue.h>
#include <pthread.h>
#include <unistd.h>

#include <zephyr/sys/util.h>
#include <zephyr/ztest.h>

#define N_THR            2
#define MESSAGE_SIZE     16
#define MESG_COUNT_PERMQ 4

static char queue[16] = "server";

static char send_data[MESSAGE_SIZE] = "timed data send";

/*
 * For platforms that select CONFIG_KERNEL_COHERENCE, the receive buffer can
 * not be on the stack as the k_msgq that underlies the mq_timedsend() will
 * copy directly to the receiver's buffer when there is already a waiting
 * receiver.
 */

static char rec_data[MESSAGE_SIZE];

static void *sender_thread(void *p1)
{
	mqd_t mqd;
	struct timespec curtime;

	mqd = mq_open(queue, O_WRONLY);
	zassert_ok(clock_gettime(CLOCK_REALTIME, &curtime));
	curtime.tv_sec += 1;
	zassert_false(mq_timedsend(mqd, send_data, MESSAGE_SIZE, 0, &curtime),
		      "Not able to send message in timer");
	usleep(USEC_PER_MSEC);
	zassert_false(mq_close(mqd), "unable to close message queue descriptor.");
	pthread_exit(p1);
	return NULL;
}

static void *receiver_thread(void *p1)
{
	mqd_t mqd;
	struct timespec curtime;

	mqd = mq_open(queue, O_RDONLY);
	zassert_ok(clock_gettime(CLOCK_REALTIME, &curtime));
	curtime.tv_sec += 1;
	mq_timedreceive(mqd, rec_data, MESSAGE_SIZE, 0, &curtime);
	zassert_false(strcmp(rec_data, send_data), "Error in data reception. exp: %s act: %s",
		      send_data, rec_data);
	usleep(USEC_PER_MSEC);
	zassert_false(mq_close(mqd), "unable to close message queue descriptor.");
	pthread_exit(p1);
	return NULL;
}

ZTEST(xsi_realtime, test_mqueue)
{
	mqd_t mqd;
	struct mq_attr attrs;
	int32_t mode = 0777;
	int flags = O_RDWR | O_CREAT;
	void *retval;
	pthread_t newthread[N_THR];

	attrs.mq_msgsize = MESSAGE_SIZE;
	attrs.mq_maxmsg = MESG_COUNT_PERMQ;

	mqd = mq_open(queue, flags, mode, &attrs);

	for (int i = 0; i < N_THR; i++) {
		/* Creating threads */
		zassert_ok(pthread_create(&newthread[i], NULL,
					  (i % 2 == 0) ? receiver_thread : sender_thread, NULL));
	}

	usleep(USEC_PER_MSEC * 10U);

	for (int i = 0; i < N_THR; i++) {
		pthread_join(newthread[i], &retval);
	}

	zassert_false(mq_close(mqd), "unable to close message queue descriptor.");
	zassert_false(mq_unlink(queue), "Not able to unlink Queue");
}

static bool notification_executed;

void notify_function_basic(union sigval val)
{
	mqd_t mqd;
	bool *executed = (bool *)val.sival_ptr;

	mqd = mq_open(queue, O_RDONLY);

	mq_receive(mqd, rec_data, MESSAGE_SIZE, 0);
	zassert_ok(strcmp(rec_data, send_data), "Error in data reception. exp: %s act: %s",
		   send_data, rec_data);

	zassert_ok(mq_close(mqd), "Unable to close message queue descriptor.");

	*executed = true;
}

static void notify_flag_fn(union sigval val)
{
	*(volatile bool *)val.sival_ptr = true;
}

static void mq_notify_sigev_none_consumed(void)
{
	mqd_t mqd;
	struct mq_attr attrs = {
		.mq_msgsize = MESSAGE_SIZE,
		.mq_maxmsg = MESG_COUNT_PERMQ,
	};
	struct sigevent not = {
		.sigev_notify = SIGEV_NONE,
		.sigev_value.sival_ptr = (void *)&notification_executed,
		.sigev_notify_function = notify_function_basic,
	};
	int32_t mode = 0777;
	int flags = O_RDWR | O_CREAT;

	notification_executed = false;
	memset(rec_data, 0, MESSAGE_SIZE);

	mqd = mq_open(queue, flags, mode, &attrs);

	zassert_ok(mq_notify(mqd, &not), "Unable to set notification.");

	zassert_ok(mq_send(mqd, send_data, MESSAGE_SIZE, 0), "Unable to send message");

	/* SIGEV_NONE: no notification function runs, ever */
	zassert_false(notification_executed, "SIGEV_NONE must not invoke any function");

	/* the registration was consumed by the empty -> non-empty transition */
	zassert_ok(mq_notify(mqd, &not), "registration was not consumed when it fired");
	zassert_ok(mq_notify(mqd, NULL), "Unable to remove notification.");

	mq_receive(mqd, rec_data, MESSAGE_SIZE, 0);
	zassert_ok(mq_close(mqd), "Unable to close message queue descriptor.");
	zassert_ok(mq_unlink(queue), "Unable to unlink queue");
}

void notify_function_thread(union sigval val)
{
	mqd_t mqd;
	pthread_t sender = (pthread_t)val.sival_int;

	zassert_not_equal(sender, pthread_self(),
			  "Notification function should be executed from different thread.");

	mqd = mq_open(queue, O_RDONLY);

	mq_receive(mqd, rec_data, MESSAGE_SIZE, 0);
	zassert_ok(strcmp(rec_data, send_data), "Error in data reception. exp: %s act: %s",
		   send_data, rec_data);

	zassert_ok(mq_close(mqd), "Unable to close message queue descriptor.");

	notification_executed = true;
}

static void mq_notify_sigev_thread(void)
{
	mqd_t mqd;
	struct mq_attr attrs = {
		.mq_msgsize = MESSAGE_SIZE,
		.mq_maxmsg = MESG_COUNT_PERMQ,
	};
	struct sigevent not = {
		.sigev_notify = SIGEV_THREAD,
		.sigev_value.sival_int = (int)pthread_self(),
		.sigev_notify_function = notify_function_thread,
	};
	int32_t mode = 0777;
	int flags = O_RDWR | O_CREAT;

	notification_executed = false;
	memset(rec_data, 0, MESSAGE_SIZE);

	mqd = mq_open(queue, flags, mode, &attrs);

	zassert_ok(mq_notify(mqd, &not), "Unable to set notification.");

	zassert_ok(mq_send(mqd, send_data, MESSAGE_SIZE, 0), "Unable to send message");

	usleep(USEC_PER_MSEC * 100U);

	zassert_true(notification_executed, "Notification not triggered.");

	zassert_ok(mq_close(mqd), "Unable to close message queue descriptor.");
	zassert_ok(mq_unlink(queue), "Unable to unlink queue");
}

static void mq_notify_non_empty_queue(void)
{
	mqd_t mqd;
	struct mq_attr attrs = {
		.mq_msgsize = MESSAGE_SIZE,
		.mq_maxmsg = MESG_COUNT_PERMQ,
	};
	struct sigevent not = {
		.sigev_notify = SIGEV_THREAD,
		.sigev_value.sival_ptr = (void *)&notification_executed,
		.sigev_notify_function = notify_flag_fn,
	};
	int32_t mode = 0777;
	int flags = O_RDWR | O_CREAT;

	notification_executed = false;
	memset(rec_data, 0, MESSAGE_SIZE);

	mqd = mq_open(queue, flags, mode, &attrs);

	zassert_ok(mq_send(mqd, send_data, MESSAGE_SIZE, 0), "Unable to send message");

	zassert_ok(mq_notify(mqd, &not), "Unable to set notification.");

	/* sends to an already non-empty queue do not fire the notification */
	zassert_ok(mq_send(mqd, send_data, MESSAGE_SIZE, 0), "Unable to send message");
	usleep(USEC_PER_MSEC * 100U);
	zassert_false(notification_executed, "Notification shouldn't be processed.");

	mq_receive(mqd, rec_data, MESSAGE_SIZE, 0);
	zassert_false(strcmp(rec_data, send_data), "Error in data reception. exp: %s act: %s",
		      send_data, rec_data);
	mq_receive(mqd, rec_data, MESSAGE_SIZE, 0);

	memset(rec_data, 0, MESSAGE_SIZE);

	/* the empty -> non-empty transition fires it */
	zassert_ok(mq_send(mqd, send_data, MESSAGE_SIZE, 0), "Unable to send message");
	usleep(USEC_PER_MSEC * 100U);
	zassert_true(notification_executed, "Notification not triggered.");
	mq_receive(mqd, rec_data, MESSAGE_SIZE, 0);

	zassert_ok(mq_close(mqd), "Unable to close message queue descriptor.");
	zassert_ok(mq_unlink(queue), "Unable to unlink queue");
}

static void mq_notify_errors(void)
{
	mqd_t mqd;
	struct mq_attr attrs = {
		.mq_msgsize = MESSAGE_SIZE,
		.mq_maxmsg = MESG_COUNT_PERMQ,
	};
	struct sigevent not = {
		.sigev_notify = SIGEV_SIGNAL,
		.sigev_value.sival_ptr = (void *)&notification_executed,
		.sigev_notify_function = notify_function_basic,
	};
	int32_t mode = 0777;
	int flags = O_RDWR | O_CREAT;

	zassert_not_ok(mq_notify(NULL, NULL), "Should return -1 and set errno to EBADF.");
	zassert_equal(errno, EBADF);

	mqd = mq_open(queue, flags, mode, &attrs);

	zassert_not_ok(mq_notify(mqd, NULL), "Should return -1 and set errno to EINVAL.");
	zassert_equal(errno, EINVAL);

	/* SIGEV_SIGNAL is supported; a second registration while armed is EBUSY */
	not.sigev_signo = SIGUSR1;
	zassert_ok(mq_notify(mqd, &not), "SIGEV_SIGNAL registration failed");
	zassert_not_ok(mq_notify(mqd, &not), "second registration should be EBUSY");
	zassert_equal(errno, EBUSY);
	zassert_ok(mq_notify(mqd, NULL), "Unable to remove notification.");

	/* an unknown notification type is EINVAL */
	not.sigev_notify = 4242;
	zassert_not_ok(mq_notify(mqd, &not), "invalid sigev_notify should fail");
	zassert_equal(errno, EINVAL);

	not.sigev_notify = SIGEV_NONE;

	zassert_ok(mq_notify(mqd, &not),
		   "Unexpected error while asigning notification to the queue.");

	zassert_not_ok(mq_notify(mqd, &not),
		       "Can't assign notification when there is another assigned.");
	zassert_equal(errno, EBUSY);

	zassert_ok(mq_notify(mqd, NULL), "Unable to remove notification from the message queue.");

	zassert_ok(mq_close(mqd), "Unable to close message queue descriptor.");
	zassert_ok(mq_unlink(queue), "Unable to unlink queue");
}

ZTEST(xsi_realtime, test_mq_notify)
{
	mq_notify_errors();
	mq_notify_sigev_none_consumed();
	mq_notify_sigev_thread();
	mq_notify_non_empty_queue();
}

ZTEST(xsi_realtime, test_mqueue_open_and_unlink_multiple)
{
	const char *q1 = "q1";
	const char *q2 = "q2";

	mqd_t mqd1, mqd2;
	struct mq_attr attrs = {
		.mq_msgsize = MESSAGE_SIZE,
		.mq_maxmsg = MESG_COUNT_PERMQ,
	};

	int32_t mode = 0600;
	int flags = O_RDWR | O_CREAT;

	mqd1 = mq_open(q1, flags, mode, &attrs);

	zassert_ok(mq_unlink(q1), "Unable to unlink q1");

	mqd2 = mq_open(q2, flags, mode, &attrs);

	zassert_ok(mq_unlink(q2), "Unable to unlink q2");

	zassert_ok(mq_close(mqd1), "Unable to close message queue 1 descriptor.");
	zassert_ok(mq_close(mqd2), "Unable to close message queue 2 descriptor.");
}
```

## src/msync.c
```c
/*
 * SPDX-FileCopyrightText: Copyright The Zephyr Project Contributors
 * SPDX-License-Identifier: Apache-2.0
 */

#include <errno.h>
#include <fcntl.h>
#include <ff.h>
#include <sys/mman.h>
#include <unistd.h>

#include <zephyr/fs/fs.h>
#include <zephyr/ztest.h>

#include "../../shared/linux_compat_test.h"

#define FATFS_MNTP "/RAM:"
/* the host libc opens host paths: no volume to mount, a temporary file instead */
#define MSYNC_FILE                                                                                 \
	COND_CODE_1(CONFIG_NATIVE_LIBC, ("/tmp/posix_xsi_realtime_msync.bin"),                     \
		    (FATFS_MNTP "/msync.bin"))

/* the file holds this many pages */
#define MSYNC_FILE_PAGES 2

static FATFS msync_fat_fs;

static struct fs_mount_t msync_mnt = {
	.type = FS_FATFS,
	.mnt_point = FATFS_MNTP,
	.fs_data = &msync_fat_fs,
};

static size_t page;

/* the byte the fixture writes at file offset i */
static inline uint8_t file_byte(size_t i)
{
	return (uint8_t)(i * 7 + (i >> 8));
}

static int msync_setup(void)
{
	uint8_t buf[64];
	long ps;
	int fd;

	ps = sysconf(_SC_PAGESIZE);
	zassert_true(ps > 0);
	page = (size_t)ps;

	if (!IS_ENABLED(CONFIG_NATIVE_LIBC)) {
		zassert_ok(fs_mount(&msync_mnt));
	}

	fd = open(MSYNC_FILE, O_RDWR | O_CREAT | O_TRUNC, 0600);
	zassert_true(fd >= 0, "open(%s) failed: %d", MSYNC_FILE, errno);
	for (size_t pos = 0; pos < MSYNC_FILE_PAGES * page; pos += sizeof(buf)) {
		for (size_t i = 0; i < sizeof(buf); ++i) {
			buf[i] = file_byte(pos + i);
		}
		zassert_equal(write(fd, buf, sizeof(buf)), (ssize_t)sizeof(buf));
	}

	return fd;
}

static void msync_teardown(int fd)
{
	zassert_ok(close(fd));
	zassert_ok(unlink(MSYNC_FILE));
	if (!IS_ENABLED(CONFIG_NATIVE_LIBC)) {
		zassert_ok(fs_unmount(&msync_mnt));
	}
}

static void msync_invalid(void)
{
	uint8_t *p;

	p = mmap(NULL, page, PROT_READ | PROT_WRITE, MAP_PRIVATE | MAP_ANONYMOUS, -1, 0);
	zassert_not_equal(p, MAP_FAILED, "mmap() failed: %d", errno);

	errno = 0;
	zassert_equal(msync(p, page, 0x80), -1);
	zassert_equal(errno, EINVAL);

	errno = 0;
	zassert_equal(msync(p, page, MS_SYNC | MS_ASYNC), -1);
	zassert_equal(errno, EINVAL);

	errno = 0;
	zassert_equal(msync(p + 1, page, MS_SYNC), -1);
	zassert_equal(errno, EINVAL);

	/* an empty range is fine, an unmapped one is not */
	zassert_ok(msync(p, 0, MS_SYNC));
	zassert_ok(munmap(p, page));
	errno = 0;
	zassert_equal(msync(p, page, MS_SYNC), -1);
	zassert_equal(errno, ENOMEM);
}

static void msync_writeback(int fd, int flags)
{
	uint8_t *p;
	uint8_t b;

	p = mmap(NULL, 2 * page, PROT_READ | PROT_WRITE, MAP_SHARED, fd, 0);
	zassert_not_equal(p, MAP_FAILED, "mmap() failed: %d", errno);

	p[page + 7] = (uint8_t)~file_byte(page + 7);
	zassert_ok(msync(p + page, page, flags));
	zassert_equal(pread(fd, &b, 1, page + 7), 1);
	zassert_equal(b, (uint8_t)~file_byte(page + 7));

	p[page + 7] = file_byte(page + 7);
	zassert_ok(msync(p, 2 * page, flags));
	zassert_equal(pread(fd, &b, 1, page + 7), 1);
	zassert_equal(b, file_byte(page + 7));

	zassert_ok(munmap(p, 2 * page));
}

static void msync_invalidate(int fd)
{
	uint8_t *p;
	uint8_t b = (uint8_t)~file_byte(9);

	p = mmap(NULL, page, PROT_READ, MAP_SHARED, fd, 0);
	zassert_not_equal(p, MAP_FAILED, "mmap() failed: %d", errno);
	zassert_equal(p[9], file_byte(9));

	/* a change written through the descriptor shows once the pages are invalidated */
	zassert_equal(pwrite(fd, &b, 1, 9), 1);
	zassert_ok(msync(p, page, MS_INVALIDATE));
	zassert_equal(p[9], b);

	zassert_ok(msync(p, page, MS_SYNC | MS_INVALIDATE));
	zassert_equal(p[9], b);
	zassert_equal(p[8], file_byte(8));

	zassert_ok(munmap(p, page));
}

/* only the pages modified through the mapping reach the file */
static void msync_dirty_pages_only(int fd)
{
	uint8_t *p;
	uint8_t b;
	uint8_t via_fd = (uint8_t)~file_byte(page + 3);

	p = mmap(NULL, 2 * page, PROT_READ | PROT_WRITE, MAP_SHARED, fd, 0);
	zassert_not_equal(p, MAP_FAILED, "mmap() failed: %d", errno);

	/* the descriptor changes page 1 while the mapping changes page 0 */
	zassert_equal(pwrite(fd, &via_fd, 1, page + 3), 1);
	p[5] = (uint8_t)~file_byte(5);
	zassert_ok(msync(p, 2 * page, MS_SYNC));

	zassert_equal(pread(fd, &b, 1, 5), 1);
	zassert_equal(b, (uint8_t)~file_byte(5));
	zassert_equal(pread(fd, &b, 1, page + 3), 1);
	zassert_equal(b, via_fd, "an unmodified page was written back over the descriptor's write");

	/* a page that has been written back is tracked again */
	p[5] = file_byte(5);
	p[page + 9] = (uint8_t)~file_byte(page + 9);
	zassert_ok(msync(p, 2 * page, MS_SYNC));
	zassert_equal(pread(fd, &b, 1, 5), 1);
	zassert_equal(b, file_byte(5));
	zassert_equal(pread(fd, &b, 1, page + 9), 1);
	zassert_equal(b, (uint8_t)~file_byte(page + 9));

	zassert_ok(munmap(p, 2 * page));
}

ZTEST(xsi_realtime, test_msync)
{
	int fd = msync_setup();

	msync_invalid();
	msync_writeback(fd, MS_SYNC);
	msync_writeback(fd, MS_ASYNC);
	msync_invalidate(fd);
	if (IS_ENABLED(CONFIG_ZVFS_MMAP_DIRTY_TRACK) || IS_ENABLED(CONFIG_NATIVE_LIBC)) {
		msync_dirty_pages_only(fd);
	}

	msync_teardown(fd);
}
```

## src/mutex_prioceiling.c
```c
/*
 * Copyright (c) 2025 Friedt Professional Engineering Services, Inc.
 *
 * SPDX-License-Identifier: Apache-2.0
 */

#include <pthread.h>

#include <zephyr/ztest.h>

#if defined(_POSIX_THREAD_PRIO_PROTECT)
ZTEST(xsi_realtime, test_pthread_mutex_getprioceiling)
{
	zassert_equal(pthread_mutex_getprioceiling(NULL, NULL), ENOSYS);
}

ZTEST(xsi_realtime, test_pthread_mutex_setprioceiling)
{
	zassert_equal(pthread_mutex_setprioceiling(NULL, 0, NULL), ENOSYS);
}
#endif

#if defined(_POSIX_THREAD_PRIO_INHERIT) || defined(_POSIX_THREAD_PRIO_PROTECT)
ZTEST(xsi_realtime, test_pthread_mutexattr_getprioceiling)
{
	zassert_equal(pthread_mutexattr_getprioceiling(NULL, NULL), ENOSYS);
}

ZTEST(xsi_realtime, test_pthread_mutexattr_setprioceiling)
{
	zassert_equal(pthread_mutexattr_setprioceiling(NULL, 0), ENOSYS);
}
#endif
```

## src/sched_priority.c
```c
/*
 * Copyright (c) 2024, Meta
 * Copyright (c) 2025 Friedt Professional Engineering Services, Inc.
 *
 * SPDX-License-Identifier: Apache-2.0
 */

#include <errno.h>
#include <pthread.h>
#include <sched.h>

#include <zephyr/sys/util.h>
#include <zephyr/ztest.h>

#include "../../shared/linux_compat_test.h"

#define SCHED_INVALID 4242

static pthread_attr_t attr;

static void *thread_entry(void *arg)
{
	ARG_UNUSED(arg);
	return NULL;
}

static void can_create_thread(const pthread_attr_t *attrp)
{
	pthread_t th;

	if (CONFIG_SYS_THREAD_STACK_MAX == 0) {
		ztest_test_skip();
	}

	zassert_ok(pthread_create(&th, attrp, thread_entry, NULL));
	zassert_ok(pthread_join(th, NULL));
}

ZTEST(xsi_realtime, test_sched_get_priority_min)
{
	errno = 0;
	zassert_equal(sched_get_priority_min(SCHED_INVALID), -1);
	zassert_equal(errno, EINVAL);
}

ZTEST(xsi_realtime, test_sched_get_priority_max)
{
	errno = 0;
	zassert_equal(sched_get_priority_max(SCHED_INVALID), -1);
	zassert_equal(errno, EINVAL);
}

ZTEST(xsi_realtime, test_sched_policy_and_priority_limits)
{
	int pmin = -1;
	int pmax = -1;
	struct sched_param param;
	static const int policies[] = {
		SCHED_FIFO,
		SCHED_RR,
		SCHED_OTHER,
		SCHED_INVALID,
	};
	static const char *const policy_names[] = {
		"SCHED_FIFO",
		"SCHED_RR",
		"SCHED_OTHER",
		"SCHED_INVALID",
	};
	/* the host libc implements every policy; Zephyr maps them onto its priority classes */
	static const bool policy_enabled[] = {
		IS_ENABLED(CONFIG_NATIVE_LIBC) || (CONFIG_NUM_COOP_PRIORITIES > 0),
		IS_ENABLED(CONFIG_NATIVE_LIBC) || (CONFIG_NUM_PREEMPT_PRIORITIES > 0),
		IS_ENABLED(CONFIG_NATIVE_LIBC) || (CONFIG_NUM_PREEMPT_PRIORITIES > 0),
		false,
	};
	static int nprio[] = {
		CONFIG_NUM_COOP_PRIORITIES,
		CONFIG_NUM_PREEMPT_PRIORITIES,
		CONFIG_NUM_PREEMPT_PRIORITIES,
		42,
	};
	const char *const prios[] = {"pmin", "pmax"};

	zassert_ok(pthread_attr_init(&attr));

	BUILD_ASSERT(!(SCHED_INVALID == SCHED_FIFO || SCHED_INVALID == SCHED_RR ||
		       SCHED_INVALID == SCHED_OTHER),
		     "SCHED_INVALID is itself invalid");

	ARRAY_FOR_EACH(policies, policy) {
		ARRAY_FOR_EACH(prios, i) {
			errno = 0;
			if (i == 0) {
				pmin = sched_get_priority_min(policies[policy]);
				param.sched_priority = pmin;
			} else {
				pmax = sched_get_priority_max(policies[policy]);
				param.sched_priority = pmax;
			}

			if (policy == 3) {
				zassert_equal(-1, param.sched_priority);
				zassert_equal(errno, EINVAL);
				continue;
			}

			zassert_not_equal(-1, param.sched_priority,
					  "sched_get_priority_%s(%s) failed: %d",
					  i == 0 ? "min" : "max", policy_names[policy], errno);
			zassert_ok(errno, "sched_get_priority_%s(%s) set errno to %d",
				   i == 0 ? "min" : "max", policy_names[policy], errno);
		}

		if (policy != 3) {
			zassert_true(pmax >= pmin,
				     "%s min/max inconsistency, pmax (%d) < pmin (%d)",
				     policy_names[policy], pmax, pmin);
			/* the range is Zephyr's priority count for the class, the host has its own */
			if (!IS_ENABLED(CONFIG_NATIVE_LIBC)) {
				zassert_true(pmax > pmin, "%s has a single priority",
					     policy_names[policy]);
				zassert_equal(pmin, 0, "unexpected pmin for %s",
					      policy_names[policy]);
				zassert_equal(pmax, nprio[policy] - 1, "unexpected pmax for %s",
					      policy_names[policy]);
			}
		}

		ARRAY_FOR_EACH(prios, j) {
			param.sched_priority = (j == 0) ? pmin : pmax;

			if (!policy_enabled[policy]) {
				zassert_not_ok(
					pthread_attr_setschedpolicy(&attr, policies[policy]));
				zassert_not_ok(
					pthread_attr_setschedparam(&attr, &param),
					"pthread_attr_setschedparam() failed for %s (%d) of %s",
					prios[j], param.sched_priority, policy_names[policy]);
				continue;
			}

			zassert_ok(pthread_attr_setschedpolicy(&attr, policies[policy]),
				   "pthread_attr_setschedpolicy() failed for %s (%d) of %s",
				   prios[j], param.sched_priority, policy_names[policy]);
			zassert_ok(pthread_attr_setschedparam(&attr, &param),
				   "pthread_attr_setschedparam() failed for %s (%d) of %s",
				   prios[j], param.sched_priority, policy_names[policy]);

			can_create_thread(&attr);
		}
	}

	zassert_ok(pthread_attr_destroy(&attr));
}
```

## src/shm.c
```c
/*
 * Copyright (c) 2024, Tenstorrent AI ULC
 *
 * SPDX-License-Identifier: Apache-2.0
 */

#include <fcntl.h>
#include <pthread.h>
#include <semaphore.h>
#include <spawn.h>
#include <sys/mman.h>
#include <sys/stat.h>
#include <sys/wait.h>
#include <time.h>
#include <unistd.h>
#include <sys/socket.h>

#include <zephyr/kernel.h>
#include <zephyr/sys/fdtable.h>

#include <zephyr/ztest.h>

#include "../../shared/linux_compat_test.h"
#include "image_registry.h"

#define _page_size COND_CODE_1(CONFIG_MMU, (CONFIG_MMU_PAGE_SIZE), (CONFIG_POSIX_PAGE_SIZE))

#define SHM_SIZE 8

#define VALID_SHM_PATH     "/foo"
#define INVALID_SHM_PATH   "foo"
#define EMPTY_SHM_PATH     ""
#define TOO_SHORT_SHM_PATH "/"

#define INVALID_MODE 0
#define VALID_MODE   0666

#define INVALID_FLAGS 0
#define VALID_FLAGS   (O_RDWR | O_CREAT)
#define CREATE_FLAGS  VALID_FLAGS
#define OPEN_FLAGS    (VALID_FLAGS & ~O_CREAT)

/* account for stdin, stdout, stderr */
#define N (ZVFS_OPEN_SIZE - 3)

/* we need to have at least 2 shared memory objects */
BUILD_ASSERT(N >= 2, "ZVFS_OPEN_SIZE must be > 4");

ZTEST(xsi_realtime, test_shm_open)
{
	int ret;
	int fd[N];
	struct stat st;

	/* a leftover of an earlier run on the host would carry a size */
	(void)shm_unlink(VALID_SHM_PATH);

	{
		/* degenerate error cases; the host libc accepts a slashless name and mode 0 */
		IF_NOT_NATIVE_LIBC({
			zassert_not_ok(shm_open(NULL, INVALID_FLAGS, INVALID_MODE));
			zassert_not_ok(shm_open(NULL, INVALID_FLAGS, VALID_MODE));
			zassert_not_ok(shm_open(NULL, VALID_FLAGS, INVALID_MODE));
			zassert_not_ok(shm_open(NULL, VALID_FLAGS, VALID_MODE));
			zassert_not_ok(shm_open(INVALID_SHM_PATH, VALID_FLAGS, VALID_MODE));
			zassert_not_ok(shm_open(VALID_SHM_PATH, VALID_FLAGS, INVALID_MODE));
		})
		zassert_not_ok(shm_open(EMPTY_SHM_PATH, VALID_FLAGS, VALID_MODE));
		zassert_not_ok(shm_open(TOO_SHORT_SHM_PATH, VALID_FLAGS, VALID_MODE));
		zassert_not_ok(shm_open(VALID_SHM_PATH, INVALID_FLAGS, INVALID_MODE));
		zassert_not_ok(shm_open(VALID_SHM_PATH, INVALID_FLAGS, VALID_MODE));
	}

	/* open / close 1 file descriptor referring to VALID_SHM_PATH */
	fd[0] = shm_open(VALID_SHM_PATH, VALID_FLAGS, VALID_MODE);
	zassert_true(fd[0] >= 0, "shm_open(%s, %x, %04o) failed: %d", VALID_SHM_PATH, VALID_FLAGS,
		     VALID_MODE, errno);

	/* should have size 0 and be a shared memory object (the host cannot tell) */
	zassert_ok(fstat(fd[0], &st));
	zassert_equal(st.st_size, 0);
	IF_NOT_NATIVE_LIBC({ zassert_true(S_TYPEISSHM(&st)); })

	/* technically, the order of close / shm_unlink can be reversed too */
	zassert_ok(close(fd[0]));
	ret = shm_unlink(VALID_SHM_PATH);
	zassert_true(ret == 0 || (ret == -1 && errno == ENOENT),
		     "unexpected return / errno from shm_unlink: %d / %d", ret, errno);

	/* a failed open of an absent object must not consume a file descriptor */
	for (size_t i = 0; i < 2 * N; ++i) {
		zassert_equal(shm_open("/nonexistent_shm", OPEN_FLAGS, VALID_MODE), -1);
		zassert_equal(errno, ENOENT);
	}

	/* open / close N file descriptors referring to VALID_SHM_PATH: every slot is still free */
	for (size_t i = 0; i < N; ++i) {
		fd[i] = shm_open(VALID_SHM_PATH, i == 0 ? CREATE_FLAGS : OPEN_FLAGS, VALID_MODE);
		zassert_true(fd[i] >= 0, "shm_open(%s, %x, %04o) failed: %d", VALID_SHM_PATH,
			     VALID_FLAGS, VALID_MODE, errno);
	}
	zassert_ok(shm_unlink(VALID_SHM_PATH));
	for (size_t i = N; i > 0; --i) {
		zassert_ok(close(fd[i - 1]));
	}
}

ZTEST(xsi_realtime, test_shm_unlink)
{
	int fd;

	{
		/* degenerate error cases */
		IF_NOT_NATIVE_LIBC({ zassert_not_ok(shm_unlink(NULL)); })
		zassert_not_ok(shm_unlink(INVALID_SHM_PATH));
		zassert_not_ok(shm_unlink(EMPTY_SHM_PATH));
		zassert_not_ok(shm_unlink(TOO_SHORT_SHM_PATH));
	}

	/* open / close 1 file descriptor referring to VALID_SHM_PATH */
	fd = shm_open(VALID_SHM_PATH, VALID_FLAGS, VALID_MODE);
	zassert_true(fd >= 0, "shm_open(%s, %x, %04o) failed: %d", VALID_SHM_PATH, VALID_FLAGS,
		     VALID_MODE, errno);
	/* technically, the order of close / shm_unlink can be reversed too */
	zassert_ok(close(fd));
	zassert_ok(shm_unlink(VALID_SHM_PATH));
	/* should not be able to re-open the same path without O_CREAT */
	zassert_not_ok(shm_open(VALID_SHM_PATH, OPEN_FLAGS, VALID_MODE));
}

ZTEST(xsi_realtime, test_shm_read_write)
{
	int fd[N];

	for (size_t i = 0; i < N; ++i) {
		char cbuf = 0xff;

		fd[i] = shm_open(VALID_SHM_PATH, i == 0 ? CREATE_FLAGS : OPEN_FLAGS, VALID_MODE);
		zassert_true(fd[i] >= 0, "shm_open(%s, %x, %04o) failed: %d", VALID_SHM_PATH,
			     VALID_FLAGS, VALID_MODE, errno);
		if (i == 0) {
			/* size 0 on create: nothing to read, and the object does not grow on
			 * write (the host grows it)
			 */
			IF_NOT_NATIVE_LIBC({
				errno = 0;
				zassert_equal(write(fd[0], "", 1), -1,
					      "write() should fail on newly create shm fd with size 0");
				zassert_equal(errno, ENOSPC);
			})
			zassert_equal(read(fd[0], &cbuf, 1), 0,
				      "read() should fail on newly create shm fd with size 0");

			BUILD_ASSERT(SHM_SIZE >= 1);
			zassert_ok(ftruncate(fd[0], SHM_SIZE));

			zassert_equal(write(fd[0], "\x42", 1), 1, "write() failed on fd %d: %d\n",
				      fd[0], errno);

			continue;
		}

		zassert_equal(read(fd[i], &cbuf, 1), 1, "read() failed on fd %d: %d\n", fd[i],
			      errno);
		zassert_equal(cbuf, 0x42,
			      "Failed to read byte over fd %d: expected: 0x%02x actual: 0x%02x",
			      fd[i], 0x42, cbuf);
	}

	for (size_t i = N; i > 0; --i) {
		zassert_ok(close(fd[i - 1]));
	}

	zassert_ok(shm_unlink(VALID_SHM_PATH));
}

#if defined(_POSIX_THREAD_PROCESS_SHARED) && defined(CONFIG_POSIX_SPAWN)
#define IPC_SHM_PATH "/ipc"
#define IPC_ROUNDS   4

/* the page both processes map: the turn passes back and forth under the shared lock */
struct ipc_page {
	pthread_mutex_t lock;
	pthread_cond_t turn_changed;
	sem_t mapped;
	int turn; /* 0: the parent's, 1: the child's */
	int rounds;
};
/* without an MMU a page is CONFIG_POSIX_PAGE_SIZE bytes, smaller than the struct on 64-bit */
#define IPC_SHM_SIZE ROUND_UP(sizeof(struct ipc_page), _page_size)

static void ipc_child_entry(void *p1, void *p2, void *p3)
{
	int fd = shm_open(IPC_SHM_PATH, O_RDWR, VALID_MODE);
	struct ipc_page *pg;
	int rounds = 0;

	ARG_UNUSED(p1);
	ARG_UNUSED(p2);
	ARG_UNUSED(p3);

	if (fd < 0) {
		_exit(2);
	}
	pg = mmap(NULL, IPC_SHM_SIZE, PROT_READ | PROT_WRITE, MAP_SHARED, fd, 0);
	if (pg == MAP_FAILED) {
		_exit(3);
	}
	if (sem_post(&pg->mapped) != 0) {
		_exit(4);
	}

	for (int i = 0; i < IPC_ROUNDS; ++i) {
		if (pthread_mutex_lock(&pg->lock) != 0) {
			_exit(5);
		}
		while (pg->turn != 1) {
			if (pthread_cond_wait(&pg->turn_changed, &pg->lock) != 0) {
				_exit(6);
			}
		}
		pg->rounds++;
		rounds++;
		pg->turn = 0;
		(void)pthread_cond_signal(&pg->turn_changed);
		(void)pthread_mutex_unlock(&pg->lock);
	}

	(void)munmap(pg, IPC_SHM_SIZE);
	(void)close(fd);
	_exit((rounds == IPC_ROUNDS) ? 0 : 7);
}

IMAGE_REGISTRY_ENTRY_DEFINE(img_ipc, "/bin/ipc", ipc_child_entry);

/* a deadline for the waits on the child, so a child that died fails the test instead */
static struct timespec ipc_deadline(void)
{
	struct timespec ts;

	zassert_ok(clock_gettime(CLOCK_REALTIME, &ts));
	ts.tv_sec += 10;

	return ts;
}

/* synchronization objects in a mapped shared memory object work across processes */
static void shm_mmap_process_shared(void)
{
	struct timespec deadline;
	int fd = shm_open(IPC_SHM_PATH, CREATE_FLAGS, VALID_MODE);
	struct ipc_page *pg;
	pthread_mutexattr_t ma;
	pthread_condattr_t ca = {0};
	pid_t pid = -1;
	int status = -1;
	char *const argv[] = {"ipc", NULL};
	char *const envp[] = {NULL};

	zassert_true(fd >= 0, "shm_open(%s) failed: %d", IPC_SHM_PATH, errno);
	zassert_ok(ftruncate(fd, IPC_SHM_SIZE));
	pg = mmap(NULL, IPC_SHM_SIZE, PROT_READ | PROT_WRITE, MAP_SHARED, fd, 0);
	zassert_not_equal(pg, MAP_FAILED, "mmap() failed: %d", errno);

	zassert_ok(pthread_mutexattr_init(&ma));
	zassert_ok(pthread_mutexattr_setpshared(&ma, PTHREAD_PROCESS_SHARED));
	zassert_ok(pthread_mutex_init(&pg->lock, &ma));
	zassert_ok(pthread_mutexattr_destroy(&ma));
	zassert_ok(pthread_condattr_init(&ca));
	zassert_ok(pthread_condattr_setpshared(&ca, PTHREAD_PROCESS_SHARED));
	zassert_ok(pthread_cond_init(&pg->turn_changed, &ca));
	zassert_ok(pthread_condattr_destroy(&ca));
	zassert_ok(sem_init(&pg->mapped, 1, 0));
	pg->turn = 0;
	pg->rounds = 0;

	zassert_ok(posix_spawn(&pid, "/bin/ipc", NULL, NULL, argv, envp));
	deadline = ipc_deadline();
	zassert_ok(sem_timedwait(&pg->mapped, &deadline), "the child never mapped the page: %d",
		   errno);

	for (int i = 0; i < IPC_ROUNDS; ++i) {
		zassert_ok(pthread_mutex_lock(&pg->lock));
		pg->turn = 1;
		zassert_ok(pthread_cond_signal(&pg->turn_changed));
		while (pg->turn != 0) {
			zassert_ok(pthread_cond_timedwait(&pg->turn_changed, &pg->lock, &deadline),
				   "round %d: the child never took its turn", i);
		}
		zassert_ok(pthread_mutex_unlock(&pg->lock));
	}

	zassert_equal(waitpid(pid, &status, 0), pid, "waitpid failed: %d", errno);
	zassert_true(WIFEXITED(status), "status 0x%x", status);
	zassert_equal(WEXITSTATUS(status), 0, "the child left with %d", WEXITSTATUS(status));
	zassert_equal(pg->rounds, IPC_ROUNDS);

	zassert_ok(pthread_cond_destroy(&pg->turn_changed));
	zassert_ok(pthread_mutex_destroy(&pg->lock));
	zassert_ok(sem_destroy(&pg->mapped));
	zassert_ok(munmap(pg, IPC_SHM_SIZE));
	zassert_ok(close(fd));
	zassert_ok(shm_unlink(IPC_SHM_PATH));
}
#endif /* _POSIX_THREAD_PROCESS_SHARED && CONFIG_POSIX_SPAWN */

ZTEST(xsi_realtime, test_shm_mmap)
{
	int fd[N];
	void *addr[N];

	for (size_t i = 0; i < N; ++i) {
		fd[i] = shm_open(VALID_SHM_PATH, i == 0 ? CREATE_FLAGS : OPEN_FLAGS, VALID_MODE);
		zassert_true(fd[i] >= 0, "shm_open(%s, %x, %04o) failed : %d", VALID_SHM_PATH,
			     VALID_FLAGS, VALID_MODE, errno);

		if (i == 0) {
			/* cannot map shm of size zero */
			zassert_not_ok(mmap(NULL, _page_size, PROT_READ | PROT_WRITE, MAP_SHARED,
					    fd[0], 0));

			zassert_ok(ftruncate(fd[0], _page_size));
		}

		addr[i] = mmap(NULL, _page_size, PROT_READ | PROT_WRITE, MAP_SHARED, fd[i], 0);
		zassert_not_equal(MAP_FAILED, addr[i], "mmap() failed: %d", errno);

		if ((i & 1) == 0) {
			memset(addr[0], i & 0xff, _page_size);
		} else {
			zassert_mem_equal(addr[i], addr[i - 1], _page_size);
		}
	}

	for (size_t i = N; i > 0; --i) {
		zassert_ok(close(fd[i - 1]));
	}

	for (size_t i = N; i > 0; --i) {
		zassert_ok(munmap(addr[i - 1], _page_size));
		/*
		 * Note: for some reason, in Zephyr, unmapping a physical page once, removes all
		 * virtual mappings. When that behaviour changes, remove the break below and adjust
		 * shm.c accordingly.
		 */
		break;
	}

	zassert_ok(shm_unlink(VALID_SHM_PATH));

#if defined(_POSIX_THREAD_PROCESS_SHARED) && defined(CONFIG_POSIX_SPAWN)
	shm_mmap_process_shared();
#endif
}
```

## src/sync_io.c
```c
/*
 * Copyright (c) 2018 Intel Corporation.
 *
 * SPDX-License-Identifier: Apache-2.0
 */

#include <string.h>
#include <fcntl.h>
#include <ff.h>
#include <zephyr/fs/fs.h>
#include <unistd.h>
#include <zephyr/ztest.h>

#include "../../shared/linux_compat_test.h"

static const char test_str[] = "Hello World!";

#define FATFS_MNTP "/RAM:"
/* the host libc opens host paths: no volume to mount, a temporary file instead */
#define TEST_FILE                                                                                  \
	COND_CODE_1(CONFIG_NATIVE_LIBC, ("/tmp/posix_xsi_realtime_sync_io.txt"),                   \
		    (FATFS_MNTP "/testfile.txt"))

static FATFS fat_fs;

static struct fs_mount_t fatfs_mnt = {
	.type = FS_FATFS,
	.mnt_point = FATFS_MNTP,
	.fs_data = &fat_fs,
};

static void test_mount(void)
{
	int res;

	if (IS_ENABLED(CONFIG_NATIVE_LIBC)) {
		return;
	}
	res = fs_mount(&fatfs_mnt);
	zassert_ok(res, "Error mounting fs [%d]\n", res);
}

void test_unmount(void)
{
	int res;

	if (IS_ENABLED(CONFIG_NATIVE_LIBC)) {
		(void)unlink(TEST_FILE);
		return;
	}
	res = fs_unmount(&fatfs_mnt);
	zassert_ok(res, "Error unmounting fs [%d]", res);
}

static int file_open(void)
{
	int res;

	res = open(TEST_FILE, O_CREAT | O_RDWR, 0660);
	zassert_not_equal(res, -1, "Error opening file [%d], errno [%d]", res, errno);
	return res;
}

static int file_write(int file)
{
	ssize_t brw;
	off_t res;

	res = lseek(file, 0, SEEK_SET);
	zassert_ok((int)res, "lseek failed [%d]\n", (int)res);

	brw = write(file, (char *)test_str, strlen(test_str));
	zassert_ok((int)res, "Failed writing to file [%d]\n", (int)brw);

	zassert_ok(brw < strlen(test_str),
		   "Unable to complete write. Volume full. Number of bytes written: [%d]\n",
		   (int)brw);
	return res;
}

/**
 * @brief Test for POSIX fsync API
 *
 * @details Test sync the file through POSIX fsync API.
 */
ZTEST(xsi_realtime, test_fs_sync)
{
	test_mount();
	int res = 0;
	int file = file_open();

	res = file_write(file);
	res = fsync(file);
	zassert_ok(res, "Failed to sync file: %d, errno = %d\n", res, errno);
	zassert_ok(close(file), "Failed to close file");

	/* a directory descriptor syncs too */
	if (!IS_ENABLED(CONFIG_NATIVE_LIBC)) {
		int dir = open(FATFS_MNTP, O_RDONLY | O_DIRECTORY);

		zassert_true(dir >= 0, "Failed to open directory: errno = %d", errno);
		zassert_ok(fsync(dir), "Failed to sync directory: errno = %d", errno);
		zassert_ok(close(dir));
	}
	test_unmount();
}

/**
 * @brief Test for POSIX fdatasync API
 *
 * @details Test sync the file through POSIX fdatasync API.
 */
ZTEST(xsi_realtime, test_fs_datasync)
{
	test_mount();
	int res = 0;
	int file = file_open();

	res = file_write(file);
	res = fdatasync(file);
	zassert_ok(res, "Failed to sync file: %d, errno = %d\n", res, errno);
	zassert_ok(close(file), "Failed to close file");
	test_unmount();
}
```
