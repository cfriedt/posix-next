## CMakeLists.txt
```
# SPDX-License-Identifier: Apache-2.0

cmake_minimum_required(VERSION 3.20.0)
find_package(Zephyr REQUIRED HINTS $ENV{ZEPHYR_BASE})
project(posix_file_system_fd)

FILE(GLOB app_sources src/*.c)
target_sources(app PRIVATE ${app_sources})

target_compile_options(app PRIVATE -U_POSIX_C_SOURCE -D_POSIX_C_SOURCE=200809L)
target_compile_options(app PRIVATE -U_XOPEN_SOURCE -D_XOPEN_SOURCE=700)
```

## prj.conf
```kconfig
CONFIG_ZTEST=y

CONFIG_POSIX_AEP_CHOICE_PSE52=y
CONFIG_POSIX_FILE_SYSTEM_FD=y
# XSI provides the S_IF* constants and the XSI struct stat members
CONFIG_XSI=y

CONFIG_FILE_SYSTEM=y
CONFIG_FAT_FILESYSTEM_ELM=y
# a read-only and a writable mount beside the FAT root
CONFIG_FILE_SYSTEM_TMPFS=y
# utimensat() on a symbolic link
CONFIG_FILE_SYSTEM_SYMLINKS=y

CONFIG_EVENTFD=n

# stdio (3) + fixture rw/ro (2) + directory streams + scratch
CONFIG_ZVFS_OPEN_IGNORE_MIN=y
CONFIG_ZVFS_OPEN_MAX=12
CONFIG_ZVFS_DIR_MAX=4

CONFIG_MAIN_STACK_SIZE=4096
CONFIG_ZTEST_STACK_SIZE=4096
CONFIG_TEST_EXTRA_STACK_SIZE=4096

CONFIG_HEAP_MEM_POOL_SIZE=16384
CONFIG_COMMON_LIBC_MALLOC_ARENA_SIZE=16384
```

## src/main.c
```c
/*
 * SPDX-FileCopyrightText: Copyright The Zephyr Project Contributors
 * SPDX-License-Identifier: Apache-2.0
 */

#include "file_system_fd_tests.h"

#include <fcntl.h>
#include <stdio.h>
#include <string.h>
#include <sys/stat.h>
#include <unistd.h>

#include <zephyr/kernel.h>
#ifndef CONFIG_NATIVE_LIBC
#include <ff.h>
#include <zephyr/fs/fs.h>
#endif
#ifdef CONFIG_USERSPACE
#include <zephyr/sys/fdtable.h>
#include <zephyr/sys/internal/fdtable_priv.h>
extern struct k_mem_partition zvfs_dir_partition;
#endif

ZTEST_BMEM int fs_test_fd = -1;
ZTEST_BMEM int fs_test_rofd = -1;

#ifndef CONFIG_NATIVE_LIBC
static FATFS fat_fs;
static struct fs_mount_t fs_mnt = {
	.type = FS_FATFS,
	.mnt_point = "/",
	.fs_data = &fat_fs,
};
static struct fs_mount_t ro_mnt = {
	.type = FS_TMPFS,
	.mnt_point = TEST_RO,
	.flags = FS_MOUNT_FLAG_READ_ONLY,
};
static struct fs_mount_t tmpfs_mnt = {
	.type = FS_TMPFS,
	.mnt_point = TEST_TMPFS,
};
#endif

static void grant_fd(int fd)
{
#ifdef CONFIG_USERSPACE
	if (fd >= 0) {
		k_object_access_all_grant(zvfs_fd_entry_get(fd));
	}
#else
	ARG_UNUSED(fd);
#endif
}

/*
 * Remove a whole subtree. The Zephyr path uses the fs_* API directly: POSIX
 * <dirent.h> and the FATFS ff.h both define a DIR type, so they cannot share
 * a translation unit. Under the host libc, plain POSIX calls are used.
 */
#ifdef CONFIG_NATIVE_LIBC
#include <dirent.h>
static void rmtree(const char *path)
{
	DIR *d = opendir(path);
	struct dirent *e;
	char child[300];

	if (d != NULL) {
		while ((e = readdir(d)) != NULL) {
			if (strcmp(e->d_name, ".") == 0 || strcmp(e->d_name, "..") == 0) {
				continue;
			}
			if (snprintf(child, sizeof(child), "%s/%s", path, e->d_name) >=
			    (int)sizeof(child)) {
				continue;
			}
			rmtree(child);
		}
		closedir(d);
		rmdir(path);
		return;
	}

	(void)unlink(path);
}
#else
static void rmtree(const char *path)
{
	struct fs_dir_t dir;
	struct fs_dirent ent;
	char child[300];

	fs_dir_t_init(&dir);

	if (fs_opendir(&dir, path) == 0) {
		while (fs_readdir(&dir, &ent) == 0 && ent.name[0] != '\0') {
			if (snprintf(child, sizeof(child), "%s/%s", path, ent.name) >=
			    (int)sizeof(child)) {
				continue;
			}
			rmtree(child);
		}
		fs_closedir(&dir);
	}

	(void)fs_unlink(path);
}
#endif

void fs_test_reset(void)
{
	int fd;

	rmtree(TEST_ROOT);

	zassert_ok(mkdir(TEST_ROOT, 0777));

	fd = open(TEST_FILE, O_WRONLY | O_CREAT | O_TRUNC, 0600);
	zassert_true(fd >= 0);
	zassert_equal(write(fd, TEST_CONTENT, strlen(TEST_CONTENT)), strlen(TEST_CONTENT));
	zassert_ok(close(fd));

	fd = open(TEST_EMPTY, O_WRONLY | O_CREAT | O_TRUNC, 0600);
	zassert_true(fd >= 0);
	zassert_ok(close(fd));

	zassert_ok(mkdir(TEST_DIR, 0777));
	fd = open(TEST_SUB, O_WRONLY | O_CREAT, 0600);
	zassert_true(fd >= 0);
	zassert_ok(close(fd));

	(void)unlink(TEST_NOENT);
}

static void before(void *arg)
{
	ARG_UNUSED(arg);

	fs_test_reset();

	fs_test_fd = open(TEST_FILE, O_RDWR);
	zassert_true(fs_test_fd >= 0);
	grant_fd(fs_test_fd);

	fs_test_rofd = open(TEST_FILE, O_RDONLY);
	zassert_true(fs_test_rofd >= 0);
	grant_fd(fs_test_rofd);

	{ int rc = chdir("/"); ARG_UNUSED(rc); }
}

static void after(void *arg)
{
	ARG_UNUSED(arg);

	if (fs_test_fd >= 0) {
		close(fs_test_fd);
		fs_test_fd = -1;
	}
	if (fs_test_rofd >= 0) {
		close(fs_test_rofd);
		fs_test_rofd = -1;
	}
	{ int rc = chdir("/"); ARG_UNUSED(rc); }
}

static void *setup(void)
{
#ifndef CONFIG_NATIVE_LIBC
	memset(&fat_fs, 0, sizeof(fat_fs));
	zassert_ok(fs_mount(&fs_mnt));
	zassert_ok(fs_mount(&ro_mnt));
	zassert_ok(fs_mount(&tmpfs_mnt));
	{
		struct fs_file_t f;

		fs_file_t_init(&f);
		zassert_ok(fs_open(&f, TEST_TMPFS_FILE, FS_O_CREATE | FS_O_WRITE));
		zassert_ok(fs_close(&f));
	}
	zassert_ok(fs_symlink("target", TEST_TMPFS_LINK));
#endif
	(void)mkdir(FS_TMPDIR, 0777);
#ifdef CONFIG_USERSPACE
	zassert_ok(k_mem_domain_add_partition(&k_mem_domain_default, &zvfs_dir_partition));
#endif
	return NULL;
}

static void teardown(void *arg)
{
	ARG_UNUSED(arg);
#ifndef CONFIG_NATIVE_LIBC
	rmtree(TEST_ROOT);
	(void)fs_unmount(&tmpfs_mnt);
	(void)fs_unmount(&ro_mnt);
	(void)fs_unmount(&fs_mnt);
#endif
}

ZTEST_SUITE(posix_file_system_fd, NULL, setup, before, after, teardown);
```

## src/faccessat.c
```c
/*
 * SPDX-FileCopyrightText: Copyright The Zephyr Project Contributors
 * SPDX-License-Identifier: Apache-2.0
 */

#include "file_system_fd_common.h"

#include <errno.h>
#include <fcntl.h>
#include <unistd.h>

ZTEST_USER(posix_file_system_fd, test_faccessat)
{
	int dirfd = open_test_root();

	zassert_ok(faccessat(dirfd, "file.txt", F_OK, 0));
	zassert_ok(faccessat(dirfd, "file.txt", R_OK | W_OK, 0));
	zassert_ok(faccessat(dirfd, "dir", F_OK, AT_EACCESS));
	zassert_ok(faccessat(AT_FDCWD, TEST_FILE, F_OK, 0));

	errno = 0;
	zassert_equal(faccessat(dirfd, "nope.txt", F_OK, 0), -1);
	zassert_equal(errno, ENOENT);

	errno = 0;
	zassert_equal(faccessat(fs_test_fd, "file.txt", F_OK, 0), -1);
	zassert_equal(errno, ENOTDIR);

	/* a read-only file system refuses writes: the one the name resolves against, not the cwd */
	IF_NOT_NATIVE_LIBC({
		int rofd = open(TEST_RO, O_RDONLY | O_DIRECTORY);

		zassert_true(rofd >= 0, "open(" TEST_RO ") failed: %d", errno);
		zassert_ok(faccessat(rofd, ".", R_OK, 0));
		errno = 0;
		zassert_equal(faccessat(rofd, ".", W_OK, 0), -1);
		zassert_equal(errno, EROFS);
		zassert_ok(chdir(TEST_RO));
		zassert_ok(faccessat(dirfd, "file.txt", W_OK, 0));
		zassert_ok(chdir("/"));
		zassert_ok(close(rofd));
	});

	zassert_ok(close(dirfd));
}
```

## src/fdopendir.c
```c
/*
 * SPDX-FileCopyrightText: Copyright The Zephyr Project Contributors
 * SPDX-License-Identifier: Apache-2.0
 */

#include "file_system_fd_common.h"

#include <dirent.h>
#include <errno.h>
#include <string.h>
#include <strings.h>
#include <unistd.h>

ZTEST_USER(posix_file_system_fd, test_fdopendir)
{
	int dirfd = open_test_root();
	DIR *dir;
	struct dirent *ent;
	bool found = false;

	dir = fdopendir(dirfd);
	zassert_not_null(dir, "fdopendir failed: %d", errno);

	while ((ent = readdir(dir)) != NULL) {
		/* FAT without long names reports upper case */
		if (strcasecmp(ent->d_name, "file.txt") == 0) {
			found = true;
		}
	}
	zassert_true(found, "file.txt not listed");

	/* the stream owns the descriptor: closing it closes the descriptor */
	zassert_ok(closedir(dir));
	errno = 0;
	zassert_equal(close(dirfd), -1);
	zassert_equal(errno, EBADF);

	errno = 0;
	zassert_is_null(fdopendir(fs_test_fd));
	zassert_equal(errno, ENOTDIR);

	errno = 0;
	zassert_is_null(fdopendir(-1));
	zassert_equal(errno, EBADF);
}
```

## src/file_system_fd_common.h
```c
/*
 * SPDX-FileCopyrightText: Copyright The Zephyr Project Contributors
 * SPDX-License-Identifier: Apache-2.0
 */

#ifndef POSIX_TESTS_FILE_SYSTEM_FD_COMMON_H_
#define POSIX_TESTS_FILE_SYSTEM_FD_COMMON_H_

#include "file_system_fd_tests.h"

#include <fcntl.h>
#include <unistd.h>

/* a descriptor for TEST_ROOT, the directory the relative names resolve against */
static inline int open_test_root(void)
{
	int fd = open(TEST_ROOT, O_RDONLY | O_DIRECTORY);

	zassert_true(fd >= 0, "open(" TEST_ROOT ") failed: %d", errno);

	return fd;
}

#endif /* POSIX_TESTS_FILE_SYSTEM_FD_COMMON_H_ */
```

## src/file_system_fd_tests.h
```c
/*
 * SPDX-FileCopyrightText: Copyright The Zephyr Project Contributors
 * SPDX-License-Identifier: Apache-2.0
 */

#ifndef POSIX_TESTS_FILE_SYSTEM_FD_TESTS_H_
#define POSIX_TESTS_FILE_SYSTEM_FD_TESTS_H_

#include <zephyr/ztest.h>

#include "../../shared/linux_compat_test.h"

/*
 * The file system is mounted at "/", and /tmp exists in both worlds (the FAT
 * RAM disk under Zephyr, the host filesystem under CONFIG_NATIVE_LIBC), so
 * every path constant is identical for the linux_compat variant.
 */
#define FS_TMPDIR   "/tmp"
#define TEST_ROOT   FS_TMPDIR "/pfsfd"
#define TEST_FILE   TEST_ROOT "/file.txt"
#define TEST_EMPTY  TEST_ROOT "/empty.txt"
#define TEST_DIR    TEST_ROOT "/dir"
#define TEST_SUB    TEST_DIR "/sub.txt"
#define TEST_NOENT  TEST_ROOT "/nope.txt"
/* a read-only file system (Zephyr only) */
#define TEST_RO     "/ro"
/* a writable tmpfs mount, whose nodes record both timestamps */
#define TEST_TMPFS      "/tmpfs"
#define TEST_TMPFS_FILE TEST_TMPFS "/target"
#define TEST_TMPFS_LINK TEST_TMPFS "/link"
#define TEST_CONTENT "The quick brown fox jumps over the lazy dog!"

/* fixture descriptors, opened and granted per test */
extern int fs_test_fd;   /* TEST_FILE, O_RDWR */
extern int fs_test_rofd; /* TEST_FILE, O_RDONLY */

/* rebuild the baseline tree; kernel-mode machinery, used from before() */
void fs_test_reset(void);

#endif /* POSIX_TESTS_FILE_SYSTEM_FD_TESTS_H_ */
```

## src/fstatat.c
```c
/*
 * SPDX-FileCopyrightText: Copyright The Zephyr Project Contributors
 * SPDX-License-Identifier: Apache-2.0
 */

#include "file_system_fd_common.h"

#include <errno.h>
#include <fcntl.h>
#include <string.h>
#include <sys/stat.h>
#include <unistd.h>

ZTEST_USER(posix_file_system_fd, test_fstatat)
{
	int dirfd = open_test_root();
	struct stat st;

	zassert_ok(fstatat(dirfd, "file.txt", &st, 0));
	zassert_true(S_ISREG(st.st_mode));
	zassert_equal(st.st_size, strlen(TEST_CONTENT));

	zassert_ok(fstatat(dirfd, "dir", &st, 0));
	zassert_true(S_ISDIR(st.st_mode));

	/* a regular file reports the same either way */
	zassert_ok(fstatat(dirfd, "file.txt", &st, AT_SYMLINK_NOFOLLOW));
	zassert_true(S_ISREG(st.st_mode));

	zassert_ok(fstatat(AT_FDCWD, TEST_FILE, &st, 0));
	zassert_true(S_ISREG(st.st_mode));

	errno = 0;
	zassert_equal(fstatat(dirfd, "nope.txt", &st, 0), -1);
	zassert_equal(errno, ENOENT);

	errno = 0;
	zassert_equal(fstatat(fs_test_fd, "file.txt", &st, 0), -1);
	zassert_equal(errno, ENOTDIR);

	zassert_ok(close(dirfd));
}
```

## src/linkat.c
```c
/*
 * SPDX-FileCopyrightText: Copyright The Zephyr Project Contributors
 * SPDX-License-Identifier: Apache-2.0
 */

#include "file_system_fd_common.h"

#include <errno.h>
#include <unistd.h>

ZTEST_USER(posix_file_system_fd, test_linkat)
{
	int dirfd = open_test_root();

	if (IS_ENABLED(CONFIG_NATIVE_LIBC)) {
		/* the host filesystem supports hard links */
		zassert_ok(linkat(dirfd, "file.txt", dirfd, "nope.txt", 0));
		zassert_ok(unlinkat(dirfd, "nope.txt", 0));
	} else {
		errno = 0;
		zassert_equal(linkat(dirfd, "file.txt", dirfd, "nope.txt", 0), -1);
		zassert_equal(errno, EPERM);
	}

	zassert_ok(close(dirfd));
}
```

## src/mkdirat.c
```c
/*
 * SPDX-FileCopyrightText: Copyright The Zephyr Project Contributors
 * SPDX-License-Identifier: Apache-2.0
 */

#include "file_system_fd_common.h"

#include <errno.h>
#include <sys/stat.h>
#include <unistd.h>

ZTEST_USER(posix_file_system_fd, test_mkdirat)
{
	int dirfd = open_test_root();
	struct stat st;

	zassert_ok(mkdirat(dirfd, "nd", 0777));
	zassert_ok(stat(TEST_ROOT "/nd", &st));
	zassert_true(S_ISDIR(st.st_mode));

	errno = 0;
	zassert_equal(mkdirat(dirfd, "nd", 0777), -1);
	zassert_equal(errno, EEXIST);

	errno = 0;
	zassert_equal(mkdirat(dirfd, "nothere/x", 0777), -1);
	zassert_equal(errno, ENOENT);

	errno = 0;
	zassert_equal(mkdirat(fs_test_fd, "nd2", 0777), -1);
	zassert_equal(errno, ENOTDIR);

	zassert_ok(rmdir(TEST_ROOT "/nd"));
	zassert_ok(close(dirfd));
}
```

## src/openat.c
```c
/*
 * SPDX-FileCopyrightText: Copyright The Zephyr Project Contributors
 * SPDX-License-Identifier: Apache-2.0
 */

#include "file_system_fd_common.h"

#include <errno.h>
#include <fcntl.h>
#include <string.h>
#include <unistd.h>

ZTEST_USER(posix_file_system_fd, test_openat)
{
	int dirfd = open_test_root();
	int fd;
	char buf[sizeof(TEST_CONTENT)];

	/* relative to the directory descriptor */
	fd = openat(dirfd, "file.txt", O_RDONLY);
	zassert_true(fd >= 0, "openat failed: %d", errno);
	zassert_equal(read(fd, buf, sizeof(buf) - 1), strlen(TEST_CONTENT));
	buf[strlen(TEST_CONTENT)] = '\0';
	zassert_str_equal(buf, TEST_CONTENT);
	zassert_ok(close(fd));

	/* an absolute path ignores the descriptor */
	fd = openat(fs_test_fd, TEST_FILE, O_RDONLY);
	zassert_true(fd >= 0, "openat(absolute) failed: %d", errno);
	zassert_ok(close(fd));

	/* creation, then the same name is found through the descriptor */
	fd = openat(dirfd, "new.txt", O_WRONLY | O_CREAT | O_EXCL, 0600);
	zassert_true(fd >= 0, "openat(O_CREAT) failed: %d", errno);
	zassert_ok(close(fd));
	fd = openat(dirfd, "new.txt", O_RDONLY);
	zassert_true(fd >= 0);
	zassert_ok(close(fd));
	zassert_ok(unlink(TEST_ROOT "/new.txt"));

	errno = 0;
	zassert_equal(openat(dirfd, "nope.txt", O_RDONLY), -1);
	zassert_equal(errno, ENOENT);

	errno = 0;
	zassert_equal(openat(fs_test_fd, "file.txt", O_RDONLY), -1);
	zassert_equal(errno, ENOTDIR);

	errno = 0;
	zassert_equal(openat(-1, "file.txt", O_RDONLY), -1);
	zassert_equal(errno, EBADF);

	zassert_ok(close(dirfd));
}
```

## src/renameat.c
```c
/*
 * SPDX-FileCopyrightText: Copyright The Zephyr Project Contributors
 * SPDX-License-Identifier: Apache-2.0
 */

#include "file_system_fd_common.h"

#include <errno.h>
#include <fcntl.h>
#include <stdio.h>
#include <sys/stat.h>
#include <unistd.h>

ZTEST_USER(posix_file_system_fd, test_renameat)
{
	int dirfd = open_test_root();
	int subfd;
	struct stat st;

	zassert_ok(renameat(dirfd, "empty.txt", dirfd, "moved.txt"));
	zassert_ok(fstatat(dirfd, "moved.txt", &st, 0));
	errno = 0;
	zassert_equal(fstatat(dirfd, "empty.txt", &st, 0), -1);
	zassert_equal(errno, ENOENT);

	/* across directory descriptors */
	subfd = open(TEST_DIR, O_RDONLY | O_DIRECTORY);
	zassert_true(subfd >= 0);
	zassert_ok(renameat(dirfd, "moved.txt", subfd, "moved.txt"));
	zassert_ok(fstatat(subfd, "moved.txt", &st, 0));
	zassert_ok(unlinkat(subfd, "moved.txt", 0));
	zassert_ok(close(subfd));

	errno = 0;
	zassert_equal(renameat(dirfd, "nope.txt", dirfd, "other.txt"), -1);
	zassert_equal(errno, ENOENT);

	zassert_ok(close(dirfd));
}
```

## src/unlinkat.c
```c
/*
 * SPDX-FileCopyrightText: Copyright The Zephyr Project Contributors
 * SPDX-License-Identifier: Apache-2.0
 */

#include "file_system_fd_common.h"

#include <errno.h>
#include <fcntl.h>
#include <sys/stat.h>
#include <unistd.h>

ZTEST_USER(posix_file_system_fd, test_unlinkat)
{
	int dirfd = open_test_root();
	struct stat st;

	zassert_ok(unlinkat(dirfd, "empty.txt", 0));
	errno = 0;
	zassert_equal(fstatat(dirfd, "empty.txt", &st, 0), -1);
	zassert_equal(errno, ENOENT);

	/* a directory needs AT_REMOVEDIR, and must be empty */
	errno = 0;
	zassert_equal(unlinkat(dirfd, "dir", 0), -1);
	zassert_true(errno == EISDIR || errno == EPERM, "errno %d", errno);
	zassert_ok(unlinkat(dirfd, "dir/sub.txt", 0));
	zassert_ok(unlinkat(dirfd, "dir", AT_REMOVEDIR));
	errno = 0;
	zassert_equal(fstatat(dirfd, "dir", &st, 0), -1);
	zassert_equal(errno, ENOENT);

	errno = 0;
	zassert_equal(unlinkat(dirfd, "file.txt", AT_REMOVEDIR), -1);
	zassert_equal(errno, ENOTDIR);

	errno = 0;
	zassert_equal(unlinkat(dirfd, "nope.txt", 0), -1);
	zassert_equal(errno, ENOENT);

	zassert_ok(close(dirfd));
}
```

## src/utimensat.c
```c
/*
 * SPDX-FileCopyrightText: Copyright The Zephyr Project Contributors
 * SPDX-License-Identifier: Apache-2.0
 */

#include "file_system_fd_common.h"

#include <errno.h>
#include <sys/stat.h>
#include <time.h>
#include <unistd.h>

/* a nanosecond count that is neither a marker nor within a second is refused before any file system call */
static void utimensat_invalid(int dirfd)
{
	struct timespec times[2] = {
		{.tv_sec = 1700000000, .tv_nsec = 0},
		{.tv_sec = 1700000000, .tv_nsec = 1000000000L},
	};

	errno = 0;
	zassert_equal(utimensat(dirfd, "file.txt", times, 0), -1);
	zassert_equal(errno, EINVAL, "errno %d", errno);
	times[1].tv_nsec = 0;
	times[0].tv_nsec = -3;
	errno = 0;
	zassert_equal(utimensat(dirfd, "file.txt", times, 0), -1);
	zassert_equal(errno, EINVAL, "errno %d", errno);
}

#ifndef CONFIG_NATIVE_LIBC
/* an omitted timestamp is left as it is, under the file system's lock */
static void utimensat_omit(void)
{
	const struct timespec set[2] = {{.tv_sec = 1700000000}, {.tv_sec = 1700000100}};
	const struct timespec now_omit[2] = {{.tv_nsec = UTIME_NOW}, {.tv_nsec = UTIME_OMIT}};
	struct stat st;

	zassert_ok(utimensat(AT_FDCWD, TEST_TMPFS_FILE, set, 0));
	zassert_ok(utimensat(AT_FDCWD, TEST_TMPFS_FILE, now_omit, 0));
	zassert_ok(stat(TEST_TMPFS_FILE, &st));
	zassert_equal(st.st_mtim.tv_sec, set[1].tv_sec, "the omitted mtime changed");
	zassert_not_equal(st.st_atim.tv_sec, set[0].tv_sec, "atime was not set to now");
}

/* AT_SYMLINK_NOFOLLOW never stamps the link's target: the link itself, or an error */
static void utimensat_nofollow(void)
{
	const struct timespec set[2] = {{.tv_sec = 1700000000}, {.tv_sec = 1700000000}};
	const struct timespec other[2] = {{.tv_sec = 1600000000}, {.tv_sec = 1600000000}};
	struct stat st;
	int rc;

	zassert_ok(utimensat(AT_FDCWD, TEST_TMPFS_FILE, set, 0));

	errno = 0;
	rc = utimensat(AT_FDCWD, TEST_TMPFS_LINK, other, AT_SYMLINK_NOFOLLOW);
	zassert_true((rc == 0) || (errno == EOPNOTSUPP) || (errno == ENOTSUP), "errno %d", errno);
	errno = 0;
	rc = utimensat(AT_FDCWD, TEST_TMPFS_LINK, NULL, AT_SYMLINK_NOFOLLOW);
	zassert_true((rc == 0) || (errno == EOPNOTSUPP) || (errno == ENOTSUP), "errno %d", errno);

	zassert_ok(stat(TEST_TMPFS_FILE, &st));
	zassert_equal(st.st_mtim.tv_sec, set[1].tv_sec, "the link's target was stamped");
	zassert_equal(st.st_atim.tv_sec, set[0].tv_sec, "the link's target was stamped");
}
#endif /* !CONFIG_NATIVE_LIBC */

ZTEST_USER(posix_file_system_fd, test_utimensat)
{
	int dirfd = open_test_root();
	struct timespec times[2] = {
		{.tv_sec = 1700000000, .tv_nsec = 0},
		{.tv_sec = 1700000000, .tv_nsec = 0},
	};
	int rc;

	rc = utimensat(dirfd, "file.txt", times, 0);
	if (rc < 0) {
		/* backends without timestamp support report ENOTSUP */
		zassert_equal(errno, ENOTSUP, "errno %d", errno);
	}

	/* the UTIME_NOW and UTIME_OMIT markers are honored, or unsupported */
	times[0].tv_nsec = UTIME_NOW;
	times[1].tv_nsec = UTIME_OMIT;
	rc = utimensat(dirfd, "file.txt", times, 0);
	if (rc < 0) {
		zassert_equal(errno, ENOTSUP, "errno %d", errno);
	}

	rc = utimensat(AT_FDCWD, TEST_FILE, NULL, 0);
	if (rc < 0) {
		zassert_equal(errno, ENOTSUP, "errno %d", errno);
	}

	errno = 0;
	zassert_equal(utimensat(dirfd, "nope.txt", NULL, 0), -1);
	zassert_true(errno == ENOENT || errno == ENOTSUP, "errno %d", errno);

	utimensat_invalid(dirfd);
#ifndef CONFIG_NATIVE_LIBC
	utimensat_omit();
	if (IS_ENABLED(CONFIG_FILE_SYSTEM_SYMLINKS)) {
		utimensat_nofollow();
	}
#endif /* !CONFIG_NATIVE_LIBC */

	zassert_ok(close(dirfd));
}
```
