## CMakeLists.txt
```
# SPDX-License-Identifier: Apache-2.0

cmake_minimum_required(VERSION 3.20.0)
find_package(Zephyr REQUIRED HINTS $ENV{ZEPHYR_BASE})
project(posix_job_control)

FILE(GLOB app_sources src/*.c)
target_sources(app PRIVATE ${app_sources} ../shared/tty_fixture.c)

target_compile_options(app PRIVATE -U_POSIX_C_SOURCE -D_POSIX_C_SOURCE=200809L)
target_compile_options(app PRIVATE -U_XOPEN_SOURCE -D_XOPEN_SOURCE=700)
```

## prj.conf
```kconfig
CONFIG_ZTEST=y

CONFIG_POSIX_AEP_CHOICE_BASE=y
CONFIG_POSIX_MULTI_PROCESS=y
CONFIG_POSIX_SIGNALS=y
CONFIG_POSIX_JOB_CONTROL=y
```

## src/main.c
```c
/*
 * SPDX-FileCopyrightText: Copyright The Zephyr Project Contributors
 * SPDX-License-Identifier: Apache-2.0
 */

#include "job_control_tests.h"

#include "../../shared/tty_fixture.h"

ZTEST_BMEM int tty_test_fd = -1;

static void *setup(void)
{
	tty_test_fd = posix_test_tty_open(true);

	return NULL;
}

static void teardown(void *arg)
{
	ARG_UNUSED(arg);

	posix_test_tty_close();
}

ZTEST_SUITE(posix_job_control, NULL, setup, NULL, NULL, teardown);
```

## src/job_control_tests.h
```c
/*
 * SPDX-FileCopyrightText: Copyright The Zephyr Project Contributors
 * SPDX-License-Identifier: Apache-2.0
 */

#ifndef POSIX_TESTS_JOB_CONTROL_TESTS_H_
#define POSIX_TESTS_JOB_CONTROL_TESTS_H_

#include <zephyr/ztest.h>

#include "../../shared/linux_compat_test.h"

/* the controlling terminal under test */
extern int tty_test_fd;

#endif /* POSIX_TESTS_JOB_CONTROL_TESTS_H_ */
```

## src/setpgid.c
```c
/*
 * Copyright The Zephyr Project Contributors
 *
 * SPDX-License-Identifier: Apache-2.0
 */

#include <errno.h>
#include <sys/wait.h>
#include <unistd.h>

#include <zephyr/kernel.h>
#include <zephyr/sys/process.h>
#include <zephyr/ztest.h>

#ifndef CONFIG_USERSPACE
#define SETPGID_CHILD_STACK_SIZE 1024

static K_THREAD_STACK_DEFINE(setpgid_child_stack, SETPGID_CHILD_STACK_SIZE);
static struct k_thread setpgid_child_thread;

static void setpgid_child_entry(void *p1, void *p2, void *p3)
{
	ARG_UNUSED(p1);
	ARG_UNUSED(p2);
	ARG_UNUSED(p3);

	_exit(0);
}

/*
 * The positive paths need a target that is not a session leader: a paused
 * child, whose group the parent may set until it execs (POSIX).
 */
static void setpgid_child_group(void)
{
	int status = -1;
	k_pid_t child = NULL;
	pid_t cpid;
	struct sys_clone_args args = {
		.flags = SYS_CLONE_PAUSED,
		.entry = setpgid_child_entry,
		.thread = &setpgid_child_thread,
		.stack = setpgid_child_stack,
		.stack_size = SETPGID_CHILD_STACK_SIZE,
		.prio = k_thread_priority_get(k_current_get()),
	};

	zassert_ok(sys_clone(&args, &child));
	cpid = (pid_t)sys_process_id(child);
	zassert_true(cpid > 0);

	/* the child starts in its parent's group */
	zassert_equal(getpgid(cpid), getpgrp());

	/* pgid == pid creates a new group led by the target */
	zassert_ok(setpgid(cpid, cpid));
	zassert_equal(getpgid(cpid), cpid);

	/* any other group must already exist */
	errno = 0;
	zexpect_equal(setpgid(cpid, cpid + 1), -1);
	zexpect_equal(errno, EPERM);

	/* and an existing group in the same session may be joined */
	zassert_ok(setpgid(cpid, getpgrp()));
	zassert_equal(getpgid(cpid), getpgrp());

	k_thread_start((k_tid_t)child);
	zassert_equal(waitpid(cpid, &status, 0), cpid);
	zassert_true(WIFEXITED(status));
	zassert_equal(WEXITSTATUS(status), 0);
}
#endif /* !CONFIG_USERSPACE */

ZTEST_USER(posix_job_control, test_setpgid)
{
	/* a negative process or group id is invalid */
	errno = 0;
	zexpect_equal(setpgid(-1, 0), -1);
	zexpect_equal(errno, EINVAL);

	errno = 0;
	zexpect_equal(setpgid(0, -1), -1);
	zexpect_equal(errno, EINVAL);

	if (!IS_ENABLED(CONFIG_NATIVE_LIBC)) {
		pid_t self = getpid();

		/* a nonexistent pid is ESRCH; on the host self + 1 may be a live process */
		errno = 0;
		zexpect_equal(setpgid(self + 1, 0), -1);
		zexpect_equal(errno, ESRCH);

		/* pid 0 names the caller; a nonexistent foreign group is EPERM */
		errno = 0;
		zexpect_equal(setpgid(0, self + 1), -1);
		zexpect_equal(errno, EPERM);
	}

#ifndef CONFIG_USERSPACE
	if (!IS_ENABLED(CONFIG_NATIVE_LIBC) && !k_is_user_context()) {
		setpgid_child_group();
	}
#endif /* !CONFIG_USERSPACE */
}
```

## src/tcgetpgrp.c
```c
/*
 * SPDX-FileCopyrightText: Copyright The Zephyr Project Contributors
 * SPDX-License-Identifier: Apache-2.0
 */

#include "job_control_tests.h"

#include <errno.h>
#include <unistd.h>

ZTEST_USER(posix_job_control, test_tcgetpgrp)
{
	pid_t pgrp = tcgetpgrp(tty_test_fd);

	/* with no foreground process group, a positive value naming no group; else the group */
	zassert_true(pgrp > 1, "%d", (int)pgrp);
	IF_NOT_NATIVE_LIBC({
		zassert_equal(tcgetpgrp(STDOUT_FILENO), pgrp);
	});

	zassert_ok(tcsetpgrp(tty_test_fd, getpgrp()));
	zassert_equal(tcgetpgrp(tty_test_fd), getpgrp());

	errno = 0;
	zassert_equal(tcgetpgrp(-1), -1);
	zassert_equal(errno, EBADF);
}
```

## src/tcgetsid.c
```c
/*
 * SPDX-FileCopyrightText: Copyright The Zephyr Project Contributors
 * SPDX-License-Identifier: Apache-2.0
 */

#include "job_control_tests.h"

#include <errno.h>
#include <termios.h>
#include <unistd.h>

ZTEST_USER(posix_job_control, test_tcgetsid)
{
	pid_t sid = tcgetsid(tty_test_fd);

	zassert_true(sid > 0, "%d", (int)sid);
	zassert_equal(sid, getsid(0));
	IF_NOT_NATIVE_LIBC({
		zassert_equal(tcgetsid(STDOUT_FILENO), sid);
	});

	errno = 0;
	zassert_equal(tcgetsid(-1), -1);
	zassert_equal(errno, EBADF);
}
```

## src/tcsetpgrp.c
```c
/*
 * SPDX-FileCopyrightText: Copyright The Zephyr Project Contributors
 * SPDX-License-Identifier: Apache-2.0
 */

#include "job_control_tests.h"

#include <errno.h>
#include <unistd.h>

ZTEST_USER(posix_job_control, test_tcsetpgrp)
{
	pid_t self = getpgrp();

	zassert_ok(tcsetpgrp(tty_test_fd, self));
	zassert_equal(tcgetpgrp(tty_test_fd), self);

	/* a group id must be positive (the host looks 0 up as a group and finds none) */
	errno = 0;
	zassert_equal(tcsetpgrp(tty_test_fd, 0), -1);
	zassert_true((errno == EINVAL) || (IS_ENABLED(CONFIG_NATIVE_LIBC) && (errno == ESRCH)),
		     "%d", errno);
	errno = 0;
	zassert_equal(tcsetpgrp(tty_test_fd, -1), -1);
	zassert_equal(errno, EINVAL);

	/* and name a process group in the caller's session (the host says ESRCH for none at all) */
	errno = 0;
	zassert_equal(tcsetpgrp(tty_test_fd, self + 1), -1);
	zassert_true((errno == EPERM) || (IS_ENABLED(CONFIG_NATIVE_LIBC) && (errno == ESRCH)), "%d",
		     errno);
	zassert_equal(tcgetpgrp(tty_test_fd), self);

	errno = 0;
	zassert_equal(tcsetpgrp(-1, self), -1);
	zassert_equal(errno, EBADF);
}
```
