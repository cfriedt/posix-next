## lib/posix/options/xsi_advanced_realtime_threads/Kconfig
```kconfig
# Copyright (c) The Zephyr Project Contributors
#
# SPDX-License-Identifier: Apache-2.0

config XSI_ADVANCED_REALTIME_THREADS
	bool "X/Open Advanced Realtime Threads"
	depends on XSI
	select XSI_REALTIME_THREADS
	select POSIX_THREAD_CPUTIME
	help
	  Select 'y' here to enable the XSI Advanced Realtime Threads option group.

	  An implementation that claims conformance to this option group shall also
	  support the Realtime Threads option group
	  (:kconfig:option:`CONFIG_XSI_REALTIME_THREADS`).

	  This option group consists of the following options:

	  _POSIX_THREAD_CPUTIME and _POSIX_THREAD_SPORADIC_SERVER.

	  _POSIX_THREAD_SPORADIC_SERVER is not yet implemented in Zephyr.

	  If _POSIX_THREAD_SPORADIC_SERVER is supported, _POSIX_THREAD_PRIORITY_SCHEDULING
	  is also required (provided via :kconfig:option:`CONFIG_XSI_REALTIME_THREADS`).

	  For more information, please see
	  https://pubs.opengroup.org/onlinepubs/9699919799/basedefs/V1_chap02.html
```

## lib/posix/options/xsi_realtime_threads/Kconfig
```kconfig
# Copyright (c) The Zephyr Project Contributors
#
# SPDX-License-Identifier: Apache-2.0

config XSI_REALTIME_THREADS
	bool "X/Open Realtime Threads"
	depends on XSI
	select POSIX_THREAD_PRIO_INHERIT
	select POSIX_THREAD_PRIO_PROTECT
	select POSIX_THREAD_PRIORITY_SCHEDULING
	help
	  Select 'y' here to enable the XSI Realtime Threads option group.

	  This option group consists of the following options:

	  _POSIX_THREAD_PRIO_INHERIT, _POSIX_THREAD_PRIO_PROTECT,
	  _POSIX_THREAD_PRIORITY_SCHEDULING, _POSIX_THREAD_ROBUST_PRIO_INHERIT, and
	  _POSIX_THREAD_ROBUST_PRIO_PROTECT.

	  _POSIX_THREAD_ROBUST_PRIO_INHERIT and _POSIX_THREAD_ROBUST_PRIO_PROTECT are
	  not yet implemented in Zephyr.

	  When this option group is enabled, the _XOPEN_REALTIME_THREADS feature test
	  macro will be defined to a value other than -1.

	  For more information, please see
	  https://pubs.opengroup.org/onlinepubs/9699919799/basedefs/V1_chap02.html
```

## lib/posix/options/xsi_single_process/Kconfig
```kconfig
# Copyright (c) 2024 Tenstorrent AI ULC
#
# SPDX-License-Identifier: Apache-2.0

config XSI_SINGLE_PROCESS
	bool "X/Open single process"
	depends on XSI
	select HWINFO
	help
	  Select 'y' here and Zephyr will provide implementations of
	  gethostid(), gettimeofday(), and putenv().

module = XSI_SINGLE_PROCESS
module-str = XSI Single Process
source "subsys/logging/Kconfig.template.log_config"
```

## lib/posix/options/xsi_streams/Kconfig
```kconfig
# Copyright (c) 2024 Tenstorrent AI ULC
#
# SPDX-License-Identifier: Apache-2.0

config XSI_STREAMS
	bool "X/Open streams"
	depends on XSI
	help
	  This option provides support for the X/Open Streams interface, including functions such as
	  fattach(), fdetach(), getmsg(), getpmsg(), putmsg(), and putpmsg().

config XOPEN_STREAMS
	bool "X/Open Streams [DEPRECATED]"
	depends on XSI
	select XSI_STREAMS
	select DEPRECATED
	help
	  This option is deprecated. Please use XSI_STREAMS instead.
```

## lib/posix/options/xsi_system_logging/Kconfig
```kconfig
# Copyright (c) 2024 Tenstorrent AI ULC
#
# SPDX-License-Identifier: Apache-2.0

config XSI_SYSTEM_LOGGING
	bool "X/Open system logging"
	help
	  This option provides support for closelog(), openlog(), syslog(),
	  setlogmask(), and vsyslog().
```

## lib/posix/options/xsi_threads_ext/Kconfig
```kconfig
# Copyright (c) The Zephyr Project Contributors
#
# SPDX-License-Identifier: Apache-2.0

config XSI_THREADS_EXT
	bool "X/Open threads extensions"
	depends on XSI
	help
	  Select 'y' here to enable the XSI Threads Extensions option group.

	  When this option is enabled, the following functions are available:
	  pthread_attr_getguardsize(), pthread_attr_setguardsize(),
	  pthread_getconcurrency(), pthread_setconcurrency().

	  For more information, please see
	  https://pubs.opengroup.org/onlinepubs/009604299/xrat/subprofiles.html
```

## lib/posix/threads_ext/Kconfig
```kconfig
# Copyright (c) 2018 Intel Corporation
# Copyright (c) 2023 Meta
# Copyright (c) 2025, Friedt Professional Engineering Services, Inc.
#
# SPDX-License-Identifier: Apache-2.0

config POSIX_THREADS_EXT
	bool "Extended POSIX thread support"
	depends on POSIX_THREADS
	help
	  Enable this option to use pthread_attr_getguardsize(), pthread_attr_setguardsize(),
	  pthread_mutexattr_gettype(), or pthread_mutexattr_settype().
```

## lib/posix/xsi/Kconfig
```kconfig
# Copyright (c) The Zephyr Project Contributors
#
# SPDX-License-Identifier: Apache-2.0

# Note: implied options have changed over the years. Most are now mandatory system interfaces.
# https://pubs.opengroup.org/onlinepubs/009695399/basedefs/xbd_chap02.html
# https://pubs.opengroup.org/onlinepubs/9799919799/basedefs/V1_chap02.html

menuconfig XSI
	bool "X/Open System Interfaces (XSI)"
	select POSIX_FSYNC
	select POSIX_THREAD_ATTR_STACKADDR
	select POSIX_THREAD_ATTR_STACKSIZE
	help
	  Select 'y' to support X/Open System Interfaces (XSI).

	  When this option group is enabled, the _XOPEN_UNIX feature test
	  macro will be defined to a value other than -1.
```

## samples/posix/uname/sample.yaml
```yaml
sample:
  description: posix uname sample
  name: posix uname
common:
  tags:
    - posix_single_process
  integration_platforms:
    - native_sim
    - qemu_riscv64
  harness: console
  harness_config:
    type: multi_line
    ordered: true
    regex:
      - "sysname\\[7\\]: Zephyr"
      - "nodename\\[\\d+\\]: .*"
      - "release\\[\\d+\\]: \\d+\\.\\d+\\.\\d+"
      - "version\\[\\d+\\]: .*"
      - "machine\\[\\d+\\]: .*"
tests:
  sample.posix.uname: {}
```

## tests/posix/Kconfig.test_common
```kconfig
config SYS_THREAD_CONDVAR_MIN_ADD_TEST
	int "Number of condition variables guaranteed to be available for POSIX tests"
	default 0
	help
	  This option is mainly intended to allow us to verify that the specified minimum number
	  of condition variables are in fact statically allocated and available to the application.
	  CMake (rather than Kconfig) outputs the guaranteed minimum value as SYS_THREAD_CONDVAR_MIN
	  (rather than CONFIG_SYS_THREAD_CONDVAR_MIN) for technical reasons.

config SYS_THREAD_MUTEX_MIN_ADD_TEST
	int "Number of mutexes guaranteed to be available for POSIX tests"
	default 0
	help
	  This option is mainly intended to allow us to verify that the specified minimum number
	  of mutexes are in fact statically allocated and available to the application.
	  CMake (rather than Kconfig) outputs the guaranteed minimum value as SYS_THREAD_MUTEX_MIN
	  (rather than CONFIG_SYS_THREAD_MUTEX_MIN) for technical reasons.

config SYS_THREAD_STACK_MIN_ADD_TEST
	int "Number of thread stacks guaranteed to be available for POSIX tests"
	default 0
	help
	  This option is mainly intended to allow us to verify that the specified minimum number
	  of stacks are in fact statically allocated and available to the application.
	  CMake (rather than Kconfig) outputs the guaranteed minimum value as SYS_THREAD_STACK_MIN
	  (rather than CONFIG_SYS_THREAD_STACK_MIN) for technical reasons.

config SYS_THREAD_THREAD_MIN_ADD_TEST
	int "Number of threads guaranteed to be available for POSIX tests"
	default 0
	help
	  This option is mainly intended to allow us to verify that the specified minimum number
	  of threads are in fact statically allocated and available to the application.
	  CMake (rather than Kconfig) outputs the guaranteed minimum value as SYS_THREAD_THREAD_MIN
	  (rather than CONFIG_SYS_THREAD_THREAD_MIN) for technical reasons.

if POSIX_TEST_LINUX_COMPAT

# To support verifying the testsuites work against the native libc in linux_compat configurations
config NATIVE_LIBC
	bool
	select FULL_LIBC_SUPPORTED
	# zephyr-keep-sorted-start
	select TC_PROVIDES_EVENTFD
	select TC_PROVIDES_POSIX_ASYNCHRONOUS_IO
	select TC_PROVIDES_POSIX_BARRIERS
	select TC_PROVIDES_POSIX_CLOCK_SELECTION
	select TC_PROVIDES_POSIX_C_LANG_SUPPORT_R
	select TC_PROVIDES_POSIX_C_LIB_EXT
	select TC_PROVIDES_POSIX_DEVICE_IO
	select TC_PROVIDES_POSIX_FD_MGMT
	select TC_PROVIDES_POSIX_FILE_LOCKING
	select TC_PROVIDES_POSIX_FILE_SYSTEM
	select TC_PROVIDES_POSIX_FILE_SYSTEM_R
	select TC_PROVIDES_POSIX_FSYNC
	select TC_PROVIDES_POSIX_MAPPED_FILES
	select TC_PROVIDES_POSIX_MEMLOCK
	select TC_PROVIDES_POSIX_MEMLOCK_RANGE
	select TC_PROVIDES_POSIX_MEMORY_PROTECTION
	select TC_PROVIDES_POSIX_MESSAGE_PASSING
	select TC_PROVIDES_POSIX_MULTI_PROCESS
	select TC_PROVIDES_POSIX_NETWORKING
	select TC_PROVIDES_POSIX_NON_PORTABLE
	select TC_PROVIDES_POSIX_PRIORITY_SCHEDULING
	select TC_PROVIDES_POSIX_REALTIME_SIGNALS
	select TC_PROVIDES_POSIX_RW_LOCKS
	select TC_PROVIDES_POSIX_SEMAPHORES
	select TC_PROVIDES_POSIX_SHARED_MEMORY_OBJECTS
	select TC_PROVIDES_POSIX_SIGNALS
	select TC_PROVIDES_POSIX_SIGNALS_EXT
	select TC_PROVIDES_POSIX_SINGLE_PROCESS
	select TC_PROVIDES_POSIX_SPIN_LOCKS
	select TC_PROVIDES_POSIX_SYNCHRONIZED_IO
	select TC_PROVIDES_POSIX_SYSTEM_DATABASE
	select TC_PROVIDES_POSIX_SYSTEM_DATABASE_R
	select TC_PROVIDES_POSIX_THREAD_PRIORITY_SCHEDULING
	select TC_PROVIDES_POSIX_THREADS
	select TC_PROVIDES_POSIX_THREADS_EXT
	select TC_PROVIDES_POSIX_TIMERS
	select TC_PROVIDES_XSI_ADVANCED_REALTIME
	select TC_PROVIDES_XSI_ADVANCED_REALTIME_THREADS
	select TC_PROVIDES_XSI_REALTIME_THREADS
	select TC_PROVIDES_XSI_STREAMS
	select TC_PROVIDES_XSI_THREADS_EXT
	# zephyr-keep-sorted-stop

endif
```

## tests/posix/c_lang_support_r/testcase.yaml
```yaml
common:
  tags:
    - posix_c_lang_support_r
  platform_key:
    - arch
    - simulation
tests:
  portability.posix.c_lang_support_r:
    filter: not CONFIG_NATIVE_LIBC
    extra_configs:
      - CONFIG_MINIMAL_LIBC=y
  portability.posix.c_lang_support_r.no_strerror_table:
    filter: not CONFIG_NATIVE_LIBC
    extra_configs:
      - CONFIG_MINIMAL_LIBC=y
      - CONFIG_MINIMAL_LIBC_STRING_ERROR_TABLE=n
  portability.posix.c_lang_support_r.armclang_std_libc:
    filter: not CONFIG_NATIVE_LIBC
    toolchain_allow: armclang
    extra_configs:
      - CONFIG_ARMCLANG_STD_LIBC=y
  portability.posix.c_lang_support_r.arcmwdtlib:
    filter: not CONFIG_NATIVE_LIBC
    toolchain_allow: arcmwdt
    extra_configs:
      - CONFIG_ARCMWDT_LIBC=y
  portability.posix.c_lang_support_r.newlib:
    filter: (not CONFIG_NATIVE_LIBC) and (TOOLCHAIN_HAS_NEWLIB == 1)
    extra_configs:
      - CONFIG_NEWLIB_LIBC=y
  portability.posix.c_lang_support_r.picolibc:
    tags: picolibc
    filter: (not CONFIG_NATIVE_LIBC) and CONFIG_PICOLIBC_SUPPORTED
    extra_configs:
      - CONFIG_PICOLIBC=y
  portability.posix.c_lang_support_r.linux_compat:
    tags: native
    platform_allow:
      - native_sim
      - native_sim/native/64
    filter: CONFIG_NATIVE_LIBC
    extra_configs:
      - CONFIG_POSIX_TEST_LINUX_COMPAT=y
```

## tests/posix/device_io/testcase.yaml
```yaml
common:
  tags:
    - posix_device_io
  min_ram: 128
  modules:
    - fatfs
  platform_key:
    - arch
    - simulation
tests:
  portability.posix.device_io:
    filter: not CONFIG_NATIVE_LIBC
  portability.posix.device_io.minimal:
    filter: not CONFIG_NATIVE_LIBC
    extra_configs:
      - CONFIG_MINIMAL_LIBC=y
  portability.posix.device_io.newlib:
    filter: (not CONFIG_NATIVE_LIBC) and (TOOLCHAIN_HAS_NEWLIB == 1)
    extra_configs:
      - CONFIG_NEWLIB_LIBC=y
  portability.posix.device_io.picolibc:
    tags: picolibc
    filter: (not CONFIG_NATIVE_LIBC) and CONFIG_PICOLIBC_SUPPORTED
    extra_configs:
      - CONFIG_PICOLIBC=y
  portability.posix.device_io.linux_compat:
    tags: native
    platform_allow:
      - native_sim
      - native_sim/native/64
    filter: CONFIG_NATIVE_LIBC
    extra_configs:
      - CONFIG_POSIX_AEP_CHOICE_PSE51=y
      - CONFIG_POSIX_TEST_LINUX_COMPAT=y
      - CONFIG_ZVFS_OPEN_MAX=15
```

## tests/posix/fd_mgmt/testcase.yaml
```yaml
common:
  tags:
    - posix_fd_mgmt
  modules:
    - fatfs
  platform_key:
    - arch
    - simulation
  min_ram: 32
tests:
  portability.posix.fd_mgmt:
    filter: not CONFIG_NATIVE_LIBC
  portability.posix.fd_mgmt.minimal:
    filter: not CONFIG_NATIVE_LIBC
    extra_configs:
      - CONFIG_MINIMAL_LIBC=y
  portability.posix.fd_mgmt.newlib:
    filter: (not CONFIG_NATIVE_LIBC) and (TOOLCHAIN_HAS_NEWLIB == 1)
    extra_configs:
      - CONFIG_NEWLIB_LIBC=y
  portability.posix.fd_mgmt.picolibc:
    tags: picolibc
    filter: (not CONFIG_NATIVE_LIBC) and CONFIG_PICOLIBC_SUPPORTED
    extra_configs:
      - CONFIG_PICOLIBC=y
  portability.posix.fd_mgmt.linux_compat:
    tags: native
    platform_allow:
      - native_sim
      - native_sim/native/64
    filter: CONFIG_NATIVE_LIBC
    extra_configs:
      - CONFIG_POSIX_AEP_CHOICE_PSE51=y
      - CONFIG_POSIX_TEST_LINUX_COMPAT=y
      - CONFIG_ZVFS_OPEN_MAX=15
```

## tests/posix/file_locking/testcase.yaml
```yaml
common:
  tags:
    - posix
    - posix_file_locking
  # 1 tier0 platform per supported architecture
  platform_key:
    - arch
    - simulation
  min_flash: 64
  min_ram: 32
tests:
  portability.posix.file_locking:
    filter: not CONFIG_NATIVE_LIBC
  portability.posix.file_locking.minimal:
    filter: not CONFIG_NATIVE_LIBC
    extra_configs:
      - CONFIG_MINIMAL_LIBC=y
  portability.posix.file_locking.newlib:
    filter: (not CONFIG_NATIVE_LIBC) and (TOOLCHAIN_HAS_NEWLIB == 1)
    extra_configs:
      - CONFIG_NEWLIB_LIBC=y
  portability.posix.file_locking.picolibc:
    tags: picolibc
    filter: (not CONFIG_NATIVE_LIBC) and CONFIG_PICOLIBC_SUPPORTED
    extra_configs:
      - CONFIG_PICOLIBC=y
  portability.posix.file_locking.linux_compat:
    tags: native
    filter: CONFIG_NATIVE_LIBC
    extra_configs:
      - CONFIG_POSIX_TEST_LINUX_COMPAT=y
      - CONFIG_ZVFS_OPEN_MAX=7
```

## tests/posix/networking/testcase.yaml
```yaml
common:
  depends_on: netif
  min_ram: 16
  tags:
    - iface
    - net
    - posix_networking
  # dependent on netif support
  integration_platforms:
    - mps2/an385
    - qemu_x86
  # Building with the host libC links to if_*() from the host libc which causes the test to crash
  # immediately.
  filter: not CONFIG_NATIVE_LIBC
tests:
  portability.posix.networking:
    extra_configs:
      - CONFIG_COMMON_LIBC_MALLOC_ARENA_SIZE=256
  portability.posix.networking.armclang_std_libc:
    toolchain_allow: armclang
    extra_configs:
      - CONFIG_ARMCLANG_STD_LIBC=y
  portability.posix.networking.arcmwdtlib:
    toolchain_allow: arcmwdt
    extra_configs:
      - CONFIG_ARCMWDT_LIBC=y
  portability.posix.networking.minimal:
    extra_configs:
      - CONFIG_MINIMAL_LIBC=y
      - CONFIG_COMMON_LIBC_MALLOC_ARENA_SIZE=256
  portability.posix.networking.newlib:
    filter: TOOLCHAIN_HAS_NEWLIB == 1
    extra_configs:
      - CONFIG_NEWLIB_LIBC=y
  portability.posix.networking.picolibc:
    tags: picolibc
    filter: CONFIG_PICOLIBC_SUPPORTED
    extra_configs:
      - CONFIG_PICOLIBC=y
```

## tests/posix/realtime_signals/testcase.yaml
```yaml
common:
  tags:
    - posix
    - posix_realtime_signals
  platform_key:
    - arch
    - simulation
  platform_exclude:
    # undefined reference to `bootutil_key_cnt'
    - mps2/an521/cpu0/ns
  min_flash: 64
  min_ram: 32
tests:
  portability.posix.posix_realtime_signals:
    filter: not CONFIG_NATIVE_LIBC
  portability.posix.posix_realtime_signals.userspace:
    filter: (not CONFIG_NATIVE_LIBC) and CONFIG_ARCH_SUPPORTS_USERSPACE_SIGNALS
    tags: userspace
    extra_configs:
      - CONFIG_TEST_USERSPACE=y
      - CONFIG_USERSPACE=y
  portability.posix.posix_realtime_signals.minimal:
    filter: not CONFIG_NATIVE_LIBC
    extra_configs:
      - CONFIG_MINIMAL_LIBC=y
  portability.posix.posix_realtime_signals.newlib:
    filter: (not CONFIG_NATIVE_LIBC) and (TOOLCHAIN_HAS_NEWLIB == 1)
    extra_configs:
      - CONFIG_NEWLIB_LIBC=y
  portability.posix.posix_realtime_signals.picolibc:
    tags: picolibc
    filter: (not CONFIG_NATIVE_LIBC) and CONFIG_PICOLIBC_SUPPORTED
    extra_configs:
      - CONFIG_PICOLIBC=y
```
