## CMakeLists.txt
```
# SPDX-License-Identifier: Apache-2.0

cmake_minimum_required(VERSION 3.20.0)
find_package(Zephyr REQUIRED HINTS $ENV{ZEPHYR_BASE})
project(posix_regexp)

target_sources(app PRIVATE
  src/main.c
  src/regcomp.c
  src/regerror.c
  src/regexec.c
  src/regfree.c
)

target_compile_options(app PRIVATE -U_POSIX_C_SOURCE -D_POSIX_C_SOURCE=200809L)
```

## prj.conf
```kconfig
CONFIG_ZTEST=y

CONFIG_POSIX_AEP_CHOICE_BASE=y
CONFIG_POSIX_REGEXP=y

CONFIG_COMMON_LIBC_MALLOC_ARENA_SIZE=16384
```

## src/main.c
```c
/*
 * SPDX-FileCopyrightText: Copyright The Zephyr Project Contributors
 * SPDX-License-Identifier: Apache-2.0
 */

#include <zephyr/ztest.h>

ZTEST_SUITE(posix_regexp, NULL, NULL, NULL, NULL, NULL);
```

## src/regcomp.c
```c
/*
 * SPDX-FileCopyrightText: Copyright The Zephyr Project Contributors
 * SPDX-License-Identifier: Apache-2.0
 */

#include <regex.h>

#include <zephyr/ztest.h>

static void regcomp_basic(void)
{
	regex_t re;

	zassert_ok(regcomp(&re, "a.c", 0));
	zassert_equal(re.re_nsub, 0);
	regfree(&re);

	/* BRE subexpressions are counted in re_nsub */
	zassert_ok(regcomp(&re, "\\(a*\\)b\\(c\\)", 0));
	zassert_equal(re.re_nsub, 2);
	regfree(&re);
}

static void regcomp_extended(void)
{
	regex_t re;

	zassert_ok(regcomp(&re, "(a|b)+c?", REG_EXTENDED));
	zassert_equal(re.re_nsub, 1);
	regfree(&re);

	zassert_ok(regcomp(&re, "^[[:alpha:]_][[:alnum:]_]*$", REG_EXTENDED));
	regfree(&re);
}

static void regcomp_nosub(void)
{
	regex_t re;

	zassert_ok(regcomp(&re, "(abc)", REG_EXTENDED | REG_NOSUB));
	zassert_ok(regexec(&re, "xxabcxx", 0, NULL, 0));
	regfree(&re);
}

static void regcomp_errors(void)
{
	regex_t re;

	zassert_equal(regcomp(&re, "[abc", REG_EXTENDED), REG_EBRACK);
	zassert_equal(regcomp(&re, "(abc", REG_EXTENDED), REG_EPAREN);
}

ZTEST(posix_regexp, test_regcomp)
{
	regcomp_basic();
	regcomp_extended();
	regcomp_nosub();
	regcomp_errors();
}
```

## src/regerror.c
```c
/*
 * SPDX-FileCopyrightText: Copyright The Zephyr Project Contributors
 * SPDX-License-Identifier: Apache-2.0
 */

#include <regex.h>
#include <string.h>

#include <zephyr/ztest.h>

static void regerror_reports_size(void)
{
	int err;
	size_t needed;
	regex_t re;
	char buf[128];

	err = regcomp(&re, "(abc", REG_EXTENDED);
	zassert_equal(err, REG_EPAREN);

	/* with errbuf_size 0, the return value is the size needed */
	needed = regerror(err, &re, NULL, 0);
	zassert_true(needed > 1);
	zassert_true(needed <= sizeof(buf));

	zassert_equal(regerror(err, &re, buf, sizeof(buf)), needed);
	zassert_equal(strlen(buf) + 1, needed);
}

static void regerror_truncates(void)
{
	regex_t re;
	char small[4];

	zassert_ok(regcomp(&re, "abc", 0));

	/* a too-small buffer yields a null-terminated truncated message */
	zassert_true(regerror(REG_NOMATCH, &re, small, sizeof(small)) > sizeof(small));
	zassert_equal(strlen(small), sizeof(small) - 1);
	regfree(&re);
}

ZTEST(posix_regexp, test_regerror)
{
	regerror_reports_size();
	regerror_truncates();
}
```

## src/regexec.c
```c
/*
 * SPDX-FileCopyrightText: Copyright The Zephyr Project Contributors
 * SPDX-License-Identifier: Apache-2.0
 */

#include <regex.h>

#include <zephyr/ztest.h>

static void regexec_literal(void)
{
	regex_t re;

	zassert_ok(regcomp(&re, "hello", 0));
	zassert_ok(regexec(&re, "say hello world", 0, NULL, 0));
	zassert_equal(regexec(&re, "goodbye", 0, NULL, 0), REG_NOMATCH);
	regfree(&re);
}

static void regexec_subexpressions(void)
{
	regex_t re;
	regmatch_t pmatch[3];

	zassert_ok(regcomp(&re, "([a-z]+)([0-9]+)", REG_EXTENDED));
	zassert_ok(regexec(&re, "__abc123def", ARRAY_SIZE(pmatch), pmatch, 0));

	/* leftmost-longest: the whole match and both captures */
	zassert_equal(pmatch[0].rm_so, 2);
	zassert_equal(pmatch[0].rm_eo, 8);
	zassert_equal(pmatch[1].rm_so, 2);
	zassert_equal(pmatch[1].rm_eo, 5);
	zassert_equal(pmatch[2].rm_so, 5);
	zassert_equal(pmatch[2].rm_eo, 8);
	regfree(&re);
}

static void regexec_icase(void)
{
	regex_t re;

	zassert_ok(regcomp(&re, "hello", REG_ICASE));
	zassert_ok(regexec(&re, "HeLLo", 0, NULL, 0));
	regfree(&re);
}

static void regexec_newline(void)
{
	regex_t re;

	zassert_ok(regcomp(&re, "^b", REG_EXTENDED));
	zassert_equal(regexec(&re, "a\nb", 0, NULL, 0), REG_NOMATCH);
	regfree(&re);

	zassert_ok(regcomp(&re, "^b", REG_EXTENDED | REG_NEWLINE));
	zassert_ok(regexec(&re, "a\nb", 0, NULL, 0));
	regfree(&re);
}

static void regexec_anchoring_eflags(void)
{
	regex_t re;

	zassert_ok(regcomp(&re, "^abc", REG_EXTENDED));
	zassert_ok(regexec(&re, "abc", 0, NULL, 0));
	zassert_equal(regexec(&re, "abc", 0, NULL, REG_NOTBOL), REG_NOMATCH);
	regfree(&re);

	zassert_ok(regcomp(&re, "abc$", REG_EXTENDED));
	zassert_ok(regexec(&re, "abc", 0, NULL, 0));
	zassert_equal(regexec(&re, "abc", 0, NULL, REG_NOTEOL), REG_NOMATCH);
	regfree(&re);
}

ZTEST(posix_regexp, test_regexec)
{
	regexec_literal();
	regexec_subexpressions();
	regexec_icase();
	regexec_newline();
	regexec_anchoring_eflags();
}
```

## src/regfree.c
```c
/*
 * SPDX-FileCopyrightText: Copyright The Zephyr Project Contributors
 * SPDX-License-Identifier: Apache-2.0
 */

#include <regex.h>

#include <zephyr/ztest.h>

static void regfree_releases(void)
{
	regex_t re;

	/* repeated compile/free cycles must not exhaust the heap */
	for (int i = 0; i < 32; i++) {
		zassert_ok(regcomp(&re, "(a|b)*c[[:digit:]]?", REG_EXTENDED));
		regfree(&re);
	}
}

static void regfree_recompile(void)
{
	regex_t re;

	zassert_ok(regcomp(&re, "first", 0));
	regfree(&re);

	/* a freed regex_t is reusable for a fresh compile */
	zassert_ok(regcomp(&re, "second", 0));
	zassert_ok(regexec(&re, "the second one", 0, NULL, 0));
	regfree(&re);
}

ZTEST(posix_regexp, test_regfree)
{
	regfree_releases();
	regfree_recompile();
}
```
