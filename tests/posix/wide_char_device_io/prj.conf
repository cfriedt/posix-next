## CMakeLists.txt
```
# SPDX-License-Identifier: Apache-2.0

cmake_minimum_required(VERSION 3.20.0)
find_package(Zephyr REQUIRED HINTS $ENV{ZEPHYR_BASE})
project(posix_wide_char_device_io)

FILE(GLOB app_sources src/*.c)
target_sources(app PRIVATE ${app_sources})

target_compile_options(app PRIVATE -U_POSIX_C_SOURCE -D_POSIX_C_SOURCE=200809L)
target_compile_options(app PRIVATE -U_XOPEN_SOURCE -D_XOPEN_SOURCE=700)
```

## prj.conf
```kconfig
CONFIG_ZTEST=y

CONFIG_POSIX_AEP_CHOICE_PSE52=y
CONFIG_POSIX_C_LANG_WIDE_CHAR=y

CONFIG_FILE_SYSTEM=y
CONFIG_FAT_FILESYSTEM_ELM=y

CONFIG_EVENTFD=n

# stdio (3) + the stream under test + the saved standard descriptor + scratch
CONFIG_ZVFS_OPEN_IGNORE_MIN=y
CONFIG_ZVFS_OPEN_MAX=12

CONFIG_MAIN_STACK_SIZE=4096
CONFIG_ZTEST_STACK_SIZE=4096
CONFIG_TEST_EXTRA_STACK_SIZE=4096

CONFIG_HEAP_MEM_POOL_SIZE=16384
CONFIG_COMMON_LIBC_MALLOC_ARENA_SIZE=16384
```

## src/main.c
```c
/*
 * SPDX-FileCopyrightText: Copyright The Zephyr Project Contributors
 * SPDX-License-Identifier: Apache-2.0
 */

#include "wide_char_device_io_tests.h"

#include <errno.h>
#include <fcntl.h>
#include <string.h>
#include <wchar.h>
#include <sys/stat.h>
#include <unistd.h>

#include <zephyr/kernel.h>
#ifndef CONFIG_NATIVE_LIBC
#include <ff.h>
#include <zephyr/fs/fs.h>
#endif
#ifdef CONFIG_USERSPACE
#include <zephyr/sys/fdtable.h>
#include <zephyr/sys/internal/fdtable_priv.h>
extern struct k_mem_partition zvfs_dir_partition;
#endif

#ifndef CONFIG_NATIVE_LIBC
static FATFS fat_fs;
static struct fs_mount_t fs_mnt = {
	.type = FS_FATFS,
	.mnt_point = "/",
	.fs_data = &fat_fs,
};
#endif

static ZTEST_BMEM int saved_in = -1;
static ZTEST_BMEM int saved_out = -1;
static ZTEST_BMEM wchar_t out_buf[64];

static void write_wide_file(const char *path, const wchar_t *content)
{
	FILE *f = fopen(path, "w");

	zassert_not_null(f, "fopen(%s) failed: %d", path, errno);
	zassert_true(fputws(content, f) >= 0);
	zassert_ok(fclose(f));
}

FILE *test_open_in(void)
{
	FILE *f = fopen(TEST_IN, "r");

	zassert_not_null(f, "fopen(" TEST_IN ") failed: %d", errno);
	return f;
}

FILE *test_open_out(void)
{
	FILE *f = fopen(TEST_OUT, "w");

	zassert_not_null(f, "fopen(" TEST_OUT ") failed: %d", errno);
	return f;
}

const wchar_t *test_read_out(void)
{
	FILE *f = fopen(TEST_OUT, "r");
	size_t n = 0;
	wint_t wc;

	zassert_not_null(f, "fopen(" TEST_OUT ") failed: %d", errno);
	while ((n < ARRAY_SIZE(out_buf) - 1) && ((wc = fgetwc(f)) != WEOF)) {
		out_buf[n++] = (wchar_t)wc;
	}
	out_buf[n] = L'\0';
	zassert_ok(fclose(f));

	return out_buf;
}

#ifdef CONFIG_USERSPACE
static void grant_fd(int fd)
{
	k_object_access_all_grant(zvfs_fd_entry_get(fd));
}
#endif

void test_swap_std_in(void)
{
	int fd = open(TEST_IN, O_RDONLY);

	zassert_true(fd >= 0, "open(" TEST_IN ") failed: %d", errno);
	saved_in = dup(STDIN_FILENO);
	zassert_true(saved_in >= 0);
	zassert_equal(dup2(fd, STDIN_FILENO), STDIN_FILENO);
	zassert_ok(close(fd));
}

void test_swap_std_out(void)
{
	int fd = open(TEST_OUT, O_WRONLY | O_TRUNC);

	zassert_true(fd >= 0, "open(" TEST_OUT ") failed: %d", errno);
	zassert_ok(fflush(stdout));
	saved_out = dup(STDOUT_FILENO);
	zassert_true(saved_out >= 0);
	zassert_equal(dup2(fd, STDOUT_FILENO), STDOUT_FILENO);
	zassert_ok(close(fd));
}

void test_restore_std(void)
{
	if (saved_out >= 0) {
		(void)fflush(stdout);
		(void)dup2(saved_out, STDOUT_FILENO);
		(void)close(saved_out);
		saved_out = -1;
	}
	if (saved_in >= 0) {
		(void)dup2(saved_in, STDIN_FILENO);
		(void)close(saved_in);
		saved_in = -1;
	}
}

static void before(void *arg)
{
	ARG_UNUSED(arg);

	/* ztest zeroes the test partition between user-mode tests */
	saved_in = -1;
	saved_out = -1;

	(void)mkdir(TEST_ROOT, 0777);
	write_wide_file(TEST_IN, TEST_CONTENT);
	write_wide_file(TEST_OUT, L"");
}

static void after(void *arg)
{
	ARG_UNUSED(arg);

	test_restore_std();
}

static void *setup(void)
{
#ifndef CONFIG_NATIVE_LIBC
	memset(&fat_fs, 0, sizeof(fat_fs));
	zassert_ok(fs_mount(&fs_mnt));
#endif
	(void)mkdir(FS_TMPDIR, 0777);
#ifdef CONFIG_USERSPACE
	zassert_ok(k_mem_domain_add_partition(&k_mem_domain_default, &zvfs_dir_partition));
	grant_fd(STDIN_FILENO);
	grant_fd(STDOUT_FILENO);
#endif
	return NULL;
}

static void teardown(void *arg)
{
	ARG_UNUSED(arg);

	(void)unlink(TEST_IN);
	(void)unlink(TEST_OUT);
	(void)rmdir(TEST_ROOT);
#ifndef CONFIG_NATIVE_LIBC
	(void)fs_unmount(&fs_mnt);
#endif
}

ZTEST_SUITE(posix_wide_char_device_io, NULL, setup, before, after, teardown);
```

## src/std.c
```c
/*
 * SPDX-FileCopyrightText: Copyright The Zephyr Project Contributors
 * SPDX-License-Identifier: Apache-2.0
 */

#include "wide_char_device_io_tests.h"

#include <stdarg.h>
#include <wchar.h>

/*
 * The standard streams are swapped onto files by descriptor. Orienting the
 * host's stdout would silence the harness, so these are Zephyr-only.
 */

ZTEST_USER(posix_wide_char_device_io, test_getwchar)
{
	posix_test_skip_if_native_libc();
	test_swap_std_in();

	zassert_equal(getwchar(), L'h');
	zassert_equal(getwchar(), L'e');
}

ZTEST_USER(posix_wide_char_device_io, test_wscanf)
{
	wchar_t word[8];
	int n;

	posix_test_skip_if_native_libc();
	test_swap_std_in();

	zassert_equal(wscanf(L"%7ls %d", word, &n), 2);
	zassert_equal(wcscmp(word, L"hello"), 0);
	zassert_equal(n, 42);
}

static int vwscanf_wrap(const wchar_t *fmt, ...)
{
	va_list ap;
	int ret;

	va_start(ap, fmt);
	ret = vwscanf(fmt, ap);
	va_end(ap);

	return ret;
}

ZTEST_USER(posix_wide_char_device_io, test_vwscanf)
{
	wchar_t word[8];
	int n;

	posix_test_skip_if_native_libc();
	test_swap_std_in();

	zassert_equal(vwscanf_wrap(L"%7ls %d", word, &n), 2);
	zassert_equal(wcscmp(word, L"hello"), 0);
	zassert_equal(n, 42);
}

ZTEST_USER(posix_wide_char_device_io, test_putwchar)
{
	posix_test_skip_if_native_libc();
	test_swap_std_out();

	zassert_equal(putwchar(L'a'), L'a');
	zassert_equal(putwchar(L'b'), L'b');
	test_restore_std();
	zassert_equal(wcscmp(test_read_out(), L"ab"), 0);
}

ZTEST_USER(posix_wide_char_device_io, test_wprintf)
{
	posix_test_skip_if_native_libc();
	test_swap_std_out();

	zassert_equal(wprintf(L"%d-%ls\n", 42, L"wide"), 8);
	test_restore_std();
	zassert_equal(wcscmp(test_read_out(), L"42-wide\n"), 0);
}

static int vwprintf_wrap(const wchar_t *fmt, ...)
{
	va_list ap;
	int ret;

	va_start(ap, fmt);
	ret = vwprintf(fmt, ap);
	va_end(ap);

	return ret;
}

ZTEST_USER(posix_wide_char_device_io, test_vwprintf)
{
	posix_test_skip_if_native_libc();
	test_swap_std_out();

	zassert_equal(vwprintf_wrap(L"%d-%ls\n", 42, L"wide"), 8);
	test_restore_std();
	zassert_equal(wcscmp(test_read_out(), L"42-wide\n"), 0);
}
```

## src/stream.c
```c
/*
 * SPDX-FileCopyrightText: Copyright The Zephyr Project Contributors
 * SPDX-License-Identifier: Apache-2.0
 */

#include "wide_char_device_io_tests.h"

#include <stdarg.h>
#include <wchar.h>

ZTEST_USER(posix_wide_char_device_io, test_fwide)
{
	FILE *f = test_open_in();

	/* a byte operation leaves the stream byte-oriented, a wide request makes it wide */
	zassert_true(fgetc(f) != EOF);
	zassert_true(fwide(f, 0) < 0);
	zassert_ok(fclose(f));

	f = test_open_out();
	zassert_true(fwide(f, 1) > 0);
	zassert_true(fwide(f, 0) > 0);
	zassert_ok(fclose(f));
}

ZTEST_USER(posix_wide_char_device_io, test_fgetwc)
{
	FILE *f = test_open_in();

	zassert_equal(fgetwc(f), L'h');
	zassert_equal(fgetwc(f), L'e');
	zassert_true(fwide(f, 0) > 0);
	while (fgetwc(f) != WEOF) {
	}
	zassert_equal(fgetwc(f), WEOF);
	/* Picolibc leaves the end-of-file indicator clear on wide reads */
	if (!IS_ENABLED(CONFIG_PICOLIBC)) {
		zassert_true(feof(f));
	}
	zassert_ok(fclose(f));
}

ZTEST_USER(posix_wide_char_device_io, test_getwc)
{
	FILE *f = test_open_in();

	zassert_equal(getwc(f), L'h');
	zassert_equal(getwc(f), L'e');
	zassert_ok(fclose(f));
}

ZTEST_USER(posix_wide_char_device_io, test_ungetwc)
{
	FILE *f = test_open_in();

	zassert_equal(fgetwc(f), L'h');
	zassert_equal(ungetwc(L'X', f), L'X');
	zassert_equal(fgetwc(f), L'X');
	zassert_equal(fgetwc(f), L'e');
	zassert_equal(ungetwc(WEOF, f), WEOF);
	zassert_ok(fclose(f));
}

ZTEST_USER(posix_wide_char_device_io, test_fgetws)
{
	FILE *f = test_open_in();
	wchar_t buf[32];

	/* a line at a time, a bounded read, then the end */
	zassert_equal(fgetws(buf, ARRAY_SIZE(buf), f), buf);
	zassert_equal(wcscmp(buf, L"hello 42\n"), 0);
	zassert_equal(fgetws(buf, 4, f), buf);
	zassert_equal(wcscmp(buf, L"sec"), 0);
	zassert_equal(fgetws(buf, ARRAY_SIZE(buf), f), buf);
	zassert_equal(wcscmp(buf, L"ond line\n"), 0);
	zassert_is_null(fgetws(buf, ARRAY_SIZE(buf), f));
	if (!IS_ENABLED(CONFIG_PICOLIBC)) {
		zassert_true(feof(f));
	}
	zassert_ok(fclose(f));
}

ZTEST_USER(posix_wide_char_device_io, test_fputwc)
{
	FILE *f = test_open_out();

	zassert_equal(fputwc(L'a', f), L'a');
	zassert_equal(fputwc(L'b', f), L'b');
	zassert_true(fwide(f, 0) > 0);
	zassert_ok(fclose(f));
	zassert_equal(wcscmp(test_read_out(), L"ab"), 0);
}

ZTEST_USER(posix_wide_char_device_io, test_putwc)
{
	FILE *f = test_open_out();

	zassert_equal(putwc(L'x', f), L'x');
	zassert_equal(putwc(L'y', f), L'y');
	zassert_ok(fclose(f));
	zassert_equal(wcscmp(test_read_out(), L"xy"), 0);
}

ZTEST_USER(posix_wide_char_device_io, test_fputws)
{
	FILE *f = test_open_out();

	zassert_true(fputws(L"wide ", f) >= 0);
	zassert_true(fputws(L"string\n", f) >= 0);
	zassert_ok(fclose(f));
	zassert_equal(wcscmp(test_read_out(), L"wide string\n"), 0);
}

ZTEST_USER(posix_wide_char_device_io, test_fwprintf)
{
	FILE *f = test_open_out();

	zassert_equal(fwprintf(f, L"%d-%ls-%lc\n", 42, L"wide", L'x'), 10);
	zassert_ok(fclose(f));
	zassert_equal(wcscmp(test_read_out(), L"42-wide-x\n"), 0);
}

static int vfwprintf_wrap(FILE *f, const wchar_t *fmt, ...)
{
	va_list ap;
	int ret;

	va_start(ap, fmt);
	ret = vfwprintf(f, fmt, ap);
	va_end(ap);

	return ret;
}

ZTEST_USER(posix_wide_char_device_io, test_vfwprintf)
{
	FILE *f = test_open_out();

	zassert_equal(vfwprintf_wrap(f, L"%d-%ls\n", 42, L"wide"), 8);
	zassert_ok(fclose(f));
	zassert_equal(wcscmp(test_read_out(), L"42-wide\n"), 0);
}

ZTEST_USER(posix_wide_char_device_io, test_fwscanf)
{
	FILE *f = test_open_in();
	wchar_t word[8];
	int n;

	zassert_equal(fwscanf(f, L"%7ls %d", word, &n), 2);
	zassert_equal(wcscmp(word, L"hello"), 0);
	zassert_equal(n, 42);
	/* the second line is not a number */
	zassert_equal(fwscanf(f, L"%d", &n), 0);
	zassert_ok(fclose(f));
}

static int vfwscanf_wrap(FILE *f, const wchar_t *fmt, ...)
{
	va_list ap;
	int ret;

	va_start(ap, fmt);
	ret = vfwscanf(f, fmt, ap);
	va_end(ap);

	return ret;
}

ZTEST_USER(posix_wide_char_device_io, test_vfwscanf)
{
	FILE *f = test_open_in();
	wchar_t word[8];
	int n;

	zassert_equal(vfwscanf_wrap(f, L"%7ls %d", word, &n), 2);
	zassert_equal(wcscmp(word, L"hello"), 0);
	zassert_equal(n, 42);
	zassert_ok(fclose(f));
}
```

## src/wide_char_device_io_tests.h
```c
/*
 * SPDX-FileCopyrightText: Copyright The Zephyr Project Contributors
 * SPDX-License-Identifier: Apache-2.0
 */

#ifndef POSIX_TESTS_WIDE_CHAR_DEVICE_IO_TESTS_H_
#define POSIX_TESTS_WIDE_CHAR_DEVICE_IO_TESTS_H_

#include <stdio.h>
#include <wchar.h>

#include <zephyr/ztest.h>

#include "../../shared/linux_compat_test.h"

/*
 * The file system is mounted at "/", and /tmp exists in both worlds (the FAT
 * RAM disk under Zephyr, the host filesystem under CONFIG_NATIVE_LIBC), so
 * every path constant is identical for the linux_compat variant.
 */
#define FS_TMPDIR    "/tmp"
#define TEST_ROOT    FS_TMPDIR "/pwcio"
#define TEST_IN      TEST_ROOT "/in.txt"
#define TEST_OUT     TEST_ROOT "/out.txt"
#define TEST_CONTENT L"hello 42\nsecond line\n"

/*
 * Every file is written and read with the wide functions of the C library
 * under test: whether a wide stream holds a multibyte encoding (glibc) or
 * raw wide characters (Picolibc), a round trip through the same library holds.
 * TEST_IN holds TEST_CONTENT; TEST_OUT is empty.
 */
FILE *test_open_in(void);
FILE *test_open_out(void);
/* the wide characters TEST_OUT holds */
const wchar_t *test_read_out(void);

/* the standard streams read TEST_IN and write TEST_OUT between these calls */
void test_swap_std_in(void);
void test_swap_std_out(void);
void test_restore_std(void);

#endif /* POSIX_TESTS_WIDE_CHAR_DEVICE_IO_TESTS_H_ */
```
