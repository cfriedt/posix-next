## CMakeLists.txt
```
# SPDX-License-Identifier: Apache-2.0

cmake_minimum_required(VERSION 3.20.0)
find_package(Zephyr REQUIRED HINTS $ENV{ZEPHYR_BASE})
project(posix_message_passing)

FILE(GLOB app_sources src/*.c)

target_sources(app PRIVATE ${app_sources})

# FIXME: We should not rely on usleep() (which was dropped in Issue 7, 200809L)
target_compile_options(app PRIVATE -U_POSIX_C_SOURCE -D_POSIX_C_SOURCE=200112L)
target_compile_options(app PRIVATE -U_XOPEN_SOURCE -D_XOPEN_SOURCE=600)
```

## prj.conf
```kconfig
CONFIG_ZTEST=y

CONFIG_POSIX_AEP_CHOICE_PSE51=y
CONFIG_POSIX_MESSAGE_PASSING=y

# mq_notify() SIGEV_THREAD attribute translation coverage requires
# _POSIX_THREAD_ATTR_STACKSIZE and _POSIX_THREAD_PRIORITY_SCHEDULING;
# PSE51 selects both, but spell them out so the coverage cannot silently
# vanish with a profile change
CONFIG_POSIX_THREAD_ATTR_STACKSIZE=y
CONFIG_POSIX_THREAD_PRIORITY_SCHEDULING=y
CONFIG_POSIX_TIMEOUTS=y

# 2 guaranteed (statically allocated) message queues
CONFIG_SYS_MSGQ_MIN_ADD_TEST=2

# stdio (3) + concurrently open message queues (4)
CONFIG_ZVFS_OPEN_IGNORE_MIN=y
CONFIG_ZVFS_OPEN_MAX=7

# SIGEV_THREAD notification threads
CONFIG_SYS_THREAD_STACK_MIN_ADD_TEST=2
CONFIG_SYS_THREAD_THREAD_MIN_ADD_TEST=2

CONFIG_HEAP_MEM_POOL_SIZE=32768
```

## src/main.c
```c
/*
 * SPDX-FileCopyrightText: Copyright The Zephyr Project Contributors
 *
 * SPDX-License-Identifier: Apache-2.0
 */

#include "message_passing_tests.h"

#ifdef CONFIG_NATIVE_LIBC
/*
 * Under the host libc the notification signal is a real process-directed
 * signal: leaving it blocked and waiting for it with sigtimedwait() would
 * stall native_sim, and leaving it unhandled would kill the process. Capture
 * deliveries in a handler instead and consume them from a counter.
 */
static volatile int lc_count;
static siginfo_t lc_info;

static void lc_capture(int signo, siginfo_t *info, void *ctx)
{
	ARG_UNUSED(ctx);

	lc_info = *info;
	lc_info.si_signo = signo;
	lc_count++;
}

void mq_arm_sig(int signo)
{
	struct sigaction act = {
		.sa_flags = SA_SIGINFO,
		.sa_sigaction = lc_capture,
	};

	zassert_ok(sigemptyset(&act.sa_mask));
	zassert_ok(sigaction(signo, &act, NULL));
}
#else
void mq_arm_sig(int signo)
{
	sigset_t set;

	zassert_ok(sigemptyset(&set));
	zassert_ok(sigaddset(&set, signo));
	zassert_ok(sigprocmask(SIG_BLOCK, &set, NULL));
}
#endif /* CONFIG_NATIVE_LIBC */

int mq_accept_sig(int signo, siginfo_t *info, int timeout_ms)
{
#ifdef CONFIG_NATIVE_LIBC
	const int start = lc_count;

	for (int elapsed = 0; elapsed <= timeout_ms; elapsed += 5) {
		if (lc_count != start) {
			if (info != NULL) {
				*info = lc_info;
			}
			return lc_info.si_signo;
		}
		usleep(USEC_PER_MSEC * 5);
	}

	errno = EAGAIN;
	return -1;
#else
	sigset_t set;
	struct timespec timeout = {
		.tv_sec = timeout_ms / (long)MSEC_PER_SEC,
		.tv_nsec = (timeout_ms % (long)MSEC_PER_SEC) * (long)NSEC_PER_MSEC,
	};

	zassert_ok(sigemptyset(&set));
	zassert_ok(sigaddset(&set, signo));

	return sigtimedwait(&set, info, &timeout);
#endif /* CONFIG_NATIVE_LIBC */
}

static void before(void *arg)
{
	ARG_UNUSED(arg);

	mq_test_section_reset();
}

static void after(void *arg)
{
	ARG_UNUSED(arg);

	mq_test_section_reset();
}

ZTEST_SUITE(posix_message_passing, NULL, NULL, before, after, NULL);
```

## src/message_passing_tests.h
```c
/*
 * SPDX-FileCopyrightText: Copyright The Zephyr Project Contributors
 *
 * SPDX-License-Identifier: Apache-2.0
 */

#ifndef POSIX_MESSAGE_PASSING_TESTS_H_
#define POSIX_MESSAGE_PASSING_TESTS_H_

#include <errno.h>
#include <fcntl.h>
#include <limits.h>
#include <mqueue.h>
#include <string.h>
#include <time.h>
#include <unistd.h>

#include <zephyr/sys/timeutil.h>
#include <zephyr/sys/util.h>
#include <zephyr/ztest.h>

#include <signal.h>

/**
 * @brief Accept one instance of @p signo, waiting up to @p timeout_ms.
 *
 * On @kconfig{CONFIG_NATIVE_LIBC} the signal is a real host signal: a blocking
 * host sigtimedwait() would stall native_sim, so deliveries are captured by a
 * handler and consumed from a counter instead.
 *
 * @return the signal number, or -1 if none arrived in time.
 */
int mq_accept_sig(int signo, siginfo_t *info, int timeout_ms);

/** @brief Arrange for @p signo to be accepted by mq_accept_sig() rather than delivered. */
void mq_arm_sig(int signo);

/** @brief Discard any pending instances of @p signo. */
static inline void mq_drain_sig(int signo)
{
	while (mq_accept_sig(signo, NULL, 0) >= 0) {
	}
}

#ifndef MQ_PRIO_MAX
/* not every libc's <limits.h> exposes the POSIX runtime invariant values */
#define MQ_PRIO_MAX CONFIG_POSIX_MQ_PRIO_MAX
#endif

/* POSIX requires a portable queue name to begin with a slash */
#define MQ_NAME  "/mq_test"
#define MQ_NAME2 "/mq_test2"

#define MQ_MSG_SIZE 16
/* at most the Linux default fs.mqueue.msg_max, so linux_compat can create it */
#define MQ_MAX_MSGS 4

#define MQ_TIMEOUT_MS 100

static const struct mq_attr mq_test_attr = {
	.mq_msgsize = MQ_MSG_SIZE,
	.mq_maxmsg = MQ_MAX_MSGS,
};

/** @brief Create (or reopen) the test queue read-write. */
static inline mqd_t mq_test_open(int extra_oflags)
{
	struct mq_attr attr = mq_test_attr;

	return mq_open(MQ_NAME, O_RDWR | O_CREAT | extra_oflags, 0600, &attr);
}

/** @brief Absolute deadline @p ms milliseconds from now, for the timed calls. */
static inline struct timespec mq_test_deadline(long ms)
{
	struct timespec ts = {0};

	/* the per-second constants are unsigned: keep the arithmetic signed */
	struct timespec delta = {
		.tv_sec = ms / (long)MSEC_PER_SEC,
		.tv_nsec = (ms % (long)MSEC_PER_SEC) * (long)NSEC_PER_MSEC,
	};

	(void)clock_gettime(CLOCK_REALTIME, &ts);
	/* @p ms may be negative, for a deadline that has already passed */
	(void)timespec_normalize(&delta);
	(void)timespec_add(&ts, &delta);

	return ts;
}

/**
 * @brief Return the queue to a known state between sections.
 *
 * Unlinking removes the name immediately, so the next section's mq_open()
 * creates a fresh queue even if a descriptor from this one is still open.
 */
static inline void mq_test_section_reset(void)
{
	(void)mq_unlink(MQ_NAME);
	(void)mq_unlink(MQ_NAME2);
}

/** @brief Fill the queue to capacity at priority @p prio. */
static inline void mq_test_fill(mqd_t mqd, unsigned int prio)
{
	static const char msg[MQ_MSG_SIZE] = "fill";

	for (int i = 0; i < MQ_MAX_MSGS; i++) {
		zassert_ok(mq_send(mqd, msg, sizeof(msg), prio));
	}
}

#endif /* POSIX_MESSAGE_PASSING_TESTS_H_ */
```

## src/mq_close.c
```c
/*
 * SPDX-FileCopyrightText: Copyright The Zephyr Project Contributors
 *
 * SPDX-License-Identifier: Apache-2.0
 */

#include "message_passing_tests.h"

static void mq_close_releases_descriptor(void)
{
	char buf[MQ_MSG_SIZE];
	mqd_t mqd = mq_test_open(0);

	zassert_not_equal(mqd, (mqd_t)-1);
	zassert_ok(mq_close(mqd));

	/* the descriptor is no longer usable */
	zassert_equal(mq_receive(mqd, buf, sizeof(buf), NULL), -1);
	zassert_equal(errno, EBADF);

	zassert_ok(mq_unlink(MQ_NAME));
}

static void mq_close_other_descriptors_survive(void)
{
	char buf[MQ_MSG_SIZE];
	mqd_t a = mq_test_open(0);
	mqd_t b = mq_open(MQ_NAME, O_RDWR);

	zassert_not_equal(a, (mqd_t)-1);
	zassert_not_equal(b, (mqd_t)-1);

	zassert_ok(mq_send(a, "shared", 7, 0));
	zassert_ok(mq_close(a));

	/* messages sent through a closed descriptor remain queued */
	zassert_equal(mq_receive(b, buf, sizeof(buf), NULL), 7);
	zassert_mem_equal(buf, "shared", 7);

	zassert_ok(mq_close(b));
	zassert_ok(mq_unlink(MQ_NAME));
}

static void mq_close_errors(void)
{
	mqd_t mqd = mq_test_open(0);

	zassert_not_equal(mqd, (mqd_t)-1);
	zassert_ok(mq_close(mqd));

	/* closing twice */
	zassert_equal(mq_close(mqd), -1);
	zassert_equal(errno, EBADF);

	/* closing a descriptor that was never open */
	zassert_equal(mq_close((mqd_t)-1), -1);
	zassert_equal(errno, EBADF);

	zassert_ok(mq_unlink(MQ_NAME));
}

ZTEST_USER(posix_message_passing, test_mq_close)
{
	mq_close_releases_descriptor();
	mq_test_section_reset();
	mq_close_other_descriptors_survive();
	mq_test_section_reset();
	mq_close_errors();
	mq_test_section_reset();
}
```

## src/mq_getattr.c
```c
/*
 * SPDX-FileCopyrightText: Copyright The Zephyr Project Contributors
 *
 * SPDX-License-Identifier: Apache-2.0
 */

#include "message_passing_tests.h"

static void mq_getattr_reports_geometry(void)
{
	struct mq_attr attr;
	char buf[MQ_MSG_SIZE];
	mqd_t mqd = mq_test_open(0);

	zassert_not_equal(mqd, (mqd_t)-1);

	zassert_ok(mq_getattr(mqd, &attr));
	zassert_equal(attr.mq_msgsize, MQ_MSG_SIZE);
	zassert_equal(attr.mq_maxmsg, MQ_MAX_MSGS);
	zassert_equal(attr.mq_curmsgs, 0);
	zassert_equal(attr.mq_flags, 0);

	/* mq_curmsgs tracks the queue depth */
	zassert_ok(mq_send(mqd, "one", 4, 0));
	zassert_ok(mq_getattr(mqd, &attr));
	zassert_equal(attr.mq_curmsgs, 1);

	zassert_equal(mq_receive(mqd, buf, sizeof(buf), NULL), 4);
	zassert_ok(mq_getattr(mqd, &attr));
	zassert_equal(attr.mq_curmsgs, 0);

	zassert_ok(mq_close(mqd));
	zassert_ok(mq_unlink(MQ_NAME));
}

static void mq_getattr_flags_are_per_descriptor(void)
{
	struct mq_attr attr;
	mqd_t blocking = mq_test_open(0);
	mqd_t nonblock = mq_open(MQ_NAME, O_RDWR | O_NONBLOCK);

	zassert_not_equal(blocking, (mqd_t)-1);
	zassert_not_equal(nonblock, (mqd_t)-1);

	zassert_ok(mq_getattr(nonblock, &attr));
	zassert_equal(attr.mq_flags, O_NONBLOCK);

	/* the other descriptor for the same queue is unaffected */
	zassert_ok(mq_getattr(blocking, &attr));
	zassert_equal(attr.mq_flags, 0);

	zassert_ok(mq_close(nonblock));
	zassert_ok(mq_close(blocking));
	zassert_ok(mq_unlink(MQ_NAME));
}

static void mq_getattr_errors(void)
{
	struct mq_attr attr;

	zassert_equal(mq_getattr((mqd_t)-1, &attr), -1);
	zassert_equal(errno, EBADF);
}

ZTEST_USER(posix_message_passing, test_mq_getattr)
{
	mq_getattr_reports_geometry();
	mq_test_section_reset();
	mq_getattr_flags_are_per_descriptor();
	mq_test_section_reset();
	mq_getattr_errors();
	mq_test_section_reset();
}
```

## src/mq_notify.c
```c
/*
 * SPDX-FileCopyrightText: Copyright The Zephyr Project Contributors
 *
 * SPDX-License-Identifier: Apache-2.0
 */

#include "message_passing_tests.h"

#include <pthread.h>
#include <signal.h>

#define NOTIFY_SIGNO  SIGUSR1
#define NOTIFY_SIGVAL 4242

static ZTEST_BMEM volatile bool notify_fn_ran;
static ZTEST_BMEM volatile int notify_fn_value;

static void notify_fn(union sigval value)
{
	notify_fn_value = value.sival_int;
	notify_fn_ran = true;
}

static ZTEST_BMEM int notify_si_code;

static int notify_sig_accept(int ms)
{
	siginfo_t info = {0};

	if (mq_accept_sig(NOTIFY_SIGNO, &info, ms) < 0) {
		return -1;
	}

	notify_si_code = info.si_code;

	return info.si_value.sival_int;
}

static int notify_sig_code(void)
{
	return notify_si_code;
}

static void mq_notify_sigev_none(void)
{
	struct sigevent sev = {
		.sigev_notify = SIGEV_NONE,
	};
	mqd_t mqd = mq_test_open(0);

	zassert_not_equal(mqd, (mqd_t)-1);

	zassert_ok(mq_notify(mqd, &sev));
	zassert_ok(mq_send(mqd, "quiet", 6, 0));

	/* SIGEV_NONE runs nothing, but the arrival still consumes the
	 * registration, so a second one is accepted
	 */
	zassert_ok(mq_notify(mqd, &sev));
	zassert_ok(mq_notify(mqd, NULL));

	zassert_ok(mq_close(mqd));
	zassert_ok(mq_unlink(MQ_NAME));
}

static void mq_notify_sigev_signal(void)
{
	char buf[MQ_MSG_SIZE];
	struct sigevent sev = {
		.sigev_notify = SIGEV_SIGNAL,
		.sigev_signo = NOTIFY_SIGNO,
		.sigev_value.sival_int = NOTIFY_SIGVAL,
	};
	mqd_t mqd = mq_test_open(0);

	zassert_not_equal(mqd, (mqd_t)-1);
	mq_drain_sig(NOTIFY_SIGNO);

	zassert_ok(mq_notify(mqd, &sev));
	zassert_ok(mq_send(mqd, "signal", 7, 0));

	zassert_equal(notify_sig_accept(MQ_TIMEOUT_MS), NOTIFY_SIGVAL,
		      "notification signal not delivered");
	zassert_equal(notify_sig_code(), SI_MESGQ);

	/* the registration was consumed: a further arrival does not signal */
	zassert_equal(mq_receive(mqd, buf, sizeof(buf), NULL), 7);
	zassert_ok(mq_send(mqd, "again", 6, 0));
	zassert_equal(notify_sig_accept(MQ_TIMEOUT_MS), -1,
		      "notification fired after being consumed");

	zassert_ok(mq_close(mqd));
	zassert_ok(mq_unlink(MQ_NAME));
}

static void mq_notify_only_on_empty_to_non_empty(void)
{
	char buf[MQ_MSG_SIZE];
	struct sigevent sev = {
		.sigev_notify = SIGEV_SIGNAL,
		.sigev_signo = NOTIFY_SIGNO,
		.sigev_value.sival_int = NOTIFY_SIGVAL,
	};
	mqd_t mqd = mq_test_open(0);

	zassert_not_equal(mqd, (mqd_t)-1);
	mq_drain_sig(NOTIFY_SIGNO);

	/* arming while the queue is non-empty does not fire on further sends */
	zassert_ok(mq_send(mqd, "first", 6, 0));
	zassert_ok(mq_notify(mqd, &sev));
	zassert_ok(mq_send(mqd, "second", 7, 0));
	zassert_equal(notify_sig_accept(MQ_TIMEOUT_MS), -1,
		      "notification fired on a non-empty queue");

	/* draining and refilling crosses the transition, which does fire */
	zassert_true(mq_receive(mqd, buf, sizeof(buf), NULL) > 0);
	zassert_true(mq_receive(mqd, buf, sizeof(buf), NULL) > 0);
	zassert_ok(mq_send(mqd, "third", 6, 0));
	zassert_equal(notify_sig_accept(MQ_TIMEOUT_MS), NOTIFY_SIGVAL);

	zassert_ok(mq_close(mqd));
	zassert_ok(mq_unlink(MQ_NAME));
}

static void mq_notify_sigev_thread(void)
{
	struct sigevent sev = {
		.sigev_notify = SIGEV_THREAD,
		.sigev_notify_function = notify_fn,
		.sigev_value.sival_int = NOTIFY_SIGVAL,
	};
	mqd_t mqd = mq_test_open(0);

	zassert_not_equal(mqd, (mqd_t)-1);
	notify_fn_ran = false;
	notify_fn_value = 0;

	zassert_ok(mq_notify(mqd, &sev));
	zassert_ok(mq_send(mqd, "thread", 7, 0));

	for (int i = 0; (i < 100) && !notify_fn_ran; i++) {
		usleep(USEC_PER_MSEC * 10);
	}

	zassert_true(notify_fn_ran, "notification function did not run");
	zassert_equal(notify_fn_value, NOTIFY_SIGVAL);

	zassert_ok(mq_close(mqd));
	zassert_ok(mq_unlink(MQ_NAME));
}

#if defined(_POSIX_THREAD_ATTR_STACKSIZE) && defined(_POSIX_THREAD_PRIORITY_SCHEDULING) &&        \
	!defined(CONFIG_NATIVE_LIBC)

/*
 * Larger than the guaranteed pool slot so the notification thread takes the
 * oversized (mapped or heap) stack path. Sized relative to the slot rather
 * than fixed: MPU platforms round user stacks up to a power of two, and a
 * fixed request can exceed what small-heap platforms can align and satisfy.
 */
#define NOTIFY_ATTR_STACK_SIZE (2 * CONFIG_SYS_THREAD_STACK_SIZE)

static ZTEST_BMEM volatile int notify_fn_zprio;
static ZTEST_BMEM volatile size_t notify_fn_stack;

/* record the notification thread's kernel priority and (supervisor only) stack size */
static void attr_probe_fn(union sigval val)
{
	ARG_UNUSED(val);

	notify_fn_zprio = k_thread_priority_get(k_current_get());
	if (!k_is_user_context()) {
		notify_fn_stack = k_current_get()->stack_info.size;
	}
	notify_fn_ran = true;
}

static void attr_probe_await(mqd_t mqd, const char *msg)
{
	char buf[MQ_MSG_SIZE];

	notify_fn_ran = false;
	zassert_ok(mq_send(mqd, msg, strlen(msg) + 1, 0));
	for (int i = 0; (i < 100) && !notify_fn_ran; i++) {
		usleep(USEC_PER_MSEC * 10);
	}
	zassert_true(notify_fn_ran, "notification function did not run");

	/* drain, so the next arrival crosses the empty -> non-empty transition */
	zassert_true(mq_receive(mqd, buf, sizeof(buf), NULL) >= 0);
}

static void mq_notify_sigev_thread_attributes(void)
{
	pthread_attr_t attr;
	struct sched_param param = {
		/* the minimum SCHED_RR priority; sched_get_priority_min() is another group */
		.sched_priority = 0,
	};
	struct sigevent sev = {
		.sigev_notify = SIGEV_THREAD,
		.sigev_notify_function = attr_probe_fn,
	};
	int default_prio;
	mqd_t mqd = mq_test_open(0);

	zassert_not_equal(mqd, (mqd_t)-1);

	/* without attributes, the notification thread inherits the registrant's priority */
	zassert_ok(mq_notify(mqd, &sev));
	attr_probe_await(mqd, "no attributes");
	default_prio = notify_fn_zprio;

	zassert_ok(pthread_attr_init(&attr));
	zassert_ok(pthread_attr_setstacksize(&attr, NOTIFY_ATTR_STACK_SIZE));
	zassert_ok(pthread_attr_setschedpolicy(&attr, SCHED_RR));
	zassert_ok(pthread_attr_setschedparam(&attr, &param));
	sev.sigev_notify_attributes = &attr;

	zassert_ok(mq_notify(mqd, &sev));
	/* translated at registration time: the attribute object may be destroyed at once */
	zassert_ok(pthread_attr_destroy(&attr));

	attr_probe_await(mqd, "with attributes");
	zassert_not_equal(notify_fn_zprio, default_prio,
			  "sigev_notify_attributes scheduling parameters were not honored");
	if (!k_is_user_context()) {
		zassert_true(notify_fn_stack >= NOTIFY_ATTR_STACK_SIZE,
			     "requested %d stack, notification thread has %zu",
			     NOTIFY_ATTR_STACK_SIZE, notify_fn_stack);
	}

	zassert_ok(mq_close(mqd));
	zassert_ok(mq_unlink(MQ_NAME));
}
#endif /* _POSIX_THREAD_ATTR_STACKSIZE && _POSIX_THREAD_PRIORITY_SCHEDULING && !NATIVE_LIBC */

#if defined(SIGEV_THREAD_ID) && !defined(CONFIG_NATIVE_LIBC)
/* the helper runs in another thread, which cannot reach the registrant's stack under userspace */
static ZTEST_BMEM int received_sigval;

static void *tid_helper_fn(void *arg)
{
	int *const out = arg;
	sigset_t set;
	siginfo_t info = {0};
	struct timespec ts = {
		.tv_nsec = MQ_TIMEOUT_MS * NSEC_PER_MSEC,
	};

	(void)sigemptyset(&set);
	(void)sigaddset(&set, NOTIFY_SIGNO);
	(void)pthread_sigmask(SIG_BLOCK, &set, NULL);

	if ((sigtimedwait(&set, &info, &ts) == NOTIFY_SIGNO) && (info.si_code == SI_MESGQ)) {
		*out = info.si_value.sival_int;
	}

	return NULL;
}

static void mq_notify_sigev_thread_id(void)
{
	pthread_t th;
	struct sigevent sev = {
		.sigev_notify = SIGEV_THREAD_ID,
		.sigev_signo = NOTIFY_SIGNO,
		.sigev_value.sival_int = NOTIFY_SIGVAL,
	};
	mqd_t mqd = mq_test_open(0);

	zassert_not_equal(mqd, (mqd_t)-1);

	received_sigval = -1;
	zassert_ok(pthread_create(&th, NULL, tid_helper_fn, &received_sigval));
	/* let the helper block its signal and enter sigtimedwait() */
	usleep(USEC_PER_MSEC * 50);

	/* the arrival signal goes to the named thread, not the registrant */
	sev.sigev_notify_thread_id = (pid_t)th;
	zassert_ok(mq_notify(mqd, &sev));
	zassert_ok(mq_send(mqd, "targeted", 9, 0));

	zassert_ok(pthread_join(th, NULL));
	zassert_equal(received_sigval, NOTIFY_SIGVAL, "targeted thread did not receive the signal");

	zassert_ok(mq_close(mqd));
	zassert_ok(mq_unlink(MQ_NAME));
}
#endif /* defined(SIGEV_THREAD_ID) && !defined(CONFIG_NATIVE_LIBC) */

static void mq_notify_removal(void)
{
	struct sigevent sev = {
		.sigev_notify = SIGEV_SIGNAL,
		.sigev_signo = NOTIFY_SIGNO,
		.sigev_value.sival_int = NOTIFY_SIGVAL,
	};
	mqd_t mqd = mq_test_open(0);

	zassert_not_equal(mqd, (mqd_t)-1);
	mq_drain_sig(NOTIFY_SIGNO);

	zassert_ok(mq_notify(mqd, &sev));
	zassert_ok(mq_notify(mqd, NULL));

	/* a removed registration does not fire */
	zassert_ok(mq_send(mqd, "removed", 8, 0));
	zassert_equal(notify_sig_accept(MQ_TIMEOUT_MS), -1,
		      "notification fired after removal");

	zassert_ok(mq_close(mqd));
	zassert_ok(mq_unlink(MQ_NAME));
}

static void mq_notify_errors(void)
{
	struct sigevent sev = {
		.sigev_notify = SIGEV_SIGNAL,
		.sigev_signo = NOTIFY_SIGNO,
		.sigev_value.sival_int = NOTIFY_SIGVAL,
	};
	mqd_t mqd = mq_test_open(0);

	zassert_not_equal(mqd, (mqd_t)-1);

	/* removing when nothing is armed is not an error */
	zassert_ok(mq_notify(mqd, NULL));

	/* only one registration at a time */
	zassert_ok(mq_notify(mqd, &sev));
	zassert_equal(mq_notify(mqd, &sev), -1);
	zassert_equal(errno, EBUSY);
	zassert_ok(mq_notify(mqd, NULL));

	/* an unknown notification type */
	sev.sigev_notify = 4242;
	zassert_equal(mq_notify(mqd, &sev), -1);
	zassert_equal(errno, EINVAL);

	/* a descriptor that is not open */
	zassert_equal(mq_notify((mqd_t)-1, NULL), -1);
	zassert_equal(errno, EBADF);

	zassert_ok(mq_close(mqd));
	zassert_ok(mq_unlink(MQ_NAME));
}

ZTEST_USER(posix_message_passing, test_mq_notify)
{
	mq_arm_sig(NOTIFY_SIGNO);

	mq_notify_sigev_none();
	mq_test_section_reset();
	mq_notify_errors();
	mq_test_section_reset();

	if (IS_ENABLED(CONFIG_POSIX_SIGNALS)) {
		mq_notify_sigev_signal();
		mq_test_section_reset();
		mq_notify_only_on_empty_to_non_empty();
		mq_test_section_reset();
		mq_notify_removal();
		mq_test_section_reset();
	}

#if defined(SIGEV_THREAD_ID) && !defined(CONFIG_NATIVE_LIBC)
	/* on the host, sigev_notify_thread_id requires gettid(); covered by Linux */
	if (IS_ENABLED(CONFIG_POSIX_SIGNALS) && IS_ENABLED(CONFIG_POSIX_THREADS)) {
		mq_notify_sigev_thread_id();
		mq_test_section_reset();
	}
#endif /* defined(SIGEV_THREAD_ID) && !defined(CONFIG_NATIVE_LIBC) */

	/* SIGEV_THREAD is dispatched by the kernel: no pthreads or supervisor mode needed */
	if (IS_ENABLED(CONFIG_NATIVE_LIBC) ||
	    (IS_ENABLED(CONFIG_SIGNAL) && IS_ENABLED(CONFIG_SYS_THREAD) &&
	     IS_ENABLED(CONFIG_THREAD_DETACH))) {
		mq_notify_sigev_thread();
		mq_test_section_reset();

#if defined(_POSIX_THREAD_ATTR_STACKSIZE) && defined(_POSIX_THREAD_PRIORITY_SCHEDULING) &&        \
	!defined(CONFIG_NATIVE_LIBC)
		mq_notify_sigev_thread_attributes();
		mq_test_section_reset();
#endif
	}
}
```

## src/mq_open.c
```c
/*
 * SPDX-FileCopyrightText: Copyright The Zephyr Project Contributors
 *
 * SPDX-License-Identifier: Apache-2.0
 */

#include "message_passing_tests.h"

static void mq_open_create_and_reopen(void)
{
	mqd_t mqd = mq_test_open(0);

	zassert_not_equal(mqd, (mqd_t)-1, "mq_open() failed: %d", errno);

	/* an existing queue is reopened without O_CREAT and without attributes */
	mqd_t mqd2 = mq_open(MQ_NAME, O_RDWR);

	zassert_not_equal(mqd2, (mqd_t)-1, "reopen failed: %d", errno);
	zassert_not_equal(mqd, mqd2, "each open returns a distinct descriptor");

	zassert_ok(mq_close(mqd2));
	zassert_ok(mq_close(mqd));
	zassert_ok(mq_unlink(MQ_NAME));
}

static void mq_open_persists_until_unlinked(void)
{
	mqd_t mqd = mq_test_open(0);

	zassert_not_equal(mqd, (mqd_t)-1);
	zassert_ok(mq_close(mqd));

	/* closing every descriptor does not destroy the queue */
	mqd = mq_open(MQ_NAME, O_RDWR);
	zassert_not_equal(mqd, (mqd_t)-1, "queue did not outlive its descriptors: %d", errno);
	zassert_ok(mq_close(mqd));
	zassert_ok(mq_unlink(MQ_NAME));

	/* after unlinking it is gone */
	zassert_equal(mq_open(MQ_NAME, O_RDWR), (mqd_t)-1);
	zassert_equal(errno, ENOENT);
}

static void mq_open_access_modes(void)
{
	char buf[MQ_MSG_SIZE];
	mqd_t rdwr = mq_test_open(0);
	mqd_t rdonly;
	mqd_t wronly;

	zassert_not_equal(rdwr, (mqd_t)-1);
	rdonly = mq_open(MQ_NAME, O_RDONLY);
	wronly = mq_open(MQ_NAME, O_WRONLY);
	zassert_not_equal(rdonly, (mqd_t)-1);
	zassert_not_equal(wronly, (mqd_t)-1);

	/* the access mode is per descriptor */
	zassert_ok(mq_send(wronly, "hello", 6, 0));
	zassert_equal(mq_send(rdonly, "hello", 6, 0), -1);
	zassert_equal(errno, EBADF);

	zassert_equal(mq_receive(rdonly, buf, sizeof(buf), NULL), 6);
	zassert_equal(mq_receive(wronly, buf, sizeof(buf), NULL), -1);
	zassert_equal(errno, EBADF);

	zassert_ok(mq_close(wronly));
	zassert_ok(mq_close(rdonly));
	zassert_ok(mq_close(rdwr));
	zassert_ok(mq_unlink(MQ_NAME));
}

static void mq_open_excl(void)
{
	mqd_t mqd = mq_test_open(0);

	zassert_not_equal(mqd, (mqd_t)-1);

	/* O_CREAT | O_EXCL on an existing queue */
	struct mq_attr attr = mq_test_attr;

	zassert_equal(mq_open(MQ_NAME, O_RDWR | O_CREAT | O_EXCL, 0600, &attr), (mqd_t)-1);
	zassert_equal(errno, EEXIST);

	zassert_ok(mq_close(mqd));
	zassert_ok(mq_unlink(MQ_NAME));

	/* and on a fresh name it succeeds */
	mqd = mq_open(MQ_NAME, O_RDWR | O_CREAT | O_EXCL, 0600, &attr);
	zassert_not_equal(mqd, (mqd_t)-1, "O_EXCL create failed: %d", errno);
	zassert_ok(mq_close(mqd));
	zassert_ok(mq_unlink(MQ_NAME));
}

static void mq_open_errors(void)
{
	struct mq_attr attr;

	/* opening a queue that does not exist, without O_CREAT */
	zassert_equal(mq_open(MQ_NAME, O_RDWR), (mqd_t)-1);
	zassert_equal(errno, ENOENT);

	/* creating without attributes, or with degenerate geometry */
	attr = mq_test_attr;
	attr.mq_msgsize = 0;
	zassert_equal(mq_open(MQ_NAME, O_RDWR | O_CREAT, 0600, &attr), (mqd_t)-1);
	zassert_equal(errno, EINVAL);

	attr = mq_test_attr;
	attr.mq_maxmsg = 0;
	zassert_equal(mq_open(MQ_NAME, O_RDWR | O_CREAT, 0600, &attr), (mqd_t)-1);
	zassert_equal(errno, EINVAL);

	attr = mq_test_attr;
	attr.mq_msgsize = -1;
	zassert_equal(mq_open(MQ_NAME, O_RDWR | O_CREAT, 0600, &attr), (mqd_t)-1);
	zassert_equal(errno, EINVAL);
}

ZTEST_USER(posix_message_passing, test_mq_open)
{
	mq_open_create_and_reopen();
	mq_test_section_reset();
	mq_open_persists_until_unlinked();
	mq_test_section_reset();
	mq_open_access_modes();
	mq_test_section_reset();
	mq_open_excl();
	mq_test_section_reset();
	mq_open_errors();
	mq_test_section_reset();
}
```

## src/mq_receive.c
```c
/*
 * SPDX-FileCopyrightText: Copyright The Zephyr Project Contributors
 *
 * SPDX-License-Identifier: Apache-2.0
 */

#include <signal.h>
#include <stdint.h>

#include "message_passing_tests.h"

static void mq_receive_reports_length_and_priority(void)
{
	char buf[MQ_MSG_SIZE];
	unsigned int prio = 0xffffffff;
	mqd_t mqd = mq_test_open(0);

	zassert_not_equal(mqd, (mqd_t)-1);
	zassert_ok(mq_send(mqd, "sized", 6, 5));

	/* the actual sent length is returned, not the queue's message size */
	zassert_equal(mq_receive(mqd, buf, sizeof(buf), &prio), 6);
	zassert_equal(prio, 5);
	zassert_mem_equal(buf, "sized", 6);

	/* a NULL priority pointer is accepted */
	zassert_ok(mq_send(mqd, "again", 6, 2));
	zassert_equal(mq_receive(mqd, buf, sizeof(buf), NULL), 6);

	zassert_ok(mq_close(mqd));
	zassert_ok(mq_unlink(MQ_NAME));
}

static void mq_receive_nonblock(void)
{
	char buf[MQ_MSG_SIZE];
	mqd_t mqd = mq_test_open(O_NONBLOCK);

	zassert_not_equal(mqd, (mqd_t)-1);

	/* an empty queue on a non-blocking descriptor does not wait */
	zassert_equal(mq_receive(mqd, buf, sizeof(buf), NULL), -1);
	zassert_equal(errno, EAGAIN);

	zassert_ok(mq_close(mqd));
	zassert_ok(mq_unlink(MQ_NAME));
}

static void mq_receive_errors(void)
{
	char buf[MQ_MSG_SIZE];
	char small[MQ_MSG_SIZE - 1];
	mqd_t mqd = mq_test_open(0);

	zassert_not_equal(mqd, (mqd_t)-1);
	zassert_ok(mq_send(mqd, "msg", 4, 0));

	/* the receive buffer must be able to hold a maximum-size message */
	zassert_equal(mq_receive(mqd, small, sizeof(small), NULL), -1);
	zassert_equal(errno, EMSGSIZE);

	/* a buffer declared larger than any message takes only the message */
	zassert_equal(mq_receive(mqd, buf, SIZE_MAX, NULL), 4);

	/* a descriptor that is not open */
	zassert_equal(mq_receive((mqd_t)-1, buf, sizeof(buf), NULL), -1);
	zassert_equal(errno, EBADF);

	zassert_ok(mq_close(mqd));
	zassert_ok(mq_unlink(MQ_NAME));
}

/* re-armed: the first alarm may land before the wait it is meant to interrupt */
static void mq_receive_signal_handler(int sig)
{
	ARG_UNUSED(sig);
	(void)alarm(1);
}

static void mq_receive_interrupted(void)
{
	struct sigaction act = {.sa_handler = mq_receive_signal_handler};
	char buf[MQ_MSG_SIZE];
	sigset_t set;
	mqd_t mqd = mq_test_open(0);

	zassert_not_equal(mqd, (mqd_t)-1);

	/* nothing is sent: the caught signal ends the wait */
	zassert_ok(sigemptyset(&set));
	zassert_ok(sigaddset(&set, SIGALRM));
	zassert_ok(sigprocmask(SIG_UNBLOCK, &set, NULL));
	zassert_ok(sigaction(SIGALRM, &act, NULL));
	zassert_equal(alarm(1), 0);
	zassert_equal(mq_receive(mqd, buf, sizeof(buf), NULL), -1);
	zassert_equal(errno, EINTR);
	zassert_true(alarm(0) <= 1);
	act.sa_handler = SIG_DFL;
	zassert_ok(sigaction(SIGALRM, &act, NULL));
	zassert_ok(sigprocmask(SIG_BLOCK, &set, NULL));

	zassert_ok(mq_close(mqd));
	zassert_ok(mq_unlink(MQ_NAME));
}

ZTEST_USER(posix_message_passing, test_mq_receive)
{
	mq_receive_reports_length_and_priority();
	mq_test_section_reset();
	mq_receive_nonblock();
	mq_test_section_reset();
	mq_receive_errors();
	mq_test_section_reset();
	/* the host libc delivers a process-directed signal to any of the simulator's host threads */
	if (!IS_ENABLED(CONFIG_NATIVE_LIBC)) {
		mq_receive_interrupted();
		mq_test_section_reset();
	}
}
```

## src/mq_send.c
```c
/*
 * SPDX-FileCopyrightText: Copyright The Zephyr Project Contributors
 *
 * SPDX-License-Identifier: Apache-2.0
 */

#include <stdint.h>

#include "message_passing_tests.h"

static void mq_send_priority_order(void)
{
	char buf[MQ_MSG_SIZE];
	unsigned int prio;
	mqd_t mqd = mq_test_open(0);

	zassert_not_equal(mqd, (mqd_t)-1);

	zassert_ok(mq_send(mqd, "low", 4, 1));
	zassert_ok(mq_send(mqd, "high A", 7, 3));
	zassert_ok(mq_send(mqd, "mid", 4, 2));
	zassert_ok(mq_send(mqd, "high B", 7, 3));

	/* highest priority first, FIFO within a priority */
	zassert_equal(mq_receive(mqd, buf, sizeof(buf), &prio), 7);
	zassert_equal(prio, 3);
	zassert_mem_equal(buf, "high A", 7);

	zassert_equal(mq_receive(mqd, buf, sizeof(buf), &prio), 7);
	zassert_equal(prio, 3);
	zassert_mem_equal(buf, "high B", 7);

	zassert_equal(mq_receive(mqd, buf, sizeof(buf), &prio), 4);
	zassert_equal(prio, 2);
	zassert_mem_equal(buf, "mid", 4);

	zassert_equal(mq_receive(mqd, buf, sizeof(buf), &prio), 4);
	zassert_equal(prio, 1);
	zassert_mem_equal(buf, "low", 4);

	zassert_ok(mq_close(mqd));
	zassert_ok(mq_unlink(MQ_NAME));
}

static void mq_send_variable_length(void)
{
	char buf[MQ_MSG_SIZE];
	mqd_t mqd = mq_test_open(0);

	zassert_not_equal(mqd, (mqd_t)-1);

	/* a zero-length message is a message */
	zassert_ok(mq_send(mqd, "", 0, 0));
	zassert_ok(mq_send(mqd, "1234567", 8, 0));

	zassert_equal(mq_receive(mqd, buf, sizeof(buf), NULL), 0);
	zassert_equal(mq_receive(mqd, buf, sizeof(buf), NULL), 8);
	zassert_mem_equal(buf, "1234567", 8);

	zassert_ok(mq_close(mqd));
	zassert_ok(mq_unlink(MQ_NAME));
}

static void mq_send_nonblock(void)
{
	mqd_t mqd = mq_test_open(O_NONBLOCK);

	zassert_not_equal(mqd, (mqd_t)-1);

	mq_test_fill(mqd, 0);

	/* a full queue on a non-blocking descriptor does not wait */
	zassert_equal(mq_send(mqd, "overflow", 9, 0), -1);
	zassert_equal(errno, EAGAIN);

	zassert_ok(mq_close(mqd));
	zassert_ok(mq_unlink(MQ_NAME));
}

static void mq_send_errors(void)
{
	char big[MQ_MSG_SIZE + 1] = {0};
	mqd_t mqd = mq_test_open(0);

	zassert_not_equal(mqd, (mqd_t)-1);

	/* a message larger than the queue's message size */
	zassert_equal(mq_send(mqd, big, sizeof(big), 0), -1);
	zassert_equal(errno, EMSGSIZE);
	/* a length no buffer could back is rejected the same way */
	zassert_equal(mq_send(mqd, big, SIZE_MAX, 0), -1);
	zassert_equal(errno, EMSGSIZE);

	/* a priority the implementation does not support */
	zassert_equal(mq_send(mqd, "prio", 5, MQ_PRIO_MAX), -1);
	zassert_equal(errno, EINVAL);

	/* a descriptor that is not open */
	zassert_equal(mq_send((mqd_t)-1, "bad", 4, 0), -1);
	zassert_equal(errno, EBADF);

	zassert_ok(mq_close(mqd));
	zassert_ok(mq_unlink(MQ_NAME));
}

ZTEST_USER(posix_message_passing, test_mq_send)
{
	mq_send_priority_order();
	mq_test_section_reset();
	mq_send_variable_length();
	mq_test_section_reset();
	mq_send_nonblock();
	mq_test_section_reset();
	mq_send_errors();
	mq_test_section_reset();
}
```

## src/mq_setattr.c
```c
/*
 * SPDX-FileCopyrightText: Copyright The Zephyr Project Contributors
 *
 * SPDX-License-Identifier: Apache-2.0
 */

#include "message_passing_tests.h"

static void mq_setattr_toggles_nonblock(void)
{
	char buf[MQ_MSG_SIZE];
	struct mq_attr attr = {0};
	struct mq_attr out;
	mqd_t mqd = mq_test_open(0);

	zassert_not_equal(mqd, (mqd_t)-1);

	attr.mq_flags = O_NONBLOCK;
	zassert_ok(mq_setattr(mqd, &attr, NULL));
	zassert_ok(mq_getattr(mqd, &out));
	zassert_equal(out.mq_flags, O_NONBLOCK);

	/* the new flag takes effect on subsequent operations */
	zassert_equal(mq_receive(mqd, buf, sizeof(buf), NULL), -1);
	zassert_equal(errno, EAGAIN);

	attr.mq_flags = 0;
	zassert_ok(mq_setattr(mqd, &attr, NULL));
	zassert_ok(mq_getattr(mqd, &out));
	zassert_equal(out.mq_flags, 0);

	zassert_ok(mq_close(mqd));
	zassert_ok(mq_unlink(MQ_NAME));
}

static void mq_setattr_reports_old_attributes(void)
{
	struct mq_attr attr = {.mq_flags = O_NONBLOCK};
	struct mq_attr old;
	mqd_t mqd = mq_test_open(0);

	zassert_not_equal(mqd, (mqd_t)-1);
	zassert_ok(mq_send(mqd, "one", 4, 0));

	zassert_ok(mq_setattr(mqd, &attr, &old));

	/* omqstat describes the queue as it was before the call */
	zassert_equal(old.mq_flags, 0);
	zassert_equal(old.mq_msgsize, MQ_MSG_SIZE);
	zassert_equal(old.mq_maxmsg, MQ_MAX_MSGS);
	zassert_equal(old.mq_curmsgs, 1);

	zassert_ok(mq_close(mqd));
	zassert_ok(mq_unlink(MQ_NAME));
}

static void mq_setattr_errors(void)
{
	struct mq_attr attr = {0};
	mqd_t mqd = mq_test_open(0);

	zassert_not_equal(mqd, (mqd_t)-1);

	/* only O_NONBLOCK may be set */
	attr.mq_flags = O_CREAT;
	zassert_equal(mq_setattr(mqd, &attr, NULL), -1);
	zassert_equal(errno, EINVAL);

	attr.mq_flags = 0;
	zassert_equal(mq_setattr((mqd_t)-1, &attr, NULL), -1);
	zassert_equal(errno, EBADF);

	zassert_ok(mq_close(mqd));
	zassert_ok(mq_unlink(MQ_NAME));
}

ZTEST_USER(posix_message_passing, test_mq_setattr)
{
	mq_setattr_toggles_nonblock();
	mq_test_section_reset();
	mq_setattr_reports_old_attributes();
	mq_test_section_reset();
	mq_setattr_errors();
	mq_test_section_reset();
}
```

## src/mq_timedreceive.c
```c
/*
 * SPDX-FileCopyrightText: Copyright The Zephyr Project Contributors
 *
 * SPDX-License-Identifier: Apache-2.0
 */

#include "message_passing_tests.h"

static void mq_timedreceive_immediate(void)
{
	char buf[MQ_MSG_SIZE];
	unsigned int prio;
	struct timespec ts = mq_test_deadline(MQ_TIMEOUT_MS);
	mqd_t mqd = mq_test_open(0);

	zassert_not_equal(mqd, (mqd_t)-1);
	zassert_ok(mq_send(mqd, "ready", 6, 4));

	/* a message is available, so the deadline never comes into play */
	zassert_equal(mq_timedreceive(mqd, buf, sizeof(buf), &prio, &ts), 6);
	zassert_equal(prio, 4);
	zassert_mem_equal(buf, "ready", 6);

	zassert_ok(mq_close(mqd));
	zassert_ok(mq_unlink(MQ_NAME));
}

static void mq_timedreceive_times_out(void)
{
	char buf[MQ_MSG_SIZE];
	struct timespec ts;
	struct timespec before;
	struct timespec after;
	mqd_t mqd = mq_test_open(0);

	zassert_not_equal(mqd, (mqd_t)-1);

	zassert_ok(clock_gettime(CLOCK_REALTIME, &before));
	ts = mq_test_deadline(MQ_TIMEOUT_MS);
	zassert_equal(mq_timedreceive(mqd, buf, sizeof(buf), NULL, &ts), -1);
	zassert_equal(errno, ETIMEDOUT);
	zassert_ok(clock_gettime(CLOCK_REALTIME, &after));

	int64_t elapsed_ms = (int64_t)(after.tv_sec - before.tv_sec) * MSEC_PER_SEC +
			     (after.tv_nsec - before.tv_nsec) / NSEC_PER_MSEC;

	zassert_true(elapsed_ms >= MQ_TIMEOUT_MS, "returned early after %lld ms", elapsed_ms);

	zassert_ok(mq_close(mqd));
	zassert_ok(mq_unlink(MQ_NAME));
}

static void mq_timedreceive_expired_deadline(void)
{
	char buf[MQ_MSG_SIZE];
	struct timespec ts = mq_test_deadline(-MQ_TIMEOUT_MS);
	mqd_t mqd = mq_test_open(0);

	zassert_not_equal(mqd, (mqd_t)-1);

	zassert_equal(mq_timedreceive(mqd, buf, sizeof(buf), NULL, &ts), -1);
	zassert_equal(errno, ETIMEDOUT);

	zassert_ok(mq_close(mqd));
	zassert_ok(mq_unlink(MQ_NAME));
}

static void mq_timedreceive_errors(void)
{
	char buf[MQ_MSG_SIZE];
	char small[MQ_MSG_SIZE - 1];
	struct timespec ts = mq_test_deadline(MQ_TIMEOUT_MS);
	struct timespec bad = {.tv_sec = 0, .tv_nsec = NSEC_PER_SEC};
	mqd_t mqd = mq_test_open(0);

	zassert_not_equal(mqd, (mqd_t)-1);

	/*
	 * abstime is only required to be validated when the call would block,
	 * so the malformed deadline is checked against an empty queue.
	 */
	zassert_equal(mq_timedreceive(mqd, buf, sizeof(buf), NULL, &bad), -1);
	zassert_equal(errno, EINVAL);

	zassert_ok(mq_send(mqd, "msg", 4, 0));

	zassert_equal(mq_timedreceive(mqd, small, sizeof(small), NULL, &ts), -1);
	zassert_equal(errno, EMSGSIZE);

	zassert_equal(mq_timedreceive((mqd_t)-1, buf, sizeof(buf), NULL, &ts), -1);
	zassert_equal(errno, EBADF);

	zassert_ok(mq_close(mqd));
	zassert_ok(mq_unlink(MQ_NAME));
}

ZTEST_USER(posix_message_passing, test_mq_timedreceive)
{
	mq_timedreceive_immediate();
	mq_test_section_reset();
	mq_timedreceive_times_out();
	mq_test_section_reset();
	mq_timedreceive_expired_deadline();
	mq_test_section_reset();
	mq_timedreceive_errors();
	mq_test_section_reset();
}
```

## src/mq_timedsend.c
```c
/*
 * SPDX-FileCopyrightText: Copyright The Zephyr Project Contributors
 *
 * SPDX-License-Identifier: Apache-2.0
 */

#include "message_passing_tests.h"

static void mq_timedsend_immediate(void)
{
	char buf[MQ_MSG_SIZE];
	struct timespec ts = mq_test_deadline(MQ_TIMEOUT_MS);
	mqd_t mqd = mq_test_open(0);

	zassert_not_equal(mqd, (mqd_t)-1);

	/* space is available, so the deadline never comes into play */
	zassert_ok(mq_timedsend(mqd, "timed", 6, 3, &ts));
	zassert_equal(mq_receive(mqd, buf, sizeof(buf), NULL), 6);
	zassert_mem_equal(buf, "timed", 6);

	zassert_ok(mq_close(mqd));
	zassert_ok(mq_unlink(MQ_NAME));
}

static void mq_timedsend_times_out(void)
{
	struct timespec ts;
	struct timespec before;
	struct timespec after;
	mqd_t mqd = mq_test_open(0);

	zassert_not_equal(mqd, (mqd_t)-1);
	mq_test_fill(mqd, 0);

	zassert_ok(clock_gettime(CLOCK_REALTIME, &before));
	ts = mq_test_deadline(MQ_TIMEOUT_MS);
	zassert_equal(mq_timedsend(mqd, "late", 5, 0, &ts), -1);
	zassert_equal(errno, ETIMEDOUT);
	zassert_ok(clock_gettime(CLOCK_REALTIME, &after));

	/* the call waited for the deadline rather than returning at once */
	int64_t elapsed_ms = (int64_t)(after.tv_sec - before.tv_sec) * MSEC_PER_SEC +
			     (after.tv_nsec - before.tv_nsec) / NSEC_PER_MSEC;

	zassert_true(elapsed_ms >= MQ_TIMEOUT_MS, "returned early after %lld ms", elapsed_ms);

	zassert_ok(mq_close(mqd));
	zassert_ok(mq_unlink(MQ_NAME));
}

static void mq_timedsend_expired_deadline(void)
{
	struct timespec ts = mq_test_deadline(-MQ_TIMEOUT_MS);
	mqd_t mqd = mq_test_open(0);

	zassert_not_equal(mqd, (mqd_t)-1);
	mq_test_fill(mqd, 0);

	/* a deadline already in the past does not wait */
	zassert_equal(mq_timedsend(mqd, "past", 5, 0, &ts), -1);
	zassert_equal(errno, ETIMEDOUT);

	zassert_ok(mq_close(mqd));
	zassert_ok(mq_unlink(MQ_NAME));
}

static void mq_timedsend_errors(void)
{
	struct timespec ts = mq_test_deadline(MQ_TIMEOUT_MS);
	struct timespec bad = {.tv_sec = 0, .tv_nsec = NSEC_PER_SEC};
	char big[MQ_MSG_SIZE + 1] = {0};
	mqd_t mqd = mq_test_open(0);

	zassert_not_equal(mqd, (mqd_t)-1);

	/*
	 * abstime is only required to be validated when the call would block,
	 * so the malformed deadline is checked against a full queue.
	 */
	mq_test_fill(mqd, 0);
	zassert_equal(mq_timedsend(mqd, "msg", 4, 0, &bad), -1);
	zassert_equal(errno, EINVAL);

	zassert_equal(mq_timedsend(mqd, big, sizeof(big), 0, &ts), -1);
	zassert_equal(errno, EMSGSIZE);

	zassert_equal(mq_timedsend((mqd_t)-1, "msg", 4, 0, &ts), -1);
	zassert_equal(errno, EBADF);

	zassert_ok(mq_close(mqd));
	zassert_ok(mq_unlink(MQ_NAME));
}

ZTEST_USER(posix_message_passing, test_mq_timedsend)
{
	mq_timedsend_immediate();
	mq_test_section_reset();
	mq_timedsend_times_out();
	mq_test_section_reset();
	mq_timedsend_expired_deadline();
	mq_test_section_reset();
	mq_timedsend_errors();
	mq_test_section_reset();
}
```

## src/mq_unlink.c
```c
/*
 * SPDX-FileCopyrightText: Copyright The Zephyr Project Contributors
 *
 * SPDX-License-Identifier: Apache-2.0
 */

#include "message_passing_tests.h"

static void mq_unlink_frees_name_immediately(void)
{
	char buf[MQ_MSG_SIZE];
	mqd_t old = mq_test_open(0);
	mqd_t fresh;

	zassert_not_equal(old, (mqd_t)-1);
	zassert_ok(mq_send(old, "old", 4, 0));
	zassert_ok(mq_unlink(MQ_NAME));

	/* the open descriptor keeps working on the unlinked queue */
	zassert_equal(mq_receive(old, buf, sizeof(buf), NULL), 4);
	zassert_mem_equal(buf, "old", 4);

	/* while the name is immediately reusable for a new, distinct queue */
	fresh = mq_test_open(0);
	zassert_not_equal(fresh, (mqd_t)-1, "name not reusable after unlink: %d", errno);
	zassert_ok(mq_send(fresh, "new", 4, 0));

	/* the two queues are independent: the message went to the new one only */
	struct timespec ts = mq_test_deadline(MQ_TIMEOUT_MS);

	zassert_equal(mq_timedreceive(old, buf, sizeof(buf), NULL, &ts), -1);
	zassert_equal(errno, ETIMEDOUT, "descriptors alias the same queue");

	zassert_equal(mq_receive(fresh, buf, sizeof(buf), NULL), 4);
	zassert_mem_equal(buf, "new", 4);

	zassert_ok(mq_close(fresh));
	zassert_ok(mq_close(old));
	zassert_ok(mq_unlink(MQ_NAME));
}

static void mq_unlink_multiple(void)
{
	struct mq_attr attr = mq_test_attr;
	mqd_t a = mq_test_open(0);
	mqd_t b = mq_open(MQ_NAME2, O_RDWR | O_CREAT, 0600, &attr);

	zassert_not_equal(a, (mqd_t)-1);
	zassert_not_equal(b, (mqd_t)-1);

	zassert_ok(mq_unlink(MQ_NAME));
	zassert_ok(mq_unlink(MQ_NAME2));

	zassert_ok(mq_close(a));
	zassert_ok(mq_close(b));
}

static void mq_unlink_errors(void)
{
	zassert_equal(mq_unlink(MQ_NAME), -1);
	zassert_equal(errno, ENOENT);

	zassert_equal(mq_unlink("/no_such_queue"), -1);
	zassert_equal(errno, ENOENT);
}

ZTEST_USER(posix_message_passing, test_mq_unlink)
{
	mq_unlink_frees_name_immediately();
	mq_test_section_reset();
	mq_unlink_multiple();
	mq_test_section_reset();
	mq_unlink_errors();
	mq_test_section_reset();
}
```
