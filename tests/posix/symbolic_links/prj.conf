## CMakeLists.txt
```
# SPDX-License-Identifier: Apache-2.0

cmake_minimum_required(VERSION 3.20.0)
find_package(Zephyr REQUIRED HINTS $ENV{ZEPHYR_BASE})
project(posix_symbolic_links)

FILE(GLOB app_sources src/*.c)
target_sources(app PRIVATE ${app_sources})

target_compile_options(app PRIVATE -U_POSIX_C_SOURCE -D_POSIX_C_SOURCE=200809L)
target_compile_options(app PRIVATE -U_XOPEN_SOURCE -D_XOPEN_SOURCE=700)
```

## prj.conf
```kconfig
CONFIG_ZTEST=y
CONFIG_POSIX_AEP_CHOICE_PSE52=y
CONFIG_POSIX_SYMBOLIC_LINKS=y

# XSI provides the S_IF* constants and the XSI struct stat members
CONFIG_XSI=y

# symbolic links need ext2
CONFIG_FILE_SYSTEM=y
CONFIG_FILE_SYSTEM_EXT2=y
CONFIG_FILE_SYSTEM_MKFS=y
CONFIG_DISK_ACCESS=y
CONFIG_DISK_DRIVER_RAM=y
CONFIG_TEST_RANDOM_GENERATOR=y
CONFIG_EVENTFD=n

CONFIG_ZVFS_OPEN_IGNORE_MIN=y
CONFIG_ZVFS_OPEN_MAX=12
CONFIG_ZVFS_DIR_MAX=4

CONFIG_MAIN_STACK_SIZE=4096
CONFIG_ZTEST_STACK_SIZE=4096
CONFIG_TEST_EXTRA_STACK_SIZE=4096
CONFIG_HEAP_MEM_POOL_SIZE=65536
CONFIG_COMMON_LIBC_MALLOC_ARENA_SIZE=16384
```

## src/main.c
```c
/*
 * SPDX-FileCopyrightText: Copyright The Zephyr Project Contributors
 * SPDX-License-Identifier: Apache-2.0
 */

#include "symbolic_links_tests.h"

#include <fcntl.h>
#include <string.h>
#include <sys/stat.h>
#include <unistd.h>

#include <zephyr/kernel.h>

#ifndef CONFIG_NATIVE_LIBC
#include <zephyr/fs/fs.h>
#endif
#ifdef CONFIG_USERSPACE
#include <zephyr/sys/fdtable.h>
#include <zephyr/sys/internal/fdtable_priv.h>

extern struct k_mem_partition zvfs_dir_partition;
#endif

ZTEST_BMEM int fs_test_fd = -1;

#ifndef CONFIG_NATIVE_LIBC
static struct fs_mount_t fs_mnt = {
	.type = FS_EXT2,
	.mnt_point = "/",
	.storage_dev = (void *)"RAM",
};
#endif

static void grant_fd(int fd)
{
#ifdef CONFIG_USERSPACE
	if (fd >= 0) {
		k_object_access_all_grant(zvfs_fd_entry_get(fd));
	}
#else
	ARG_UNUSED(fd);
#endif
}

void fs_test_reset(void)
{
	int fd;

	(void)unlink(TEST_LINK);
	(void)unlink(TEST_DANGLE);
	(void)unlink(TEST_NOENT);
	(void)unlink(TEST_FILE);
	(void)rmdir(TEST_ROOT);
	zassert_ok(mkdir(TEST_ROOT, 0777));
	fd = open(TEST_FILE, O_WRONLY | O_CREAT | O_TRUNC, 0600);
	zassert_true(fd >= 0);
	zassert_equal(write(fd, TEST_CONTENT, strlen(TEST_CONTENT)), strlen(TEST_CONTENT));
	zassert_ok(close(fd));
}

static void before(void *arg)
{
	ARG_UNUSED(arg);

	fs_test_reset();
	fs_test_fd = open(TEST_FILE, O_RDWR);
	zassert_true(fs_test_fd >= 0);
	grant_fd(fs_test_fd);
}

static void after(void *arg)
{
	ARG_UNUSED(arg);

	if (fs_test_fd >= 0) {
		close(fs_test_fd);
		fs_test_fd = -1;
	}
}

static void *setup(void)
{
#ifndef CONFIG_NATIVE_LIBC
	zassert_ok(fs_mkfs(FS_EXT2, (uintptr_t)"RAM", NULL, 0));
	zassert_ok(fs_mount(&fs_mnt));
#endif
	(void)mkdir(FS_TMPDIR, 0777);
#ifdef CONFIG_USERSPACE
	zassert_ok(k_mem_domain_add_partition(&k_mem_domain_default, &zvfs_dir_partition));
#endif

	return NULL;
}

static void teardown(void *arg)
{
	ARG_UNUSED(arg);

	fs_test_reset();
	(void)unlink(TEST_FILE);
	(void)rmdir(TEST_ROOT);
#ifndef CONFIG_NATIVE_LIBC
	(void)fs_unmount(&fs_mnt);
#endif
}

ZTEST_SUITE(posix_symbolic_links, NULL, setup, before, after, teardown);
```

## src/lchown.c
```c
/*
 * SPDX-FileCopyrightText: Copyright The Zephyr Project Contributors
 * SPDX-License-Identifier: Apache-2.0
 */

#include "symbolic_links_tests.h"

#include <errno.h>
#include <sys/stat.h>
#include <unistd.h>

ZTEST_USER(posix_symbolic_links, test_lchown)
{
	struct stat st;

	/* the owning identity (a host user cannot give files away), and "leave unchanged" */
	zassert_ok(lchown(TEST_FILE, IS_ENABLED(CONFIG_NATIVE_LIBC) ? (uid_t)-1 : 0,
			  IS_ENABLED(CONFIG_NATIVE_LIBC) ? (gid_t)-1 : 0));
	zassert_ok(lchown(TEST_FILE, (uid_t)-1, (gid_t)-1));

	/* the link itself is the object: a dangling link is fine, its target is not */
	zassert_ok(symlink("nope", TEST_DANGLE));
	zassert_ok(lchown(TEST_DANGLE, (uid_t)-1, (gid_t)-1));
	errno = 0;
	zassert_equal(stat(TEST_DANGLE, &st), -1);
	zassert_equal(errno, ENOENT);
	zassert_ok(unlink(TEST_DANGLE));

	errno = 0;
	zassert_equal(lchown(TEST_NOENT, (uid_t)-1, (gid_t)-1), -1);
	zassert_equal(errno, ENOENT);

	/* the privileged identity may give a link away without touching its target */
	IF_NOT_NATIVE_LIBC({
		zassert_ok(symlink("file.txt", TEST_DANGLE));
		zassert_ok(lchown(TEST_DANGLE, 1000, (gid_t)-1));
		zassert_ok(lstat(TEST_DANGLE, &st));
		zassert_equal(st.st_uid, 1000);
		zassert_equal(st.st_gid, 0);
		zassert_ok(stat(TEST_DANGLE, &st));
		zassert_equal(st.st_uid, 0, "the target kept its owner");
		zassert_ok(unlink(TEST_DANGLE));
	});
}
```

## src/lstat.c
```c
/*
 * SPDX-FileCopyrightText: Copyright The Zephyr Project Contributors
 * SPDX-License-Identifier: Apache-2.0
 */

#include "symbolic_links_tests.h"

#include <errno.h>
#include <string.h>
#include <sys/stat.h>
#include <unistd.h>

ZTEST_USER(posix_symbolic_links, test_lstat)
{
	struct stat st;

	/* without a link in the way, lstat() is stat() */
	zassert_ok(lstat(TEST_FILE, &st));
	zassert_true(S_ISREG(st.st_mode));
	zassert_equal(st.st_size, strlen(TEST_CONTENT));
	zassert_ok(lstat(TEST_ROOT, &st));
	zassert_true(S_ISDIR(st.st_mode));

	/* the link itself, not the file behind it */
	zassert_ok(symlink("file.txt", TEST_LINK));
	zassert_ok(lstat(TEST_LINK, &st));
	zassert_true(S_ISLNK(st.st_mode));
	zassert_equal(st.st_size, strlen("file.txt"));
	zassert_ok(stat(TEST_LINK, &st));
	zassert_true(S_ISREG(st.st_mode));
	zassert_equal(st.st_size, strlen(TEST_CONTENT));
	zassert_ok(unlink(TEST_LINK));

	errno = 0;
	zassert_equal(lstat(TEST_NOENT, &st), -1);
	zassert_equal(errno, ENOENT);
}
```

## src/readlink.c
```c
/*
 * SPDX-FileCopyrightText: Copyright The Zephyr Project Contributors
 * SPDX-License-Identifier: Apache-2.0
 */

#include "symbolic_links_tests.h"

#include <errno.h>
#include <string.h>
#include <unistd.h>

ZTEST_USER(posix_symbolic_links, test_readlink)
{
	char buf[32];
	ssize_t len;

	zassert_ok(symlink("file.txt", TEST_LINK));

	len = readlink(TEST_LINK, buf, sizeof(buf));
	zassert_equal(len, strlen("file.txt"), "readlink: %zd (errno %d)", len, errno);
	zassert_mem_equal(buf, "file.txt", len);

	/* a short buffer truncates, without a terminator */
	memset(buf, 'x', sizeof(buf));
	len = readlink(TEST_LINK, buf, 4);
	zassert_equal(len, 4, "readlink: %zd (errno %d)", len, errno);
	zassert_mem_equal(buf, "filex", 5);

	errno = 0;
	zassert_equal(readlink(TEST_FILE, buf, sizeof(buf)), -1);
	zassert_equal(errno, EINVAL);

	errno = 0;
	zassert_equal(readlink(TEST_NOENT, buf, sizeof(buf)), -1);
	zassert_equal(errno, ENOENT);

	zassert_ok(unlink(TEST_LINK));
}
```

## src/symbolic_links_tests.h
```c
/*
 * SPDX-FileCopyrightText: Copyright The Zephyr Project Contributors
 * SPDX-License-Identifier: Apache-2.0
 */

#ifndef POSIX_TESTS_SYMBOLIC_LINKS_TESTS_H_
#define POSIX_TESTS_SYMBOLIC_LINKS_TESTS_H_

#include <zephyr/ztest.h>

#include "../../shared/linux_compat_test.h"

#define FS_TMPDIR    "/tmp"
#define TEST_ROOT    FS_TMPDIR "/pslnk"
#define TEST_FILE    TEST_ROOT "/file.txt"
#define TEST_LINK    TEST_ROOT "/link"
#define TEST_DANGLE  TEST_ROOT "/dangle"
#define TEST_NOENT   TEST_ROOT "/nope"
#define TEST_CONTENT "The quick brown fox jumps over the lazy dog!"

/* fixture descriptor, opened and granted per test */
extern int fs_test_fd; /* TEST_FILE, O_RDWR */

#endif /* POSIX_TESTS_SYMBOLIC_LINKS_TESTS_H_ */
```

## src/symlink.c
```c
/*
 * SPDX-FileCopyrightText: Copyright The Zephyr Project Contributors
 * SPDX-License-Identifier: Apache-2.0
 */

#include "symbolic_links_tests.h"

#include <errno.h>
#include <fcntl.h>
#include <string.h>
#include <sys/stat.h>
#include <unistd.h>

ZTEST_USER(posix_symbolic_links, test_symlink)
{
	struct stat st;
	char buf[sizeof(TEST_CONTENT)];
	int fd;

	zassert_ok(symlink(TEST_FILE, TEST_LINK));
	zassert_ok(lstat(TEST_LINK, &st));
	zassert_true(S_ISLNK(st.st_mode));
	zassert_ok(stat(TEST_LINK, &st));
	zassert_true(S_ISREG(st.st_mode));

	/* following the link reaches the file */
	fd = open(TEST_LINK, O_RDONLY);
	zassert_true(fd >= 0, "open(link) failed: %d", errno);
	zassert_equal(read(fd, buf, sizeof(buf) - 1), strlen(TEST_CONTENT));
	zassert_ok(close(fd));

	errno = 0;
	zassert_equal(symlink(TEST_FILE, TEST_LINK), -1);
	zassert_equal(errno, EEXIST);

	/* removing the link leaves the file */
	zassert_ok(unlink(TEST_LINK));
	zassert_ok(stat(TEST_FILE, &st));
	zassert_equal(st.st_size, strlen(TEST_CONTENT));

	/* the target need not exist */
	zassert_ok(symlink("nope", TEST_DANGLE));
	zassert_ok(lstat(TEST_DANGLE, &st));
	zassert_true(S_ISLNK(st.st_mode));
	errno = 0;
	zassert_equal(stat(TEST_DANGLE, &st), -1);
	zassert_equal(errno, ENOENT);
	zassert_ok(unlink(TEST_DANGLE));

	errno = 0;
	zassert_equal(symlink(TEST_FILE, TEST_NOENT "/link"), -1);
	zassert_equal(errno, ENOENT);
}
```
