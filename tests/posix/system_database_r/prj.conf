## CMakeLists.txt
```
# SPDX-License-Identifier: Apache-2.0

cmake_minimum_required(VERSION 3.20.0)
find_package(Zephyr REQUIRED HINTS $ENV{ZEPHYR_BASE})
project(posix_system_database_r)

target_sources(app PRIVATE src/main.c)

target_compile_options(app PRIVATE -U_POSIX_C_SOURCE -D_POSIX_C_SOURCE=200809L)
```

## Kconfig
```
# Copyright (c) 2025 Friedt Professional Engineering Services, Inc.
# SPDX-License-Identifier: Apache-2.0

rsource "../Kconfig.test_common"
source "Kconfig.zephyr"

config TC_PROVIDES_POSIX_SYSTEM_DATABASE_R
	bool
	default y if TEST_POSIX_LINUX_COMPAT && ARCH_POSIX && CONFIG_NATIVE_LIBC
	default n
```

## prj.conf
```kconfig
CONFIG_ZTEST=y

CONFIG_POSIX_AEP_CHOICE_BASE=y
CONFIG_POSIX_SYSTEM_DATABASE_R=y

CONFIG_FILE_SYSTEM=y
CONFIG_FAT_FILESYSTEM_ELM=y

CONFIG_MAIN_STACK_SIZE=4096
```

## src/main.c
```c
/*
 * Copyright (c) 2024 Meta Platforms
 * Copyright (c) 2025 Friedt Professional Engineering Services, Inc.
 *
 * SPDX-License-Identifier: Apache-2.0
 */

#include <errno.h>
#include <grp.h>
#include <pwd.h>

#include <zephyr/ztest.h>

ZTEST(posix_system_database_r, test_getpwnam_r)
{
	zassert_equal(getpwnam_r(NULL, NULL, NULL, 42, NULL), ENOSYS);
}

ZTEST(posix_system_database_r, test_getpwuid_r)
{
	zassert_equal(getpwuid_r(42, NULL, NULL, 42, NULL), ENOSYS);
}

ZTEST(posix_system_database_r, test_getgrnam_r)
{
	zassert_equal(getgrnam_r(NULL, NULL, NULL, 42, NULL), ENOSYS);
}

ZTEST(posix_system_database_r, test_getgrgid_r)
{
	zassert_equal(getgrgid_r(42, NULL, NULL, 42, NULL), ENOSYS);
}

ZTEST_SUITE(posix_system_database_r, NULL, NULL, NULL, NULL, NULL);
```

## src/fs.c
```c
/*
 * Copyright (c) 2024 Friedt Professional Engineering Services, Inc.
 *
 * SPDX-License-Identifier: Apache-2.0
 */

#include <string.h>

#include <ff.h>
#include <zephyr/fs/fs.h>
#include <zephyr/sys/util.h>
#include <zephyr/ztest.h>

static FATFS _fs;

static struct fs_mount_t _mnt = {
	.type = FS_FATFS,
	.mnt_point = "/",
	.fs_data = &_fs,
};

struct _entry {
	const char *const name;
	const char *const data;
};

static const struct _entry _data[] = {
	{.name = "/etc/passwd",
	 .data = "user:x:1000:1000:user:/home/user:/bin/sh\nroot:x:0:0:root:/root:/bin/sh\n"},
	{.name = "/etc/group", .data = "user:x:1000:staff,admin\nroot:x:0:\n"},
};

void *setup(void)
{
	int ret;

	memset(&_fs, 0, sizeof(_fs));

	ret = fs_mount(&_mnt);
	zassert_ok(ret, "mount failed: %d", ret);

	ret = fs_mkdir("/etc");
	zassert_ok(ret, "mkdir failed: %d", ret);

	ARRAY_FOR_EACH_PTR(_data, entry) {
		int len;
		struct fs_file_t zfp;

		fs_file_t_init(&zfp);

		ret = fs_open(&zfp, entry->name, FS_O_CREATE | FS_O_RDWR | FS_O_TRUNC);
		zassert_true(ret >= 0, "open failed: %d", ret);

		len = strlen(entry->data);
		ret = fs_write(&zfp, entry->data, len);
		zassert_equal(ret, len, "%s returned %d instead of %d", "write", ret, len);

		ret = fs_close(&zfp);
		zassert_ok(ret, "%s returned %d instead of %d", "close", ret, len);
	};

	return &_mnt;
}

void teardown(void *arg)
{
	struct fs_mount_t *const mnt = arg;

	(void)fs_unmount(mnt);
}
```
