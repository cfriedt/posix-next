## lib/posix/device_specific/Kconfig
```kconfig
# SPDX-FileCopyrightText: Copyright The Zephyr Project Contributors
# SPDX-License-Identifier: Apache-2.0

config POSIX_DEVICE_SPECIFIC
	bool "POSIX terminal device interfaces"
	depends on POSIX_DEVICE_IO
	help
	  Select 'y' here and Zephyr will provide implementations of the
	  POSIX_DEVICE_SPECIFIC Option Group: the termios attribute and
	  line-control functions, ctermid(), isatty(), and ttyname(). The
	  console is the one terminal; attribute changes round-trip, and
	  the synchronous console driver completes drain, flush, flow, and
	  break operations trivially.

config POSIX_DEVICE_SPECIFIC_SHARED_IO_BAUD
	bool "One baud rate for input and output"
	depends on POSIX_DEVICE_SPECIFIC
	default y
	help
	  Select 'y' here and cfsetispeed() and cfsetospeed() set the one
	  baud rate a terminal has for both directions, as on Linux; an
	  input speed of zero follows the output speed. Select 'n' and the
	  input and output speeds are kept apart, for a UART that can run
	  them at different rates.
```

## lib/posix/symbolic_links/Kconfig
```kconfig
# SPDX-FileCopyrightText: Copyright The Zephyr Project Contributors
# SPDX-License-Identifier: Apache-2.0

config POSIX_SYMBOLIC_LINKS
	bool "POSIX symbolic links"
	depends on POSIX_FILE_SYSTEM
	imply FILE_SYSTEM_SYMLINKS
	imply FILE_SYSTEM_ATTRIBUTES
	help
	  Select 'y' here and Zephyr will provide implementations of the
	  POSIX_SYMBOLIC_LINKS Option Group: lchown(), lstat(), readlink(),
	  and symlink(). Symbolic links require support from the underlying
	  file system driver, built with FILE_SYSTEM_SYMLINKS; on file systems
	  without it, symlink() fails and lstat() is equivalent to stat().
	  lchown() changes the owner a file system stores for the link itself
	  (FILE_SYSTEM_ATTRIBUTES); without that, it fails with ENOTSUP.
```

## lib/posix/xsi_multi_process/Kconfig
```kconfig
# Copyright (c) The Zephyr Project Contributors
#
# SPDX-License-Identifier: Apache-2.0

config XSI_MULTI_PROCESS
	bool "X/Open multi process"
	depends on XSI
	depends on POSIX_MULTI_PROCESS
	help
	  Select 'y' here and Zephyr will provide implementations of
	  getrlimit(), getrusage() and setrlimit(). The resource limits are
	  the build's and cannot be changed; getpriority(), nice(),
	  setpriority() and ulimit() are not provided.
```

## tests/posix/device_specific_r/testcase.yaml
```yaml
common:
  tags:
    - posix_device_specific_r
  # 1 tier0 platform per supported architecture
  platform_key:
    - arch
    - simulation
tests:
  portability.posix.device_specific_r:
    filter: not CONFIG_NATIVE_LIBC
  portability.posix.device_specific_r.userspace:
    filter: (not CONFIG_NATIVE_LIBC) and CONFIG_ARCH_HAS_USERSPACE
    tags: userspace
    extra_configs:
      - CONFIG_TEST_USERSPACE=y
      - CONFIG_USERSPACE=y
  portability.posix.device_specific_r.minimal:
    filter: not CONFIG_NATIVE_LIBC
    extra_configs:
      - CONFIG_MINIMAL_LIBC=y
  portability.posix.device_specific_r.newlib:
    filter: (not CONFIG_NATIVE_LIBC) and (TOOLCHAIN_HAS_NEWLIB == 1)
    extra_configs:
      - CONFIG_NEWLIB_LIBC=y
  portability.posix.device_specific_r.picolibc:
    tags: picolibc
    filter: (not CONFIG_NATIVE_LIBC) and CONFIG_PICOLIBC_SUPPORTED
    extra_configs:
      - CONFIG_PICOLIBC=y
  portability.posix.device_specific_r.linux_compat:
    tags: native
    platform_allow:
      - native_sim
      - native_sim/native/64
    filter: CONFIG_NATIVE_LIBC
    extra_configs:
      - CONFIG_POSIX_TEST_LINUX_COMPAT=y
```

## tests/posix/job_control/testcase.yaml
```yaml
common:
  tags:
    - posix_job_control
  # 1 tier0 platform per supported architecture
  platform_key:
    - arch
    - simulation
tests:
  portability.posix.job_control:
    filter: not CONFIG_NATIVE_LIBC
  portability.posix.job_control.userspace:
    filter: (not CONFIG_NATIVE_LIBC) and CONFIG_ARCH_HAS_USERSPACE
    tags: userspace
    extra_configs:
      - CONFIG_TEST_USERSPACE=y
      - CONFIG_USERSPACE=y
  portability.posix.job_control.minimal:
    filter: not CONFIG_NATIVE_LIBC
    extra_configs:
      - CONFIG_MINIMAL_LIBC=y
  portability.posix.job_control.newlib:
    filter: (not CONFIG_NATIVE_LIBC) and (TOOLCHAIN_HAS_NEWLIB == 1)
    extra_configs:
      - CONFIG_NEWLIB_LIBC=y
  portability.posix.job_control.picolibc:
    tags: picolibc
    filter: (not CONFIG_NATIVE_LIBC) and CONFIG_PICOLIBC_SUPPORTED
    extra_configs:
      - CONFIG_PICOLIBC=y
  portability.posix.job_control.linux_compat:
    tags: native
    platform_allow:
      - native_sim
      - native_sim/native/64
    filter: CONFIG_NATIVE_LIBC
    extra_configs:
      - CONFIG_POSIX_TEST_LINUX_COMPAT=y
```

## tests/posix/networking/testcase.yaml
```yaml
common:
  min_ram: 48
  tags:
    - iface
    - net
    - posix_networking
  platform_key:
    - arch
    - simulation
tests:
  portability.posix.networking:
    filter: not CONFIG_NATIVE_LIBC
  portability.posix.networking.userspace:
    filter: (not CONFIG_NATIVE_LIBC) and CONFIG_ARCH_HAS_USERSPACE
    tags: userspace
    min_ram: 160
    extra_configs:
      - CONFIG_TEST_USERSPACE=y
      - CONFIG_USERSPACE=y
  portability.posix.networking.dns_resolver.userspace:
    filter: (not CONFIG_NATIVE_LIBC) and CONFIG_ARCH_HAS_USERSPACE
    tags: userspace
    min_ram: 160
    extra_configs:
      - CONFIG_TEST_USERSPACE=y
      - CONFIG_USERSPACE=y
      # a name server nothing answers for: the query fails as a result code
      - CONFIG_DNS_RESOLVER=y
      - CONFIG_DNS_SERVER_IP_ADDRESSES=y
      - CONFIG_DNS_SERVER1="192.0.2.53"
      - CONFIG_NET_SOCKETS_DNS_TIMEOUT=500
  portability.posix.networking.inet_raw:
    filter: not CONFIG_NATIVE_LIBC
    extra_configs:
      - CONFIG_NET_SOCKETS_INET_RAW=y
  portability.posix.networking.armclang_std_libc:
    filter: not CONFIG_NATIVE_LIBC
    toolchain_allow: armclang
    extra_configs:
      - CONFIG_ARMCLANG_STD_LIBC=y
  portability.posix.networking.arcmwdtlib:
    filter: not CONFIG_NATIVE_LIBC
    toolchain_allow: arcmwdt
    extra_configs:
      - CONFIG_ARCMWDT_LIBC=y
  portability.posix.networking.minimal:
    filter: not CONFIG_NATIVE_LIBC
    extra_configs:
      - CONFIG_MINIMAL_LIBC=y
  portability.posix.networking.newlib:
    filter: (not CONFIG_NATIVE_LIBC) and (TOOLCHAIN_HAS_NEWLIB == 1)
    extra_configs:
      - CONFIG_NEWLIB_LIBC=y
  portability.posix.networking.picolibc:
    tags: picolibc
    filter: (not CONFIG_NATIVE_LIBC) and CONFIG_PICOLIBC_SUPPORTED
    extra_configs:
      - CONFIG_PICOLIBC=y
  portability.posix.networking.linux_compat:
    tags: native
    platform_allow:
      - native_sim
      - native_sim/native/64
    filter: CONFIG_NATIVE_LIBC
    extra_configs:
      - CONFIG_POSIX_TEST_LINUX_COMPAT=y
```

## tests/posix/xsi_multi_process/testcase.yaml
```yaml
common:
  tags:
    - posix
    - xsi_multi_process
  # 1 tier0 platform per supported architecture
  platform_key:
    - arch
    - simulation
  min_ram: 32
tests:
  portability.posix.xsi_multi_process:
    filter: not CONFIG_NATIVE_LIBC
  portability.posix.xsi_multi_process.userspace:
    filter: (not CONFIG_NATIVE_LIBC) and CONFIG_ARCH_HAS_USERSPACE
    tags: userspace
    extra_configs:
      - CONFIG_TEST_USERSPACE=y
      - CONFIG_USERSPACE=y
  portability.posix.xsi_multi_process.linux_compat:
    tags: native
    platform_allow:
      - native_sim
      - native_sim/native/64
    filter: CONFIG_NATIVE_LIBC
    extra_configs:
      - CONFIG_POSIX_TEST_LINUX_COMPAT=y
```
