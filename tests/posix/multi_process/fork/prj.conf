## prj.conf
```kconfig
CONFIG_ZTEST=y

CONFIG_POSIX_AEP_CHOICE_BASE=y
CONFIG_POSIX_MULTI_PROCESS=y
CONFIG_USERSPACE=y
CONFIG_TEST_USERSPACE=y
CONFIG_PROCESS_VM=y
# fork's same-address TLS requires the arch current-thread lookup
CONFIG_CURRENT_THREAD_USE_TLS=n
CONFIG_SYS_PROCESS_MAX=5
# four fork round-trips: the reaped children's tables free lazily
CONFIG_HEAP_MEM_POOL_SIZE=262144
# a child's copies come from the page-frame pool: an arena the kernel heap could not hold
CONFIG_COMMON_LIBC_MALLOC_ARENA_SIZE=524288
CONFIG_MAX_THREAD_BYTES=5
CONFIG_SYS_THREAD_THREAD_MIN=4
CONFIG_SYS_THREAD_STACK_MIN=4

# fd inheritance sections use an eventfd as the shared description
CONFIG_POSIX_DEVICE_IO=y
CONFIG_EVENTFD=y

# the disposition inheritance section queries sigaction() across fork
CONFIG_POSIX_SIGNALS=y
```

## boards/qemu_riscv64.conf
```kconfig
# SPDX-FileCopyrightText: Copyright The Zephyr Project Contributors
# SPDX-License-Identifier: Apache-2.0

# three-level tables: the ztest domain, the four forked children and their
# kernel views each privatize a table per level (page tables are not reclaimed)
CONFIG_MAX_XLAT_TABLES=48
```

## boards/qemu_riscv64_qemu_virt_riscv64_sv48.conf
```kconfig
# SPDX-FileCopyrightText: Copyright The Zephyr Project Contributors
# SPDX-License-Identifier: Apache-2.0

# four-level tables: the ztest domain, the four forked children and their
# kernel views each privatize a table per level (page tables are not reclaimed)
CONFIG_MAX_XLAT_TABLES=80
```

## boards/qemu_x86.conf
```kconfig
# SPDX-FileCopyrightText: Copyright The Zephyr Project Contributors
# SPDX-License-Identifier: Apache-2.0

# one additional domain per fork round-trip (page tables are not reclaimed):
# the ztest domain plus the three forked children
CONFIG_X86_MAX_ADDITIONAL_MEM_DOMAINS=4

# PROCESS_VM needs the kernel on the process's page tables: no KPTI
CONFIG_X86_KPTI=n
```

## boards/qemu_x86_64.conf
```kconfig
# SPDX-FileCopyrightText: Copyright The Zephyr Project Contributors
# SPDX-License-Identifier: Apache-2.0

# one additional domain per fork round-trip (page tables are not reclaimed):
# the ztest domain plus the four forked children
CONFIG_X86_MAX_ADDITIONAL_MEM_DOMAINS=5

# PROCESS_VM needs the kernel on the process's page tables: no KPTI
CONFIG_X86_KPTI=n
```

## src/main.c
```c
/*
 * SPDX-FileCopyrightText: Copyright The Zephyr Project Contributors
 *
 * SPDX-License-Identifier: Apache-2.0
 */

#include <errno.h>
#include <pthread.h>
#include <signal.h>
#include <stdlib.h>
#include <sys/eventfd.h>
#include <sys/wait.h>
#include <unistd.h>

#include <zephyr/ztest.h>

/*
 * Experimental CONFIG_PROCESS_VM fork over the kernel-assisted resume: the
 * child's first run returns to user mode from the parent's captured syscall
 * frame (no setjmp/longjmp), so fork() must be called from user mode - a
 * kernel-mode caller has no syscall frame and gets ENOTSUP.
 */

static ZTEST_DMEM volatile int fork_shared = 10;
static Z_THREAD_LOCAL volatile int fork_tls = 30;

static void fork_handler(int signo)
{
	ARG_UNUSED(signo);
}

/* the child inherits every parent disposition across fork (POSIX) */
static void fork_dispositions(void)
{
	pid_t pid;
	int status = -1;
	struct sigaction oact;
	struct sigaction act = {
		.sa_handler = fork_handler,
		.sa_flags = 0,
	};

	zassert_ok(sigemptyset(&act.sa_mask));
	zassert_ok(sigaction(SIGUSR1, &act, NULL));
	act.sa_handler = SIG_IGN;
	zassert_ok(sigaction(SIGUSR2, &act, NULL));

	/* in force for the parent before the fork */
	zassert_ok(sigaction(SIGUSR1, NULL, &oact));
	zassert_equal(fork_handler, oact.sa_handler);
	zassert_ok(sigaction(SIGUSR2, NULL, &oact));
	zassert_equal(SIG_IGN, oact.sa_handler);

	pid = fork();
	zassert_true(pid >= 0, "fork failed: %d", errno);
	if (pid == 0) {
		/*
		 * Kernel-staged user memory (syscall copy-outs, the signal
		 * trampoline frame) aliases the parent's frames in the fork
		 * child, so neither sigaction() queries nor handler delivery
		 * can run here. The inherited ignore is still observable end
		 * to end: were the disposition not inherited, the default
		 * action for SIGUSR2 would end this thread before _exit(9).
		 */
		if (raise(SIGUSR2) != 0) {
			_exit(6);
		}
		_exit(9);
	}

	zassert_equal(waitpid(pid, &status, 0), pid);
	zassert_true(WIFEXITED(status));
	zassert_equal(WEXITSTATUS(status), 9,
		      "the child did not inherit the parent's dispositions (exit %d)",
		      WEXITSTATUS(status));

	act.sa_handler = SIG_DFL;
	zassert_ok(sigaction(SIGUSR1, &act, NULL));
	zassert_ok(sigaction(SIGUSR2, &act, NULL));
}

/* the child's signal mask is the parent's: a blocked signal pends, an unblocked one acts */
static void fork_sigmask(void)
{
	int status = -1;
	pid_t pid;
	sigset_t set;
	sigset_t old;

	zassert_ok(sigemptyset(&set));
	zassert_ok(sigaddset(&set, SIGUSR2));
	zassert_ok(pthread_sigmask(SIG_BLOCK, &set, &old));

	pid = fork();
	zassert_true(pid >= 0, "fork failed: %d", errno);
	if (pid == 0) {
		/* SIGUSR2 stays pending; the default action for SIGTERM ends the child */
		if (raise(SIGUSR2) != 0) {
			_exit(6);
		}
		(void)raise(SIGTERM);
		_exit(9);
	}

	zassert_equal(waitpid(pid, &status, 0), pid);
	zassert_true(WIFSIGNALED(status), "the child did not inherit the parent's mask (status %d)",
		     status);
	zassert_equal(WTERMSIG(status), SIGTERM);

	zassert_ok(pthread_sigmask(SIG_SETMASK, &old, NULL));
}

static ZTEST_DMEM volatile unsigned int atfork_stages;

static void atfork_prepare(void)
{
	atfork_stages |= 1U;
}

static void atfork_parent(void)
{
	atfork_stages |= 2U;
}

static void atfork_child(void)
{
	atfork_stages |= 4U;
}

/* prepare runs before the fork, parent after it here, child after it there (POSIX) */
static void fork_atfork(void)
{
	pid_t pid;
	int status = -1;

	atfork_stages = 0;
	zassert_ok(pthread_atfork(atfork_prepare, atfork_parent, atfork_child));

	pid = fork();
	zassert_true(pid >= 0, "fork failed: %d", errno);
	if (pid == 0) {
		_exit((atfork_stages == (1U | 4U)) ? 9 : 1);
	}

	zassert_equal(waitpid(pid, &status, 0), pid);
	zassert_true(WIFEXITED(status));
	zassert_equal(WEXITSTATUS(status), 9, "the child did not see prepare and child only");
	zassert_equal(atfork_stages, 1U | 2U, "the parent ran %#x", atfork_stages);
}

ZTEST_USER(posix_fork, test_fork)
{
	volatile int on_stack = 20;
	volatile int *tls_addr = &fork_tls;

	zassert_equal(fork_shared, 10, "app-data not initialized before fork");
	zassert_equal(fork_tls, 30, "TLS not initialized before fork");

	pid_t pid = fork();

	zassert_true(pid >= 0, "fork failed: %d", errno);

	if (pid == 0) {
		/* TLS keeps its address and contents across fork (POSIX) */
		if ((&fork_tls != tls_addr) || (fork_tls != 30)) {
			_exit(2);
		}
		fork_shared = 11;
		on_stack = 21;
		fork_tls = 31;
		_exit((fork_shared == 11 && on_stack == 21 && fork_tls == 31) ? 7 : 1);
	}

	int status = -1;

	zassert_equal(waitpid(pid, &status, 0), pid);
	zassert_true(WIFEXITED(status));
	zassert_equal(WEXITSTATUS(status), 7, "child could not diverge its own copy");

	zassert_equal(on_stack, 20, "parent stack was mutated");
	zassert_equal(fork_shared, 10, "parent app-data was mutated");
	zassert_equal(fork_tls, 30, "parent TLS was mutated");

	/* descriptors: the child inherits copies sharing the descriptions */
	eventfd_t val = 0;
	int efd = eventfd(0, 0);

	zassert_true(efd >= 0, "eventfd failed: %d", errno);

	pid = fork();
	zassert_true(pid >= 0, "fork failed: %d", errno);
	if (pid == 0) {
		/* the inherited descriptor reaches the same open description */
		if (eventfd_write(efd, 5) != 0) {
			_exit(3);
		}
		/* closing here drops only this process's descriptor */
		_exit((close(efd) == 0) ? 8 : 4);
	}

	status = -1;
	zassert_equal(waitpid(pid, &status, 0), pid);
	zassert_true(WIFEXITED(status));
	zassert_equal(WEXITSTATUS(status), 8);

	/* the parent's descriptor survives the child's close and exit */
	zassert_ok(eventfd_read(efd, &val));
	zassert_equal(val, 5);
	zassert_ok(close(efd));

	fork_dispositions();
	fork_sigmask();
	fork_atfork();
}

ZTEST_SUITE(posix_fork, NULL, NULL, NULL, NULL, NULL);
```
