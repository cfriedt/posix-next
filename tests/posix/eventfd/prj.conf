## CMakeLists.txt
```
# SPDX-License-Identifier: Apache-2.0

cmake_minimum_required(VERSION 3.20.0)
find_package(Zephyr REQUIRED HINTS $ENV{ZEPHYR_BASE})
project(eventfd)

FILE(GLOB app_sources src/*.c)
target_sources(app PRIVATE ${app_sources})

target_compile_options(app PRIVATE -U_POSIX_C_SOURCE -D_POSIX_C_SOURCE=200112L)
target_compile_options(app PRIVATE -U_XOPEN_SOURCE -D_XOPEN_SOURCE=600)
```

## Kconfig
```
# Copyright (c) 2023, Meta
#
# SPDX-License-Identifier: Apache-2.0

source "Kconfig.zephyr"

config TEST_DURATION_S
	int "Number of seconds to run the test"
	range 1 21600
	default 5
	help
	   Duration for the test, in seconds. The range has a reblatively high
	   upper bound because we should expect that eventfd_read() and
	   eventfd_write() are stable enough to run for an arbitrarily long
	   period of time without encountering any race conditions.

config TEST_TIMEOUT_S
	int "Number of seconds to run the test"
	range 1 21600
	default 10

config TEST_STACK_SIZE
	int "Size of each thread stack in this test"
	default 2048
	help
	  The minimal stack size required to run a no-op thread.

config TEST_EXTRA_ASSERTIONS
	bool "Add extra assertions into the hot path"
	help
	  In order to get a true benchmark, there should be as few branches
	  as possible on the hot path. Say 'y' here to add extra assertions
	  on the hot path as well to verify functionality.

config TEST_EXTRA_QUIET
	bool "Do not print out regular reports"
	help
	  In order to get a true benchmark, there should be as few branches
	  as possible on the hot path. Say 'y' here to skip reporting.

module = EVENTFD_TEST
module-str = eventfd
source "subsys/logging/Kconfig.template.log_config"

# Disable NATIVE_LIBC_INCOMPATIBLE to support testing against Linux's eventfd() implementation
config POSIX_SYSTEM_INTERFACES
	bool

# To support testing against Linux's eventfd(), POSIX, and X/Open API implementations
config NATIVE_LIBC
	bool
	select FULL_LIBC_SUPPORTED
	select TC_PROVIDES_EVENTFD
	select TC_PROVIDES_POSIX_ASYNCHRONOUS_IO
	select TC_PROVIDES_POSIX_BARRIERS
	select TC_PROVIDES_POSIX_C_LANG_SUPPORT_R
	select TC_PROVIDES_POSIX_C_LIB_EXT
	select TC_PROVIDES_POSIX_DEVICE_IO
	select TC_PROVIDES_POSIX_FD_MGMT
	select TC_PROVIDES_POSIX_FILE_SYSTEM_R
	select TC_PROVIDES_POSIX_MULTI_PROCESS
	select TC_PROVIDES_POSIX_RW_LOCKS
	select TC_PROVIDES_POSIX_SINGLE_PROCESS
	select TC_PROVIDES_POSIX_SEMAPHORES
	select TC_PROVIDES_POSIX_SPIN_LOCKS
	select TC_PROVIDES_POSIX_THREADS
	select TC_PROVIDES_POSIX_TIMERS
	select TC_PROVIDES_XSI_STREAMS
```

## prj.conf
```kconfig
CONFIG_ZTEST=y

CONFIG_EVENTFD=y

# for basic POSIX I/O and file descriptor management
CONFIG_POSIX_AEP_CHOICE_PSE51=y
CONFIG_POSIX_DEVICE_IO=y
CONFIG_XSI_STREAMS=y

# for pthreads with automatically allocated stacks
CONFIG_DYNAMIC_THREAD=y
CONFIG_DYNAMIC_THREAD_POOL_SIZE=1
CONFIG_THREAD_STACK_INFO=y
```

## src/_main.h
```c
/*
 * Copyright (c) 2020 Tobias Svehagen
 *
 * SPDX-License-Identifier: Apache-2.0
 */

#ifndef TESTS_POSIX_EVENTFD_SRC__MAIN_H_
#define TESTS_POSIX_EVENTFD_SRC__MAIN_H_

#include <errno.h>
#include <poll.h>
#include <pthread.h>
#include <stdio.h>
#include <sys/eventfd.h>
#include <unistd.h>

#include <zephyr/ztest.h>

#define TESTVAL 10

#ifdef __cplusplus
extern "C" {
#endif

struct eventfd_fixture {
	int fd;
};

void reopen(int *fd, int initval, int flags);
int is_blocked(int fd, short *event);
void eventfd_poll_set_common(int fd);
void eventfd_poll_unset_common(int fd);

#ifdef __cplusplus
}
#endif

#endif
```

## src/blocking.c
```c
/*
 * Copyright (c) 2020 Tobias Svehagen
 *
 * SPDX-License-Identifier: Apache-2.0
 */

#include "_main.h"

ZTEST_F(eventfd, test_write_then_read)
{
	eventfd_t val;
	int ret;

	ret = eventfd_write(fixture->fd, 3);
	zassert_true(ret == 0, "write ret %d", ret);

	ret = eventfd_write(fixture->fd, 2);
	zassert_true(ret == 0, "write ret %d", ret);

	ret = eventfd_read(fixture->fd, &val);
	zassert_true(ret == 0, "read ret %d", ret);
	zassert_true(val == 5, "val == %lld", val);

	/* Test EFD_SEMAPHORE */
	reopen(&fixture->fd, 0, EFD_SEMAPHORE);

	ret = eventfd_write(fixture->fd, 3);
	zassert_true(ret == 0, "write ret %d", ret);

	ret = eventfd_write(fixture->fd, 2);
	zassert_true(ret == 0, "write ret %d", ret);

	ret = eventfd_read(fixture->fd, &val);
	zassert_true(ret == 0, "read ret %d", ret);
	zassert_true(val == 1, "val == %lld", val);
}

ZTEST_F(eventfd, test_zero_shall_not_unblock)
{
	short event;
	int ret;

	ret = eventfd_write(fixture->fd, 0);
	zassert_equal(ret, 0, "fd == %d", fixture->fd);

	event = POLLIN;
	ret = is_blocked(fixture->fd, &event);
	zassert_equal(ret, 1, "eventfd unblocked by zero");
}

ZTEST_F(eventfd, test_poll_timeout)
{
	struct pollfd pfd;
	int ret;

	pfd.fd = fixture->fd;
	pfd.events = POLLIN;

	ret = poll(&pfd, 1, 500);
	zassert_true(ret == 0, "poll ret %d", ret);
}

ZTEST_F(eventfd, test_set_poll_event_block)
{
	reopen(&fixture->fd, TESTVAL, 0);
	eventfd_poll_set_common(fixture->fd);
}

ZTEST_F(eventfd, test_unset_poll_event_block)
{
	eventfd_poll_unset_common(fixture->fd);
}

static void *thread_eventfd_read_42(void *arg1)
{
	eventfd_t value;
	struct eventfd_fixture *fixture = arg1;

	zassert_ok(eventfd_read(fixture->fd, &value));
	zassert_equal(value, 42);

	return NULL;
}

ZTEST_F(eventfd, test_read_then_write_block)
{
	pthread_t th;

	zassert_ok(pthread_create(&th, NULL, thread_eventfd_read_42, fixture));

	usleep(100000);

	/* this write never occurs */
	zassert_ok(eventfd_write(fixture->fd, 42));

	/* unreachable code */
	zassert_ok(pthread_join(th, NULL));
}

static void *thread_eventfd_posix_read_42(void *arg1)
{
	uint64_t value;
	struct eventfd_fixture *fixture = arg1;
	int ret;

	ret = read(fixture->fd, &value, sizeof(value));
	zassert(ret == sizeof(value), "read(2) failed");
	zassert_equal(value, 42);

	return NULL;
}

ZTEST_F(eventfd, test_posix_read_then_write_block)
{
	pthread_t th;

	zassert_ok(pthread_create(&th, NULL, thread_eventfd_posix_read_42, fixture));

	usleep(100000);

	zassert_ok(eventfd_write(fixture->fd, 42));

	zassert_ok(pthread_join(th, NULL));
}

static void *thread_eventfd_write(void *arg1)
{
	struct eventfd_fixture *fixture = arg1;

	zassert_ok(eventfd_write(fixture->fd, 71));

	return NULL;
}

ZTEST_F(eventfd, test_write_while_pollin)
{
	struct pollfd fds[] = {
		{
			.fd = fixture->fd,
			.events = POLLIN,
		},
	};
	eventfd_t value;
	pthread_t th;
	int ret;

	zassert_ok(pthread_create(&th, NULL, thread_eventfd_write, fixture));

	/* Expect 1 event */
	ret = poll(fds, ARRAY_SIZE(fds), 200);
	zassert_equal(ret, 1);

	zassert_equal(fds[0].revents, POLLIN);

	/* Check value */
	zassert_ok(eventfd_read(fixture->fd, &value));
	zassert_equal(value, 71);

	zassert_ok(pthread_join(th, NULL));
}

static void *thread_eventfd_read(void *arg1)
{
	eventfd_t value;
	struct eventfd_fixture *fixture = arg1;

	usleep(100000);

	zassert_ok(eventfd_read(fixture->fd, &value));

	return NULL;
}

ZTEST_F(eventfd, test_read_while_pollout)
{
	struct pollfd fds[] = {
		{
			.fd = fixture->fd,
			.events = POLLOUT,
		},
	};
	pthread_t th;
	int ret;

	zassert_ok(eventfd_write(fixture->fd, UINT64_MAX - 1));

	zassert_ok(pthread_create(&th, NULL, thread_eventfd_read, fixture));

	/* Expect 1 event */
	ret = poll(fds, ARRAY_SIZE(fds), 200);
	zassert_equal(ret, 1);

	zassert_equal(fds[0].revents, POLLOUT);

	zassert_ok(pthread_join(th, NULL));
}

static void *thread_eventfd_close(void *arg1)
{
	struct eventfd_fixture *fixture = arg1;

	usleep(100000);

	zassert_ok(close(fixture->fd));

	return NULL;
}

ZTEST_F(eventfd, test_read_then_close_block)
{
	eventfd_t value;
	pthread_t th;

	if (IS_ENABLED(CONFIG_POSIX_TEST_LINUX_COMPAT)) {
		/* Linux leaves a reader blocked when another thread closes the descriptor */
		ztest_test_skip();
	}

	zassert_ok(pthread_create(&th, NULL, thread_eventfd_close, fixture));

	zassert_equal(read(fixture->fd, &value, sizeof(value)), -1);

	zassert_ok(pthread_join(th, NULL));
}
```

## src/ioctl.c
```c
/*
 * Copyright (c) 2024 Celina Sophie Kalus
 *
 * SPDX-License-Identifier: Apache-2.0
 */

#include "_main.h"

#undef _POSIX_C_SOURCE
#define _POSIX_C_SOURCE 200809L

#include <fcntl.h>
#include <sys/ioctl.h>

#define EFD_IN_USE_INTERNAL 0x1

ZTEST_F(eventfd, test_set_flags)
{
	eventfd_t val;
	int ret;
	int flags;
	short event;

	/* Get current flags; Expect blocking, non-semaphore. */
	flags = ioctl(fixture->fd, F_GETFL, 0);
	zassert_equal(flags, 0, "flags == %d", flags);

	event = POLLIN;
	ret = is_blocked(fixture->fd, &event);
	zassert_equal(ret, 1, "eventfd read not blocked");

	/* Try writing and reading. Should not fail. */
	ret = eventfd_write(fixture->fd, 3);
	zassert_ok(ret);

	ret = eventfd_read(fixture->fd, &val);
	zassert_ok(ret);
	zassert_equal(val, 3, "val == %lld", val);


	/* Set nonblocking without reopening. */
	ret = ioctl(fixture->fd, F_SETFL, O_NONBLOCK);
	zassert_ok(ret);

	flags = ioctl(fixture->fd, F_GETFL, 0);
	zassert_equal(flags, O_NONBLOCK, "flags == %d", flags);

	event = POLLOUT;
	ret = is_blocked(fixture->fd, &event);
	zassert_equal(ret, 0, "eventfd write blocked");


	/* Try writing and reading again. */
	ret = eventfd_write(fixture->fd, 19);
	zassert_ok(ret);

	ret = eventfd_read(fixture->fd, &val);
	zassert_ok(ret);
	zassert_equal(val, 19, "val == %lld", val);


	/* Set back to blocking. */
	ret = ioctl(fixture->fd, F_SETFL, 0);
	zassert_ok(ret);

	flags = ioctl(fixture->fd, F_GETFL, 0);
	zassert_equal(flags, 0, "flags == %d", flags);

	event = POLLIN;
	ret = is_blocked(fixture->fd, &event);
	zassert_equal(ret, 1, "eventfd read not blocked");


	/* Try writing and reading again. */
	ret = eventfd_write(fixture->fd, 10);
	zassert_ok(ret);

	ret = eventfd_read(fixture->fd, &val);
	zassert_ok(ret);
	zassert_equal(val, 10, "val == %lld", val);


	/* Test setting internal in-use-flag. Should fail. */
	ret = ioctl(fixture->fd, F_SETFL, EFD_IN_USE_INTERNAL);
	zassert_not_ok(ret);


	/* File descriptor should still be valid and working. */
	ret = eventfd_write(fixture->fd, 97);
	zassert_ok(ret);

	ret = eventfd_read(fixture->fd, &val);
	zassert_ok(ret);
	zassert_equal(val, 97, "val == %lld", val);
}
```

## src/stress.c
```c
/*
 * Copyright (c) 2023, Meta
 *
 * SPDX-License-Identifier: Apache-2.0
 */

#include "_main.h"

/* update interval for printing stats */
#if CONFIG_TEST_DURATION_S >= 60
#define UPDATE_INTERVAL_S 10
#elif CONFIG_TEST_DURATION_S >= 30
#define UPDATE_INTERVAL_S 5
#else
#define UPDATE_INTERVAL_S 1
#endif

enum th_id {
	WRITER,
	READER,
};

typedef int (*eventfd_op_t)(int fd);

static size_t count[2];
static struct k_thread th[2];
static const char *msg[2] = {
	[READER] = "reads",
	[WRITER] = "writes",
};

static int read_op(int fd);
static int write_op(int fd);

static const eventfd_op_t op[2] = {
	[READER] = read_op,
	[WRITER] = write_op,
};
static K_THREAD_STACK_ARRAY_DEFINE(th_stack, 2, CONFIG_TEST_STACK_SIZE);

static int read_op(int fd)
{
	eventfd_t value;

	return eventfd_read(fd, &value);
}

static int write_op(int fd)
{
	return eventfd_write(fd, 1);
}

static void th_fun(void *arg1, void *arg2, void *arg3)
{

	int ret;
	uint64_t now;
	uint64_t end;
	uint64_t report;
	enum th_id id = POINTER_TO_UINT(arg1);
	struct eventfd_fixture *fixture = arg2;
	const uint64_t report_ms = UPDATE_INTERVAL_S * MSEC_PER_SEC;
	const uint64_t end_ms = CONFIG_TEST_DURATION_S * MSEC_PER_SEC;

	for (now = k_uptime_get(), end = now + end_ms, report = now + report_ms; now < end;
	     now = k_uptime_get()) {

		ret = op[id](fixture->fd);
		if (IS_ENABLED(CONFIG_TEST_EXTRA_ASSERTIONS)) {
			zassert_true(ret == 0 || (ret == -1 && errno == EAGAIN),
				     "ret: %d errno: %d", ret, errno);
		}
		count[id] += (ret == 0);

		if (!IS_ENABLED(CONFIG_TEST_EXTRA_QUIET)) {
			if (now >= report) {
				printk("%zu %s\n", count[id], msg[id]);
				report += report_ms;
			}
		}
		Z_SPIN_DELAY(10);
	}

	printk("avg: %zu %s/s\n", (size_t)((count[id] * MSEC_PER_SEC) / end_ms), msg[id]);
}

ZTEST_F(eventfd, test_stress)
{
	if (IS_ENABLED(CONFIG_COVERAGE)) {
		/* Coverage overhead overflows thread stacks on constrained targets */
		ztest_test_skip();
	}
	enum th_id i;
	enum th_id begin = MIN(READER, WRITER);
	enum th_id end = MAX(READER, WRITER) + 1;

	printk("BOARD: %s\n", CONFIG_BOARD);
	printk("TEST_DURATION_S: %u\n", CONFIG_TEST_DURATION_S);
	printk("UPDATE_INTERVAL_S: %u\n", UPDATE_INTERVAL_S);

	reopen(&fixture->fd, 0, EFD_NONBLOCK | EFD_SEMAPHORE);

	for (i = begin; i < end; ++i) {
		k_thread_create(&th[i], th_stack[i], K_THREAD_STACK_SIZEOF(th_stack[0]), th_fun,
				UINT_TO_POINTER(i), fixture, NULL, K_LOWEST_APPLICATION_THREAD_PRIO,
				0, K_NO_WAIT);
	}

	for (i = begin; i < end; ++i) {
		zassert_ok(k_thread_join(&th[i], K_FOREVER));
	}

	zassert_true(count[READER] > 0, "read count is zero");
	zassert_true(count[WRITER] > 0, "write count is zero");
	zassert_true(count[WRITER] >= count[READER], "read count (%zu) > write count (%zu)",
		     count[READER], count[WRITER]);
}
```
