## CMakeLists.txt
```
# SPDX-License-Identifier: Apache-2.0

cmake_minimum_required(VERSION 3.20.0)

find_package(Zephyr REQUIRED HINTS $ENV{ZEPHYR_BASE})
project(posix_hello_zephyr)

target_sources(app PRIVATE src/main.c)

target_compile_options(app PRIVATE -U_POSIX_C_SOURCE -D_POSIX_C_SOURCE=200809L)
target_compile_options(app PRIVATE -U_XOPEN_SOURCE -D_XOPEN_SOURCE=700)
```

## sample.yaml
```
sample:
  description: POSIX hello world using native Zephyr threads
  name: posix hello zephyr
common:
  tags:
    - posix_threads_base
  integration_platforms:
    - native_sim
    - qemu_riscv64
  harness: console
  harness_config:
    type: multi_line
    ordered: true
    regex:
      - "Hello World! .* from k_thread 0x[0-9a-f]+"
      - "k_thread returned 42"
tests:
  sample.posix.hello_zephyr: {}
```

## prj.conf
```kconfig
CONFIG_POSIX_AEP_CHOICE_PSE51=y
```

## src/main.c
```c
/*
 * Copyright (c) The Zephyr Project Contributors
 *
 * SPDX-License-Identifier: Apache-2.0
 */

#include <pthread.h>
#include <stdio.h>

#include <zephyr/kernel.h>

void worker_entry(void *p1, void *p2, void *p3)
{
	printf("Hello World! %s from k_thread %p\n", CONFIG_BOARD_TARGET, k_current_get());

	/* Zephyr's native threading API still does not support a direct return value */
	k_thread_result_set(INT_TO_POINTER(42));
}

K_THREAD_DEFINE(kth, 2048, worker_entry, NULL, NULL, NULL, K_LOWEST_APPLICATION_THREAD_PRIO,
		0, SYS_FOREVER_MS);

int main(void)
{
	void *res;
	pthread_t th = (pthread_t)(uintptr_t)kth;

	k_thread_start(kth);
	pthread_join(th, &res);

	printf("k_thread returned %d\n", (int)POINTER_TO_INT(res));

	return 0;
}
```
