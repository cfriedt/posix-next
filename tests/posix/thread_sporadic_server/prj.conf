## CMakeLists.txt
```
# SPDX-License-Identifier: Apache-2.0

cmake_minimum_required(VERSION 3.20.0)
find_package(Zephyr REQUIRED HINTS $ENV{ZEPHYR_BASE})
project(posix_thread_sporadic_server)

target_sources(app PRIVATE
  src/main.c
  src/pthread_attr_getschedparam.c
  src/pthread_attr_setschedparam.c
  src/pthread_attr_setschedpolicy.c
  src/pthread_getschedparam.c
  src/pthread_setschedparam.c
)

target_compile_options(app PRIVATE -U_POSIX_C_SOURCE -D_POSIX_C_SOURCE=200809L)
```

## prj.conf
```kconfig
CONFIG_ZTEST=y

CONFIG_POSIX_AEP_CHOICE_BASE=y
CONFIG_POSIX_PRIORITY_SCHEDULING=y
CONFIG_POSIX_THREAD_PRIORITY_SCHEDULING=y
CONFIG_POSIX_THREAD_SPORADIC_SERVER=y
```

## src/main.c
```c
/*
 * SPDX-FileCopyrightText: Copyright The Zephyr Project Contributors
 * SPDX-License-Identifier: Apache-2.0
 */

#include <limits.h>
#include <sched.h>
#include <unistd.h>

#include <zephyr/ztest.h>

BUILD_ASSERT(_POSIX_THREAD_SPORADIC_SERVER == 200809L,
	     "_POSIX_THREAD_SPORADIC_SERVER is not defined to 200809L");
BUILD_ASSERT((SCHED_SPORADIC != SCHED_OTHER) && (SCHED_SPORADIC != SCHED_FIFO) &&
		     (SCHED_SPORADIC != SCHED_RR),
	     "SCHED_SPORADIC is not distinct from the other scheduling policies");
BUILD_ASSERT(_POSIX_SS_REPL_MAX >= 4, "_POSIX_SS_REPL_MAX is below the POSIX minimum");
#ifdef SS_REPL_MAX
BUILD_ASSERT(SS_REPL_MAX >= _POSIX_SS_REPL_MAX, "SS_REPL_MAX is below the POSIX minimum");
#endif

ZTEST_SUITE(posix_thread_sporadic_server, NULL, NULL, NULL, NULL, NULL);
```

## src/pthread_attr_getschedparam.c
```c
/*
 * SPDX-FileCopyrightText: Copyright The Zephyr Project Contributors
 * SPDX-License-Identifier: Apache-2.0
 */

#include <pthread.h>
#include <sched.h>

#include <zephyr/ztest.h>

#include "thread_sporadic_server_tests.h"

ZTEST_USER(posix_thread_sporadic_server, test_pthread_attr_getschedparam)
{
	pthread_attr_t attr;
	int priority = sched_get_priority_max(SCHED_SPORADIC);
	struct sched_param param = sporadic_param(priority);
	struct sched_param readback = {0};

	zassert_ok(pthread_attr_init(&attr));
	zassert_ok(pthread_attr_setschedpolicy(&attr, SCHED_SPORADIC));
	zassert_ok(pthread_attr_setschedparam(&attr, &param));
	zassert_ok(pthread_attr_getschedparam(&attr, &readback));
	zassert_equal(readback.sched_priority, priority);
	zassert_ok(pthread_attr_destroy(&attr));
}
```

## src/pthread_attr_setschedparam.c
```c
/*
 * SPDX-FileCopyrightText: Copyright The Zephyr Project Contributors
 * SPDX-License-Identifier: Apache-2.0
 */

#include <errno.h>
#include <limits.h>
#include <pthread.h>
#include <sched.h>

#include <zephyr/ztest.h>

#include "thread_sporadic_server_tests.h"

ZTEST_USER(posix_thread_sporadic_server, test_pthread_attr_setschedparam)
{
	pthread_attr_t attr;
	struct sched_param param = sporadic_param(sched_get_priority_min(SCHED_SPORADIC));

	zassert_ok(pthread_attr_init(&attr));
	zassert_ok(pthread_attr_setschedpolicy(&attr, SCHED_SPORADIC));
	zassert_ok(pthread_attr_setschedparam(&attr, &param));

	param.sched_ss_max_repl = 0;
	zassert_equal(pthread_attr_setschedparam(&attr, &param), EINVAL);
	param.sched_ss_max_repl = _POSIX_SS_REPL_MAX + 1;
	zassert_equal(pthread_attr_setschedparam(&attr, &param), EINVAL);

	zassert_ok(pthread_attr_destroy(&attr));
}
```

## src/pthread_attr_setschedpolicy.c
```c
/*
 * SPDX-FileCopyrightText: Copyright The Zephyr Project Contributors
 * SPDX-License-Identifier: Apache-2.0
 */

#include <pthread.h>
#include <sched.h>

#include <zephyr/ztest.h>

ZTEST_USER(posix_thread_sporadic_server, test_pthread_attr_setschedpolicy)
{
	int policy;
	pthread_attr_t attr;

	zassert_ok(pthread_attr_init(&attr));
	zassert_ok(pthread_attr_setschedpolicy(&attr, SCHED_SPORADIC));
	zassert_ok(pthread_attr_getschedpolicy(&attr, &policy));
	zassert_equal(policy, SCHED_SPORADIC);
	zassert_ok(pthread_attr_destroy(&attr));
}
```

## src/pthread_getschedparam.c
```c
/*
 * SPDX-FileCopyrightText: Copyright The Zephyr Project Contributors
 * SPDX-License-Identifier: Apache-2.0
 */

#include <pthread.h>
#include <sched.h>

#include <zephyr/ztest.h>

#include "thread_sporadic_server_tests.h"

ZTEST_USER(posix_thread_sporadic_server, test_pthread_getschedparam)
{
	int policy = -1;
	struct sched_param orig;
	struct sched_param readback = {0};
	struct sched_param param = sporadic_param(sched_get_priority_min(SCHED_SPORADIC));

	zassert_ok(pthread_getschedparam(pthread_self(), &policy, &orig));

	zassert_ok(pthread_setschedparam(pthread_self(), SCHED_SPORADIC, &param));
	zassert_ok(pthread_getschedparam(pthread_self(), &policy, &readback));
	/* budgets are not enforced; the policy reads back as a supported policy */
	zassert_true((policy == SCHED_FIFO) || (policy == SCHED_RR) || (policy == SCHED_OTHER) ||
		     (policy == SCHED_SPORADIC));
	zassert_equal(readback.sched_priority, param.sched_priority);

	zassert_ok(pthread_setschedparam(pthread_self(), SCHED_RR, &orig));
}
```

## src/pthread_setschedparam.c
```c
/*
 * SPDX-FileCopyrightText: Copyright The Zephyr Project Contributors
 * SPDX-License-Identifier: Apache-2.0
 */

#include <errno.h>
#include <limits.h>
#include <pthread.h>
#include <sched.h>

#include <zephyr/ztest.h>

#include "thread_sporadic_server_tests.h"

ZTEST(posix_thread_sporadic_server, test_pthread_setschedparam)
{
	int policy;
	struct sched_param orig;
	struct sched_param param = sporadic_param(sched_get_priority_min(SCHED_SPORADIC));

	zassert_ok(pthread_getschedparam(pthread_self(), &policy, &orig));

	zassert_ok(pthread_setschedparam(pthread_self(), SCHED_SPORADIC, &param));

	param.sched_ss_max_repl = 0;
	zassert_equal(pthread_setschedparam(pthread_self(), SCHED_SPORADIC, &param), EINVAL);
	param.sched_ss_max_repl = _POSIX_SS_REPL_MAX + 1;
	zassert_equal(pthread_setschedparam(pthread_self(), SCHED_SPORADIC, &param), EINVAL);

	zassert_ok(pthread_setschedparam(pthread_self(), policy, &orig));
}
```

## src/thread_sporadic_server_tests.h
```c
/*
 * SPDX-FileCopyrightText: Copyright The Zephyr Project Contributors
 * SPDX-License-Identifier: Apache-2.0
 */

#ifndef TESTS_POSIX_THREAD_SPORADIC_SERVER_SRC_THREAD_SPORADIC_SERVER_TESTS_H_
#define TESTS_POSIX_THREAD_SPORADIC_SERVER_SRC_THREAD_SPORADIC_SERVER_TESTS_H_

#include <limits.h>
#include <sched.h>

static inline struct sched_param sporadic_param(int priority)
{
	return (struct sched_param){
		.sched_priority = priority,
		.sched_ss_low_priority = sched_get_priority_min(SCHED_SPORADIC),
		.sched_ss_repl_period = {.tv_sec = 1, .tv_nsec = 0},
		.sched_ss_init_budget = {.tv_sec = 0, .tv_nsec = 100000000},
		.sched_ss_max_repl = 1,
	};
}

#endif /* TESTS_POSIX_THREAD_SPORADIC_SERVER_SRC_THREAD_SPORADIC_SERVER_TESTS_H_ */
```
