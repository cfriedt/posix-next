## tests/posix/semaphores/testcase.yaml
```yaml
common:
  tags:
    - posix_semaphores
  # 1 tier0 platform per supported architecture
  platform_key:
    - arch
    - simulation
  min_flash: 64
  min_ram: 32
tests:
  portability.posix.semaphores:
    filter: not CONFIG_NATIVE_LIBC
  portability.posix.semaphores.userspace:
    filter: (not CONFIG_NATIVE_LIBC) and CONFIG_ARCH_HAS_USERSPACE
    tags: userspace
    extra_configs:
      - CONFIG_TEST_USERSPACE=y
      - CONFIG_USERSPACE=y
  portability.posix.semaphores.minimal:
    filter: not CONFIG_NATIVE_LIBC
    extra_configs:
      - CONFIG_MINIMAL_LIBC=y
  portability.posix.semaphores.newlib:
    filter: (not CONFIG_NATIVE_LIBC) and (TOOLCHAIN_HAS_NEWLIB == 1)
    extra_configs:
      - CONFIG_NEWLIB_LIBC=y
  portability.posix.semaphores.picolibc:
    tags: picolibc
    filter: (not CONFIG_NATIVE_LIBC) and CONFIG_PICOLIBC_SUPPORTED
    extra_configs:
      - CONFIG_PICOLIBC=y
  portability.posix.semaphores.linux_compat:
    tags: native
    platform_allow:
      - native_sim
      - native_sim/native/64
    filter: CONFIG_NATIVE_LIBC
    extra_configs:
      - CONFIG_POSIX_TEST_LINUX_COMPAT=y
```

## tests/posix/spin_locks/testcase.yaml
```yaml
common:
  tags:
    - posix_spin_locks
  # 1 tier0 platform per supported architecture
  platform_key:
    - arch
    - simulation
  min_flash: 64
  min_ram: 32
tests:
  portability.posix.spin_locks:
    filter: not CONFIG_NATIVE_LIBC
  portability.posix.spin_locks.userspace:
    filter: (not CONFIG_NATIVE_LIBC) and CONFIG_ARCH_HAS_USERSPACE
    tags: userspace
    extra_configs:
      - CONFIG_TEST_USERSPACE=y
      - CONFIG_USERSPACE=y
  portability.posix.spin_locks.minimal:
    filter: not CONFIG_NATIVE_LIBC
    extra_configs:
      - CONFIG_MINIMAL_LIBC=y
  portability.posix.spin_locks.newlib:
    filter: (not CONFIG_NATIVE_LIBC) and (TOOLCHAIN_HAS_NEWLIB == 1)
    extra_configs:
      - CONFIG_NEWLIB_LIBC=y
  portability.posix.spin_locks.picolibc:
    tags: picolibc
    filter: (not CONFIG_NATIVE_LIBC) and CONFIG_PICOLIBC_SUPPORTED
    extra_configs:
      - CONFIG_PICOLIBC=y
  portability.posix.spin_locks.no_spin_validate:
    filter: not CONFIG_NATIVE_LIBC
    extra_configs:
      - CONFIG_SPIN_VALIDATE=n
  portability.posix.spin_locks.linux_compat:
    tags: native
    platform_allow:
      - native_sim
      - native_sim/native/64
    filter: CONFIG_NATIVE_LIBC
    extra_configs:
      - CONFIG_POSIX_TEST_LINUX_COMPAT=y
```

## tests/posix/sporadic_server/testcase.yaml
```yaml
common:
  tags:
    - posix_sporadic_server
  # 1 tier0 platform per supported architecture
  platform_key:
    - arch
    - simulation
  min_flash: 64
  min_ram: 32
tests:
  portability.posix.sporadic_server:
    filter: not CONFIG_NATIVE_LIBC
  portability.posix.sporadic_server.userspace:
    filter: (not CONFIG_NATIVE_LIBC) and CONFIG_ARCH_HAS_USERSPACE
    tags: userspace
    extra_configs:
      - CONFIG_TEST_USERSPACE=y
      - CONFIG_USERSPACE=y
  portability.posix.sporadic_server.minimal:
    filter: not CONFIG_NATIVE_LIBC
    extra_configs:
      - CONFIG_MINIMAL_LIBC=y
  portability.posix.sporadic_server.newlib:
    filter: (not CONFIG_NATIVE_LIBC) and (TOOLCHAIN_HAS_NEWLIB == 1)
    extra_configs:
      - CONFIG_NEWLIB_LIBC=y
  portability.posix.sporadic_server.picolibc:
    tags: picolibc
    filter: (not CONFIG_NATIVE_LIBC) and CONFIG_PICOLIBC_SUPPORTED
    extra_configs:
      - CONFIG_PICOLIBC=y
  # fails: the host libc does not define SCHED_SPORADIC
  # portability.posix.sporadic_server.linux_compat:
  #   tags: native
  #   platform_allow:
  #     - native_sim
  #     - native_sim/native/64
  #   filter: CONFIG_NATIVE_LIBC
  #   extra_configs:
  #     - CONFIG_POSIX_TEST_LINUX_COMPAT=y
```

## tests/posix/symbolic_links_fd/testcase.yaml
```yaml
common:
  tags:
    - ext2
    - posix_symbolic_links_fd
  min_ram: 128
  # 1 tier0 platform per supported architecture
  platform_key:
    - arch
    - simulation
tests:
  portability.posix.symbolic_links_fd:
    filter: not CONFIG_NATIVE_LIBC
  portability.posix.symbolic_links_fd.userspace:
    filter: (not CONFIG_NATIVE_LIBC) and CONFIG_ARCH_HAS_USERSPACE
    tags: userspace
    min_ram: 160
    extra_configs:
      - CONFIG_TEST_USERSPACE=y
      - CONFIG_USERSPACE=y
      - platform:mps2/an385:CONFIG_TEST_USERSPACE_WITHOUT_HW_STACK_PROTECTION=y
      # ext2 symlink resolution runs deep on the syscall side
      - platform:qemu_riscv32/qemu_virt_riscv32:CONFIG_PRIVILEGED_STACK_SIZE=2048
  portability.posix.symbolic_links_fd.linux_compat:
    tags: native
    platform_allow:
      - native_sim
      - native_sim/native/64
    filter: CONFIG_NATIVE_LIBC
    extra_configs:
      - CONFIG_POSIX_TEST_LINUX_COMPAT=y
```

## tests/posix/thread_sporadic_server/testcase.yaml
```yaml
common:
  tags:
    - posix_thread_sporadic_server
  # 1 tier0 platform per supported architecture
  platform_key:
    - arch
    - simulation
  min_flash: 64
  min_ram: 32
tests:
  portability.posix.thread_sporadic_server:
    filter: not CONFIG_NATIVE_LIBC
  portability.posix.thread_sporadic_server.minimal:
    filter: not CONFIG_NATIVE_LIBC
    extra_configs:
      - CONFIG_MINIMAL_LIBC=y
  portability.posix.thread_sporadic_server.newlib:
    filter: (not CONFIG_NATIVE_LIBC) and (TOOLCHAIN_HAS_NEWLIB == 1)
    extra_configs:
      - CONFIG_NEWLIB_LIBC=y
  portability.posix.thread_sporadic_server.picolibc:
    tags: picolibc
    filter: (not CONFIG_NATIVE_LIBC) and CONFIG_PICOLIBC_SUPPORTED
    extra_configs:
      - CONFIG_PICOLIBC=y
```

## tests/posix/timers/testcase.yaml
```yaml
common:
  tags:
    - posix_timers
  # 1 tier0 platform per supported architecture
  platform_key:
    - arch
    - simulation
  min_flash: 64
  min_ram: 32
tests:
  portability.posix.timers:
    filter: not CONFIG_NATIVE_LIBC
  portability.posix.timers.userspace:
    filter: (not CONFIG_NATIVE_LIBC) and CONFIG_ARCH_SUPPORTS_USERSPACE_SIGNALS
    tags: userspace
    extra_configs:
      - CONFIG_TEST_USERSPACE=y
      - CONFIG_USERSPACE=y
  portability.posix.timers.static_only:
    filter: not CONFIG_NATIVE_LIBC
    extra_configs:
      # equal to the accumulated SYS_TIMER_MIN (SYS_TIMER_MIN_ADD_TEST=2): no dynamic timers
      - CONFIG_SYS_TIMER_MAX=2
  portability.posix.timers.minimal:
    filter: not CONFIG_NATIVE_LIBC
    extra_configs:
      - CONFIG_MINIMAL_LIBC=y
  portability.posix.timers.newlib:
    filter: (not CONFIG_NATIVE_LIBC) and (TOOLCHAIN_HAS_NEWLIB == 1)
    extra_configs:
      - CONFIG_NEWLIB_LIBC=y
  portability.posix.timers.picolibc:
    tags: picolibc
    filter: (not CONFIG_NATIVE_LIBC) and CONFIG_PICOLIBC_SUPPORTED
    extra_configs:
      - CONFIG_PICOLIBC=y
  portability.posix.timers.linux_compat:
    tags: native
    platform_allow:
      - native_sim
      - native_sim/native/64
    filter: CONFIG_NATIVE_LIBC
    extra_configs:
      - CONFIG_POSIX_TEST_LINUX_COMPAT=y
      - CONFIG_NATIVE_SIM_SLOWDOWN_TO_REAL_TIME=y
  portability.posix.timers.signal_less:
    filter: not CONFIG_NATIVE_LIBC
    extra_args:
      - CONF_FILE=prj_signal_less.conf
```

## tests/posix/user_groups/testcase.yaml
```yaml
common:
  tags:
    - posix_user_groups
  # 1 tier0 platform per supported architecture
  platform_key:
    - arch
    - simulation
tests:
  portability.posix.user_groups:
    filter: not CONFIG_NATIVE_LIBC
  portability.posix.user_groups.userspace:
    filter: (not CONFIG_NATIVE_LIBC) and CONFIG_ARCH_HAS_USERSPACE
    tags: userspace
    extra_configs:
      - CONFIG_TEST_USERSPACE=y
      - CONFIG_USERSPACE=y
  portability.posix.user_groups.minimal:
    filter: not CONFIG_NATIVE_LIBC
    extra_configs:
      - CONFIG_MINIMAL_LIBC=y
  portability.posix.user_groups.newlib:
    filter: (not CONFIG_NATIVE_LIBC) and (TOOLCHAIN_HAS_NEWLIB == 1)
    extra_configs:
      - CONFIG_NEWLIB_LIBC=y
  portability.posix.user_groups.picolibc:
    tags: picolibc
    filter: (not CONFIG_NATIVE_LIBC) and CONFIG_PICOLIBC_SUPPORTED
    extra_configs:
      - CONFIG_PICOLIBC=y
  portability.posix.user_groups.tls:
    filter: (not CONFIG_NATIVE_LIBC) and CONFIG_ARCH_HAS_THREAD_LOCAL_STORAGE and
      CONFIG_TOOLCHAIN_SUPPORTS_THREAD_LOCAL_STORAGE
    extra_configs:
      - CONFIG_NEWLIB_LIBC=n
      - CONFIG_THREAD_LOCAL_STORAGE=y
  portability.posix.user_groups.tls.newlib:
    filter: (not CONFIG_NATIVE_LIBC) and (TOOLCHAIN_HAS_NEWLIB == 1) and
      CONFIG_ARCH_HAS_THREAD_LOCAL_STORAGE and CONFIG_TOOLCHAIN_SUPPORTS_THREAD_LOCAL_STORAGE
    extra_configs:
      - CONFIG_NEWLIB_LIBC=y
      - CONFIG_THREAD_LOCAL_STORAGE=y
  portability.posix.user_groups.linux_compat:
    tags: native
    platform_allow:
      - native_sim
      - native_sim/native/64
    filter: CONFIG_NATIVE_LIBC
    extra_configs:
      - CONFIG_POSIX_TEST_LINUX_COMPAT=y
      - CONFIG_ZVFS_OPEN_MAX=7
```
